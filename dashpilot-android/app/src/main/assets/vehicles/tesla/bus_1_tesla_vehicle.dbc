VERSION "2021.24.4"

NS_ :

BS_:

BU_: VEH CH Receiver X

BA_DEF_ BO_ "GenMsgSendType" ENUM "Cyclic";
BA_DEF_ BO_ "GenMsgCycleTime" INT 0 10000;

BO_ 1465 DAS_alertLog: 8 Vector__XXX
 SG_ DAS_sw076_accActive m76 : 63|1@1+ (1,0) [0|0] "" Vector__XXX
 SG_ DAS_sw074_autopilotActive m74 : 63|1@1+ (1,0) [0|0] "" Vector__XXX
 SG_ DAS_sw060_accActive m60 : 63|1@1+ (1,0) [0|0] "" Vector__XXX
 SG_ DAS_sw053_a62strRackMismatch m53 : 63|1@1+ (1,0) [0|0] "" Vector__XXX
 SG_ DAS_sw050_accActive m50 : 63|1@1+ (1,0) [0|0] "" Vector__XXX
 SG_ DAS_sw017_Any_FCW_PCW_Msg_Recd m17 : 63|1@1+ (1,0) [0|0] "" Vector__XXX
 SG_ DAS_sw016_accActive m16 : 63|1@1+ (1,0) [0|0] "" Vector__XXX
 SG_ DAS_sw074_cruiseActive m74 : 62|1@1+ (1,0) [0|0] "" Vector__XXX
 SG_ DAS_sw072_userTimeout m72 : 62|1@1+ (1,0) [0|0] "" Vector__XXX
 SG_ DAS_sw053_a61radPositionMismatch m53 : 62|1@1+ (1,0) [0|0] "" Vector__XXX
 SG_ DAS_sw027_Unused_word m27 : 62|2@1+ (1,0) [0|0] "" Vector__XXX
 SG_ DAS_sw017_Any_Common_Msg_Recd m17 : 62|1@1+ (1,0) [0|0] "" Vector__XXX
 SG_ DAS_sw086_driverHandsOn m86 : 61|1@1+ (1,0) [0|0] "" Vector__XXX
 SG_ DAS_sw076_fcmModeAtEvent m76 : 61|2@1+ (1,0) [0|0] "" Vector__XXX
 SG_ DAS_sw072_garageOpened m72 : 61|1@1+ (1,0) [0|0] "" Vector__XXX
 SG_ DAS_sw053_a60drmiInvalidCount m53 : 61|1@1+ (1,0) [0|0] "" Vector__XXX
 SG_ DAS_sw050_fcmModeAtEvent m50 : 61|2@1+ (1,0) [0|0] "" Vector__XXX
 SG_ DAS_sw027_PORST m27 : 61|1@1+ (1,0) [0|0] "" Vector__XXX
 SG_ DAS_sw017_Any_Hlb_Msg_Recd m17 : 61|1@1+ (1,0) [0|0] "" Vector__XXX
 SG_ DAS_sw016_fcmModeAtEvent m16 : 61|2@1+ (1,0) [0|0] "" Vector__XXX
 SG_ DAS_sw004_visionNotRunning m4 : 61|1@1+ (1,0) [0|0] "" Vector__XXX
 SG_ DAS_sw231_predOverlap m231 : 60|4@1+ (10,0) [0|0] "" Vector__XXX
 SG_ DAS_sw199_numShifts m199 : 60|4@1+ (1,0) [0|0] "" Vector__XXX
 SG_ DAS_sw086_controlledAccess m86 : 60|1@1+ (1,0) [0|0] "" Vector__XXX
 SG_ DAS_sw076_overrideSteer m76 : 60|1@1+ (1,0) [0|0] "" Vector__XXX
 SG_ DAS_sw073_freespaceRightFarZ m73 : 60|4@1+ (4,0) [0|0] "" Vector__XXX
 SG_ DAS_sw072_keyfobPress m72 : 60|1@1+ (1,0) [0|0] "" Vector__XXX
 SG_ DAS_sw060_collisionWarningSource m60 : 60|3@1+ (1,0) [0|0] "" Vector__XXX
 SG_ DAS_sw053_a59drmiInvalidChkSm m53 : 60|1@1+ (1,0) [0|0] "" Vector__XXX
 SG_ DAS_sw050_overrideSteer m50 : 60|1@1+ (1,0) [0|0] "" Vector__XXX
 SG_ DAS_sw027_STDBY_WDG m27 : 60|1@1+ (1,0) [0|0] "" Vector__XXX
 SG_ DAS_sw017_Any_Tsr_Msg_Recd m17 : 60|1@1+ (1,0) [0|0] "" Vector__XXX
 SG_ DAS_sw016_overrideSteer m16 : 60|1@1+ (1,0) [0|0] "" Vector__XXX
 SG_ DAS_sw013_numTransportErrors m13 : 60|4@1+ (1,0) [0|0] "" Vector__XXX
 SG_ DAS_sw004_SelfGlare m4 : 60|1@1+ (1,0) [0|0] "" Vector__XXX
 SG_ DAS_sw231_steeringOverride m231 : 59|1@1+ (1,0) [0|0] "" Vector__XXX
 SG_ DAS_sw103_radAlignment m103 : 59|5@1+ (0.015625,-0.2343) [0|0] "" Vector__XXX
 SG_ DAS_sw086_ipsoApproved m86 : 59|1@1+ (1,0) [0|0] "" Vector__XXX
 SG_ DAS_sw083_Targ5_wNonObj m83 : 59|5@1+ (0.03125,0) [0|0] "" Vector__XXX
 SG_ DAS_sw076_overrideBrake m76 : 59|1@1+ (1,0) [0|0] "" Vector__XXX
 SG_ DAS_sw074_roadClass m74 : 59|3@1+ (1,0) [0|0] "" Vector__XXX
 SG_ DAS_sw072_handlePress m72 : 59|1@1+ (1,0) [0|0] "" Vector__XXX
 SG_ DAS_sw060_overrideSteer m60 : 59|1@1+ (1,0) [0|0] "" Vector__XXX
 SG_ DAS_sw053_a57dimodValidity m53 : 59|1@1+ (1,0) [0|0] "" Vector__XXX
 SG_ DAS_sw050_overrideBrake m50 : 59|1@1+ (1,0) [0|0] "" Vector__XXX
 SG_ DAS_sw027_SWD m27 : 59|1@1+ (1,0) [0|0] "" Vector__XXX
 SG_ DAS_sw016_overrideBrake m16 : 59|1@1+ (1,0) [0|0] "" Vector__XXX
 SG_ DAS_sw004_FoggyLights m4 : 59|1@1+ (1,0) [0|0] "" Vector__XXX
 SG_ DAS_sw085_freeSpaceC0Right m85 : 58|5@1+ (1,-15) [0|0] "" Vector__XXX
 SG_ DAS_sw076_overrideBlinker m76 : 58|1@1+ (1,0) [0|0] "" Vector__XXX
 SG_ DAS_sw072_guidanceTimer m72 : 58|1@1+ (1,0) [0|0] "" Vector__XXX
 SG_ DAS_sw060_overrideBrake m60 : 58|1@1+ (1,0) [0|0] "" Vector__XXX
 SG_ DAS_sw053_a56bcmodValidity m53 : 58|1@1+ (1,0) [0|0] "" Vector__XXX
 SG_ DAS_sw050_overrideBlinker m50 : 58|1@1+ (1,0) [0|0] "" Vector__XXX
 SG_ DAS_sw047_unused m47 : 58|6@1+ (1,0) [0|0] "" Vector__XXX
 SG_ DAS_sw027_EVR33 m27 : 58|1@1+ (1,0) [0|0] "" Vector__XXX
 SG_ DAS_sw016_overrideBlinker m16 : 58|1@1+ (1,0) [0|0] "" Vector__XXX
 SG_ DAS_sw006_timeOfDay m6 : 58|2@1+ (1,0) [0|0] "" Vector__XXX
 SG_ DAS_sw004_SmearedHalos m4 : 58|1@1+ (1,0) [0|0] "" Vector__XXX
 SG_ DAS_sw103_constArea m103 : 57|2@1+ (1,0) [0|0] "" Vector__XXX
 SG_ DAS_sw076_overrideAccelPed m76 : 57|1@1+ (1,0) [0|0] "" Vector__XXX
 SG_ DAS_sw072_guidanceRunaway m72 : 57|1@1+ (1,0) [0|0] "" Vector__XXX
 SG_ DAS_sw060_overrideBlinker m60 : 57|1@1+ (1,0) [0|0] "" Vector__XXX
 SG_ DAS_sw053_a55stwmodValidity m53 : 57|1@1+ (1,0) [0|0] "" Vector__XXX
 SG_ DAS_sw050_aebEnable m50 : 57|1@1+ (1,0) [0|0] "" Vector__XXX
 SG_ DAS_sw027_EVR13 m27 : 57|1@1+ (1,0) [0|0] "" Vector__XXX
 SG_ DAS_sw026_veh_mean_utilization m26 : 57|7@1+ (1,0) [0|0] "" Vector__XXX
 SG_ DAS_sw016_overrideAccelPed m16 : 57|1@1+ (1,0) [0|0] "" Vector__XXX
 SG_ DAS_sw006_trailerMode m6 : 57|1@1+ (1,0) [0|0] "" Vector__XXX
 SG_ DAS_sw004_FullBlockage m4 : 57|1@1+ (1,0) [0|0] "" Vector__XXX
 SG_ DAS_sw205_rrRightMiddle m205 : 56|8@1+ (1,0) [0|0] "" Vector__XXX
 SG_ DAS_sw204_maxSpeed m204 : 56|8@1+ (0.1,-12.2) [0|0] "" Vector__XXX
 SG_ DAS_sw103_ipsoApproved m103 : 56|1@1+ (1,0) [0|0] "" Vector__XXX
 SG_ DAS_sw086_roadClass m86 : 56|3@1+ (1,0) [0|0] "" Vector__XXX
 SG_ DAS_sw078_radarTarg1_VxRel m78 : 56|8@1+ (0.2,-25.6) [0|0] "" Vector__XXX
 SG_ DAS_sw076_driverPressedBrakePed m76 : 56|1@1+ (1,0) [0|0] "" Vector__XXX
 SG_ DAS_sw073_freespaceLeftFarZ m73 : 56|4@1+ (4,0) [0|0] "" Vector__XXX
 SG_ DAS_sw072_guidanceComplete m72 : 56|1@1+ (1,0) [0|0] "" Vector__XXX
 SG_ DAS_sw071_activationType m71 : 56|2@1+ (1,0) [0|0] "" Vector__XXX
 SG_ DAS_sw067_offsetEstimator m67 : 56|8@1+ (0.1,-12.8) [0|0] "" Vector__XXX
 SG_ DAS_sw063_detectedSubMinorVer m63 : 56|8@1+ (1,0) [0|0] "" Vector__XXX
 SG_ DAS_sw060_overrideAccelPed m60 : 56|1@1+ (1,0) [0|0] "" Vector__XXX
 SG_ DAS_sw053_a54gtwmodValidity m53 : 56|1@1+ (1,0) [0|0] "" Vector__XXX
 SG_ DAS_sw050_driverPressedBrakePed m50 : 56|1@1+ (1,0) [0|0] "" Vector__XXX
 SG_ DAS_sw047_edrLoggerBuffer m47 : 56|2@1+ (1,0) [0|0] "" Vector__XXX
 SG_ DAS_sw042_road_class m42 : 56|3@1+ (1,0) [0|0] "" Vector__XXX
 SG_ DAS_sw040_view_range m40 : 56|8@1+ (1,0) [0|0] "" Vector__XXX
 SG_ DAS_sw027_CBS_APP m27 : 56|1@1+ (1,0) [0|0] "" Vector__XXX
 SG_ DAS_sw016_driverPressedBrakePed m16 : 56|1@1+ (1,0) [0|0] "" Vector__XXX
 SG_ DAS_sw015_NarrowCameraBadAssoc m15 : 56|2@1+ (1,0) [0|0] "" Vector__XXX
 SG_ DAS_sw011_laneWidth m11 : 56|8@1+ (0.025,0) [0|0] "" Vector__XXX
 SG_ DAS_sw006_brakeLights m6 : 56|1@1+ (1,0) [0|0] "" Vector__XXX
 SG_ DAS_sw004_AutofixOutOfCalibYaw m4 : 56|1@1+ (1,0) [0|0] "" Vector__XXX
 SG_ DAS_sw076_driverPressedAccelPed m76 : 55|1@1+ (1,0) [0|0] "" Vector__XXX
 SG_ DAS_sw060_driverPressedBrakePed m60 : 55|1@1+ (1,0) [0|0] "" Vector__XXX
 SG_ DAS_sw053_a53espmodValidity m53 : 55|1@1+ (1,0) [0|0] "" Vector__XXX
 SG_ DAS_sw050_driverPressedAccelPed m50 : 55|1@1+ (1,0) [0|0] "" Vector__XXX
 SG_ DAS_sw042_controlled_access m42 : 55|1@1+ (1,0) [0|0] "" Vector__XXX
 SG_ DAS_sw027_CBS_DEBUG m27 : 55|1@1+ (1,0) [0|0] "" Vector__XXX
 SG_ DAS_sw016_driverPressedAccelPed m16 : 55|1@1+ (1,0) [0|0] "" Vector__XXX
 SG_ DAS_sw006_DIaebStateUnavailable m6 : 55|1@1+ (1,0) [0|0] "" Vector__XXX
 SG_ DAS_sw004_AutofixOutOfCalibHorzn m4 : 55|1@1+ (1,0) [0|0] "" Vector__XXX
 SG_ DAS_sw231_egoVehicleSpeed m231 : 54|5@1+ (5,0) [0|0] "" Vector__XXX
 SG_ DAS_sw086_mcvrValid m86 : 54|1@1+ (1,0) [0|0] "" Vector__XXX
 SG_ DAS_sw083_Targ5_wObj m83 : 54|5@1+ (0.03125,0) [0|0] "" Vector__XXX
 SG_ DAS_sw077_oocOffCourseDist_cm m77 : 54|10@1- (1,0) [0|0] "" Vector__XXX
 SG_ DAS_sw074_ipsowExist m74 : 54|5@1+ (1,0) [0|0] "" Vector__XXX
 SG_ DAS_sw069_drivingLaneRight m69 : 54|8@1+ (1,0) [0|0] "" Vector__XXX
 SG_ DAS_sw053_a51yawSanity m53 : 54|1@1+ (1,0) [0|0] "" Vector__XXX
 SG_ DAS_sw042_road_match m42 : 54|1@1+ (1,0) [0|0] "" Vector__XXX
 SG_ DAS_sw027_CBS_SYSTEM m27 : 54|1@1+ (1,0) [0|0] "" Vector__XXX
 SG_ DAS_sw015_MainCameraBadAssoc m15 : 54|2@1+ (1,0) [0|0] "" Vector__XXX
 SG_ DAS_sw006_DIaebState_SNA m6 : 54|1@1+ (1,0) [0|0] "" Vector__XXX
 SG_ DAS_sw004_AutofixOutOfCalib m4 : 54|1@1+ (1,0) [0|0] "" Vector__XXX
 SG_ DAS_sw231_targetIsACar m231 : 53|1@1+ (1,0) [0|0] "" Vector__XXX
 SG_ DAS_sw199_maxSpeed m199 : 53|7@1+ (0.2,-12.2) [0|0] "" Vector__XXX
 SG_ DAS_sw086_mcvlValid m86 : 53|1@1+ (1,0) [0|0] "" Vector__XXX
 SG_ DAS_sw085_freeSpaceC0Left m85 : 53|5@1+ (1,-15) [0|0] "" Vector__XXX
 SG_ DAS_sw080_cruise_speed_check m80 : 53|1@1+ (1,0) [0|0] "" Vector__XXX
 SG_ DAS_sw053_a50velocitySanity m53 : 53|1@1+ (1,0) [0|0] "" Vector__XXX
 SG_ DAS_sw042_cam_OutofFocus m42 : 53|1@1+ (1,0) [0|0] "" Vector__XXX
 SG_ DAS_sw027_STM2 m27 : 53|1@1+ (1,0) [0|0] "" Vector__XXX
 SG_ DAS_sw012_freescaleTemp m12 : 53|8@1- (1,0) [0|0] "" Vector__XXX
 SG_ DAS_sw011_scaReasonEldw m11 : 53|1@1+ (1,0) [0|0] "" Vector__XXX
 SG_ DAS_sw006_yawRate m6 : 53|1@1+ (1,0) [0|0] "" Vector__XXX
 SG_ DAS_sw004_PartialBlockage m4 : 53|1@1+ (1,0) [0|0] "" Vector__XXX
 SG_ DAS_sw203_vehicleSkew m203 : 52|12@1+ (0.002,0) [0|0] "" Vector__XXX
 SG_ DAS_sw086_cipvValid m86 : 52|1@1+ (1,0) [0|0] "" Vector__XXX
 SG_ DAS_sw053_a49tireSizeSanity m53 : 52|1@1+ (1,0) [0|0] "" Vector__XXX
 SG_ DAS_sw042_cam_SelfGlare m42 : 52|1@1+ (1,0) [0|0] "" Vector__XXX
 SG_ DAS_sw027_STM1 m27 : 52|1@1+ (1,0) [0|0] "" Vector__XXX
 SG_ DAS_sw015_NarrowCameraLowLight m15 : 52|2@1+ (1,0) [0|0] "" Vector__XXX
 SG_ DAS_sw011_egoCentered m11 : 52|1@1+ (1,0) [0|0] "" Vector__XXX
 SG_ DAS_sw006_longAccel m6 : 52|1@1+ (1,0) [0|0] "" Vector__XXX
 SG_ DAS_sw004_SmearedSpots m4 : 52|1@1+ (1,0) [0|0] "" Vector__XXX
 SG_ DAS_sw086_activeBraking m86 : 51|1@1+ (1,0) [0|0] "" Vector__XXX
 SG_ DAS_sw060_RadarAssociationAge m60 : 51|4@1+ (100,0) [0|0] "" Vector__XXX
 SG_ DAS_sw053_a48steerAngOffSanity m53 : 51|1@1+ (1,0) [0|0] "" Vector__XXX
 SG_ DAS_sw042_cam_FoggySpots m42 : 51|1@1+ (1,0) [0|0] "" Vector__XXX
 SG_ DAS_sw027_STM0 m27 : 51|1@1+ (1,0) [0|0] "" Vector__XXX
 SG_ DAS_sw011_polyValid m11 : 51|1@1+ (1,0) [0|0] "" Vector__XXX
 SG_ DAS_sw006_camFcwPcwMsg m6 : 51|1@1+ (1,0) [0|0] "" Vector__XXX
 SG_ DAS_sw004_LowSun m4 : 51|1@1+ (1,0) [0|0] "" Vector__XXX
 SG_ DAS_sw080_cruise_lever_state m80 : 50|3@1+ (1,0) [0|0] "" Vector__XXX
 SG_ DAS_sw053_a44yawValidity m53 : 50|1@1+ (1,0) [0|0] "" Vector__XXX
 SG_ DAS_sw042_cam_SmearedHalos m42 : 50|1@1+ (1,0) [0|0] "" Vector__XXX
 SG_ DAS_sw027_SW m27 : 50|1@1+ (1,0) [0|0] "" Vector__XXX
 SG_ DAS_sw026_mob_mean_utilization m26 : 50|7@1+ (1,0) [0|0] "" Vector__XXX
 SG_ DAS_sw015_MainCameraLowLight m15 : 50|2@1+ (1,0) [0|0] "" Vector__XXX
 SG_ DAS_sw012_mespDDRTempStatus m12 : 50|3@1+ (1,0) [0|0] "" Vector__XXX
 SG_ DAS_sw011_egoMovingLeft m11 : 50|1@1+ (1,0) [0|0] "" Vector__XXX
 SG_ DAS_sw006_camCommonMsg m6 : 50|1@1+ (1,0) [0|0] "" Vector__XXX
 SG_ DAS_sw004_BlurredImage m4 : 50|1@1+ (1,0) [0|0] "" Vector__XXX
 SG_ DAS_sw199_internalState m199 : 49|4@1+ (1,0) [0|0] "" Vector__XXX
 SG_ DAS_sw080_min_speed_check m80 : 49|1@1+ (1,0) [0|0] "" Vector__XXX
 SG_ DAS_sw053_a43yawOffValidity m53 : 49|1@1+ (1,0) [0|0] "" Vector__XXX
 SG_ DAS_sw042_cam_FullBlock m42 : 49|1@1+ (1,0) [0|0] "" Vector__XXX
 SG_ DAS_sw027_ESR1 m27 : 49|1@1+ (1,0) [0|0] "" Vector__XXX
 SG_ DAS_sw011_egoLeftOfCenter m11 : 49|1@1+ (1,0) [0|0] "" Vector__XXX
 SG_ DAS_sw006_camObjHeader m6 : 49|1@1+ (1,0) [0|0] "" Vector__XXX
 SG_ DAS_sw004_Splashes m4 : 49|1@1+ (1,0) [0|0] "" Vector__XXX
 SG_ DAS_sw205_rrRight m205 : 48|8@1+ (1,0) [0|0] "" Vector__XXX
 SG_ DAS_sw204_frRightMiddle m204 : 48|8@1+ (1,0) [0|0] "" Vector__XXX
 SG_ DAS_sw201_viewRangeOAL m201 : 48|3@1+ (1,0) [0|0] "" Vector__XXX
 SG_ DAS_sw194_timeInHold m194 : 48|16@1+ (1,0) [0|0] "" Vector__XXX
 SG_ DAS_sw103_distanceEllipse m103 : 48|8@1+ (0.5,0) [0|0] "" Vector__XXX
 SG_ DAS_sw086_ellipseAge m86 : 48|3@1+ (1,0) [0|0] "" Vector__XXX
 SG_ DAS_sw083_Targ5_dz m83 : 48|6@1+ (0.25,-5) [0|0] "" Vector__XXX
 SG_ DAS_sw082_road_class m82 : 48|3@1+ (1,0) [0|0] "" Vector__XXX
 SG_ DAS_sw081_pedalPosition m81 : 48|7@1+ (1,0) [0|0] "" Vector__XXX
 SG_ DAS_sw080_cipv_valid m80 : 48|1@1+ (1,0) [0|0] "" Vector__XXX
 SG_ DAS_sw078_radarTarg1_dx m78 : 48|8@1+ (0.0625,0) [0|0] "" Vector__XXX
 SG_ DAS_sw077_oocUntrackedTime m77 : 48|6@1+ (0.1,0) [0|0] "" Vector__XXX
 SG_ DAS_sw076_hostLongAccel m76 : 48|7@1+ (0.15625,-10) [0|0] "" Vector__XXX
 SG_ DAS_sw075_unusedW1 m75 : 48|16@1+ (1,0) [0|0] "" Vector__XXX
 SG_ DAS_sw074_ipsoConfidence m74 : 48|6@1+ (2,0) [0|0] "" Vector__XXX
 SG_ DAS_sw073_freespaceRightC1 m73 : 48|8@1+ (0.0016,-0.2) [0|0] "" Vector__XXX
 SG_ DAS_sw072_endDistance m72 : 48|8@1+ (1,0) [0|0] "" Vector__XXX
 SG_ DAS_sw071_temperature m71 : 48|8@1+ (0.5,-40) [0|0] "" Vector__XXX
 SG_ DAS_sw066_unusedW1 m66 : 48|16@1+ (1,0) [0|0] "" Vector__XXX
 SG_ DAS_sw065_unusedW1 m65 : 48|16@1+ (1,0) [0|0] "" Vector__XXX
 SG_ DAS_sw063_expectedSubMinorVer m63 : 48|8@1+ (1,0) [0|0] "" Vector__XXX
 SG_ DAS_sw062_VmaPlausibility m62 : 48|16@1+ (1.52587890625005e-05,0) [0|0] "" Vector__XXX
 SG_ DAS_sw061_unusedW1 m61 : 48|16@1+ (1,0) [0|0] "" Vector__XXX
 SG_ DAS_sw059_unusedW1 m59 : 48|16@1+ (1,0) [0|0] "" Vector__XXX
 SG_ DAS_sw058_unusedW1 m58 : 48|16@1+ (1,0) [0|0] "" Vector__XXX
 SG_ DAS_sw056_unusedW1 m56 : 48|16@1+ (1,0) [0|0] "" Vector__XXX
 SG_ DAS_sw055_expectedCrcLsw m55 : 48|16@1+ (1,0) [0|0] "" Vector__XXX
 SG_ DAS_sw054_unusedW0 m54 : 48|16@1+ (1,0) [0|0] "" Vector__XXX
 SG_ DAS_sw053_a42xwdValidity m53 : 48|1@1+ (1,0) [0|0] "" Vector__XXX
 SG_ DAS_sw051_unusedW1 m51 : 48|16@1+ (1,0) [0|0] "" Vector__XXX
 SG_ DAS_sw050_hostLongAccel m50 : 48|7@1+ (0.15625,-10) [0|0] "" Vector__XXX
 SG_ DAS_sw049_ffs_version_msw m49 : 48|16@1+ (1,0) [0|0] "" Vector__XXX
 SG_ DAS_sw047_edrStateMachine m47 : 48|8@1+ (1,0) [0|0] "" Vector__XXX
 SG_ DAS_sw045_unusedW1 m45 : 48|16@1+ (1,0) [0|0] "" Vector__XXX
 SG_ DAS_sw043_camLongRunTime_unused m43 : 48|16@1+ (1,0) [0|0] "" Vector__XXX
 SG_ DAS_sw042_cam_AutofixYaw m42 : 48|1@1+ (1,0) [0|0] "" Vector__XXX
 SG_ DAS_sw040_torsion_bar_torque m40 : 48|8@1+ (0.1,-12.8) [0|0] "" Vector__XXX
 SG_ DAS_sw039_unusedW1 m39 : 48|16@1+ (1,0) [0|0] "" Vector__XXX
 SG_ DAS_sw037_unusedW1 m37 : 48|16@1+ (1,0) [0|0] "" Vector__XXX
 SG_ DAS_sw036_unusedW1 m36 : 48|16@1+ (1,0) [0|0] "" Vector__XXX
 SG_ DAS_sw035_unusedW1 m35 : 48|16@1+ (1,0) [0|0] "" Vector__XXX
 SG_ DAS_sw034_unusedW1 m34 : 48|16@1+ (1,0) [0|0] "" Vector__XXX
 SG_ DAS_sw033_unusedW1 m33 : 48|16@1+ (1,0) [0|0] "" Vector__XXX
 SG_ DAS_sw032_errorData2 m32 : 48|16@1+ (1,0) [0|0] "" Vector__XXX
 SG_ DAS_sw031_errorData2 m31 : 48|16@1+ (1,0) [0|0] "" Vector__XXX
 SG_ DAS_sw030_unusedW1 m30 : 48|16@1+ (1,0) [0|0] "" Vector__XXX
 SG_ DAS_sw029_unusedW1 m29 : 48|16@1+ (1,0) [0|0] "" Vector__XXX
 SG_ DAS_sw028_multifrm_rx_len m28 : 48|16@1+ (1,0) [0|0] "" Vector__XXX
 SG_ DAS_sw027_ESR0 m27 : 48|1@1+ (1,0) [0|0] "" Vector__XXX
 SG_ DAS_sw025_torsionBarTorque m25 : 48|8@1+ (0.1,-12.8) [0|0] "" Vector__XXX
 SG_ DAS_sw021_unusedWord m21 : 48|16@1+ (1,0) [0|0] "" Vector__XXX
 SG_ DAS_sw020_unusedW2 m20 : 48|16@1+ (1,0) [0|0] "" Vector__XXX
 SG_ DAS_sw018_currentVoltage m18 : 48|16@1+ (1,0) [0|0] "" Vector__XXX
 SG_ DAS_sw017_highestSeqRecd m17 : 48|12@1+ (1,0) [0|0] "" Vector__XXX
 SG_ DAS_sw016_hostLongAccel m16 : 48|7@1+ (0.15625,-10) [0|0] "" Vector__XXX
 SG_ DAS_sw015_OutOfFocusImage m15 : 48|2@1+ (1,0) [0|0] "" Vector__XXX
 SG_ DAS_sw014_assertData m14 : 48|16@1+ (1,0) [0|0] "" Vector__XXX
 SG_ DAS_sw013_highestSeqRecd m13 : 48|12@1+ (1,0) [0|0] "" Vector__XXX
 SG_ DAS_sw011_egoMovingRight m11 : 48|1@1+ (1,0) [0|0] "" Vector__XXX
 SG_ DAS_sw010_VmaPlausibility m10 : 48|16@1+ (1.52587890625005e-05,0) [0|0] "" Vector__XXX
 SG_ DAS_sw006_camWatchdog m6 : 48|1@1+ (1,0) [0|0] "" Vector__XXX
 SG_ DAS_sw004_SunRay m4 : 48|1@1+ (1,0) [0|0] "" Vector__XXX
 SG_ DAS_sw085_averageSpeedHist m85 : 47|6@1+ (0.25,0) [0|0] "" Vector__XXX
 SG_ DAS_sw060_hostLongAccel m60 : 47|4@1+ (1,-7.5) [0|0] "" Vector__XXX
 SG_ DAS_sw053_a41wiperValidity m53 : 47|1@1+ (1,0) [0|0] "" Vector__XXX
 SG_ DAS_sw042_cam_AutofixHorizon m42 : 47|1@1+ (1,0) [0|0] "" Vector__XXX
 SG_ DAS_sw018_railControl m18 : 47|1@1+ (1,0) [0|0] "" Vector__XXX
 SG_ DAS_sw011_egoRightOfCenter m11 : 47|1@1+ (1,0) [0|0] "" Vector__XXX
 SG_ DAS_sw006_speedDerivative m6 : 47|1@1+ (1,0) [0|0] "" Vector__XXX
 SG_ DAS_sw004_ImpairedVD m4 : 47|1@1+ (1,0) [0|0] "" Vector__XXX
 SG_ DAS_sw069_drivingLaneLeft m69 : 46|8@1+ (1,0) [0|0] "" Vector__XXX
 SG_ DAS_sw053_a40whlStndStllValidty m53 : 46|1@1+ (1,0) [0|0] "" Vector__XXX
 SG_ DAS_sw042_cam_Autofix m42 : 46|1@1+ (1,0) [0|0] "" Vector__XXX
 SG_ DAS_sw041_unusedW2 m41 : 46|18@1+ (1,0) [0|0] "" Vector__XXX
 SG_ DAS_sw015_SelfGlare m15 : 46|2@1+ (1,0) [0|0] "" Vector__XXX
 SG_ DAS_sw010_unusedBits m10 : 46|2@1+ (1,0) [0|0] "" Vector__XXX
 SG_ DAS_sw006_dasDisabled m6 : 46|1@1+ (1,0) [0|0] "" Vector__XXX
 SG_ DAS_sw004_OutOfFocusImage m4 : 46|1@1+ (1,0) [0|0] "" Vector__XXX
 SG_ DAS_sw231_targetRelAcceleration m231 : 45|8@1+ (0.1,-12.8) [0|0] "" Vector__XXX
 SG_ DAS_sw053_a39whlSpdValidity m53 : 45|1@1+ (1,0) [0|0] "" Vector__XXX
 SG_ DAS_sw042_cam_PartialBlock m42 : 45|1@1+ (1,0) [0|0] "" Vector__XXX
 SG_ DAS_sw006_stabilityControl m6 : 45|1@1+ (1,0) [0|0] "" Vector__XXX
 SG_ DAS_sw004_RadarMisalignment m4 : 45|1@1+ (1,0) [0|0] "" Vector__XXX
 SG_ DAS_sw194_reasonForHold m194 : 44|4@1+ (1,0) [0|0] "" Vector__XXX
 SG_ DAS_sw071_airSuspension m71 : 44|3@1+ (1,0) [0|0] "" Vector__XXX
 SG_ DAS_sw067_vehSpeed m67 : 44|12@1+ (0.1,-50) [0|0] "" Vector__XXX
 SG_ DAS_sw053_a38whlRotValidity m53 : 44|1@1+ (1,0) [0|0] "" Vector__XXX
 SG_ DAS_sw042_cam_SmearedSpots m42 : 44|1@1+ (1,0) [0|0] "" Vector__XXX
 SG_ DAS_sw015_ImpairedVD m15 : 44|2@1+ (1,0) [0|0] "" Vector__XXX
 SG_ DAS_sw006_gear m6 : 44|1@1+ (1,0) [0|0] "" Vector__XXX
 SG_ DAS_sw005_RadarLowVisibility m5 : 44|1@1+ (1,0) [0|0] "" Vector__XXX
 SG_ DAS_sw004_RadarLowVisibility m4 : 44|1@1+ (1,0) [0|0] "" Vector__XXX
 SG_ DAS_sw080_ego_speed m80 : 43|5@1+ (1,0) [0|0] "" Vector__XXX
 SG_ DAS_sw071_driverPresent m71 : 43|1@1+ (1,0) [0|0] "" Vector__XXX
 SG_ DAS_sw053_a37vinValidity m53 : 43|1@1+ (1,0) [0|0] "" Vector__XXX
 SG_ DAS_sw042_cam_LowSun m42 : 43|1@1+ (1,0) [0|0] "" Vector__XXX
 SG_ DAS_sw026_uds_mean_utilization m26 : 43|7@1+ (1,0) [0|0] "" Vector__XXX
 SG_ DAS_sw006_speed m6 : 43|1@1+ (1,0) [0|0] "" Vector__XXX
 SG_ DAS_sw005_AutofixOutOfCalibHorzn m5 : 43|1@1+ (1,0) [0|0] "" Vector__XXX
 SG_ DAS_sw004_CamWatchdog m4 : 43|1@1+ (1,0) [0|0] "" Vector__XXX
 SG_ DAS_sw069_roadClass m69 : 42|4@1+ (1,0) [0|0] "" Vector__XXX
 SG_ DAS_sw062_unusedBits m62 : 42|6@1+ (1,0) [0|0] "" Vector__XXX
 SG_ DAS_sw053_a36vehStndStllValidty m53 : 42|1@1+ (1,0) [0|0] "" Vector__XXX
 SG_ DAS_sw042_cam_BlurredImage m42 : 42|1@1+ (1,0) [0|0] "" Vector__XXX
 SG_ DAS_sw015_SunRay m15 : 42|2@1+ (1,0) [0|0] "" Vector__XXX
 SG_ DAS_sw012_mespFatalErrDetails m12 : 42|8@1+ (1,0) [0|0] "" Vector__XXX
 SG_ DAS_sw006_steeringAngleRate m6 : 42|1@1+ (1,0) [0|0] "" Vector__XXX
 SG_ DAS_sw005_camWatchdog m5 : 42|1@1+ (1,0) [0|0] "" Vector__XXX
 SG_ DAS_sw004_CamObjectsMIA m4 : 42|1@1+ (1,0) [0|0] "" Vector__XXX
 SG_ DAS_sw203_startDistance m203 : 41|11@1+ (1,0) [0|0] "" Vector__XXX
 SG_ DAS_sw199_currentSpeed m199 : 41|8@1+ (0.1,-12.2) [0|0] "" Vector__XXX
 SG_ DAS_sw085_rightLaneExist m85 : 41|6@1+ (2,0) [0|0] "" Vector__XXX
 SG_ DAS_sw053_a35indctrValidity m53 : 41|1@1+ (1,0) [0|0] "" Vector__XXX
 SG_ DAS_sw042_cam_RoadSpray m42 : 41|1@1+ (1,0) [0|0] "" Vector__XXX
 SG_ DAS_sw006_steeringAngle m6 : 41|1@1+ (1,0) [0|0] "" Vector__XXX
 SG_ DAS_sw005_speedDerivative m5 : 41|1@1+ (1,0) [0|0] "" Vector__XXX
 SG_ DAS_sw004_CamCommonMIA m4 : 41|1@1+ (1,0) [0|0] "" Vector__XXX
 SG_ DAS_sw227_ambientTemperature m227 : 40|8@1+ (0.5,-40) [0|0] "" Vector__XXX
 SG_ DAS_sw205_rrMiddle m205 : 40|8@1+ (1,0) [0|0] "" Vector__XXX
 SG_ DAS_sw204_frRight m204 : 40|8@1+ (1,0) [0|0] "" Vector__XXX
 SG_ DAS_sw202_vehicleSpeed m202 : 40|12@1+ (0.1,0) [0|0] "" Vector__XXX
 SG_ DAS_sw201_vehSpeed m201 : 40|8@1+ (1,0) [0|0] "" Vector__XXX
 SG_ DAS_sw195_vehicleSpeed m195 : 40|12@1+ (0.1,0) [0|0] "" Vector__XXX
 SG_ DAS_sw194_numPedstrian m194 : 40|4@1+ (1,0) [0|0] "" Vector__XXX
 SG_ DAS_sw141_temperature m141 : 40|8@1- (1,0) [0|0] "" Vector__XXX
 SG_ DAS_sw103_objectDz m103 : 40|8@1+ (0.25,-5) [0|0] "" Vector__XXX
 SG_ DAS_sw086_ellipseOverlap m86 : 40|8@1+ (0.1,-12.5) [0|0] "" Vector__XXX
 SG_ DAS_sw084_ipsoDy m84 : 40|8@1+ (0.1,-12.6) [0|0] "" Vector__XXX
 SG_ DAS_sw082_R_Lane m82 : 40|8@1+ (0.05,-6.4) [0|0] "" Vector__XXX
 SG_ DAS_sw081_cameraTTC m81 : 40|8@1+ (0.02,0) [0|0] "" Vector__XXX
 SG_ DAS_sw080_road_class m80 : 40|3@1+ (1,0) [0|0] "" Vector__XXX
 SG_ DAS_sw078_radarTarg5_VxRel m78 : 40|8@1+ (0.2,-25.6) [0|0] "" Vector__XXX
 SG_ DAS_sw076_hostSpeed m76 : 40|8@1+ (1,0) [0|0] "" Vector__XXX
 SG_ DAS_sw074_ipsoRCS m74 : 40|8@1+ (1,0) [0|0] "" Vector__XXX
 SG_ DAS_sw073_freespaceLeftC1 m73 : 40|8@1+ (0.0016,-0.2) [0|0] "" Vector__XXX
 SG_ DAS_sw071_roadClass m71 : 40|3@1+ (1,0) [0|0] "" Vector__XXX
 SG_ DAS_sw070_currentSpeed m70 : 40|12@1+ (0.1,-204.7) [0|0] "" Vector__XXX
 SG_ DAS_sw068_navigationSTW m68 : 40|14@1+ (0.1,-819.2) [0|0] "" Vector__XXX
 SG_ DAS_sw063_detectedMinorVer m63 : 40|8@1+ (1,0) [0|0] "" Vector__XXX
 SG_ DAS_sw060_hostSpeed m60 : 40|7@1+ (2,0) [0|0] "" Vector__XXX
 SG_ DAS_sw054_unusedByte m54 : 40|8@1+ (1,0) [0|0] "" Vector__XXX
 SG_ DAS_sw053_a34steerAngSpdValidity m53 : 40|1@1+ (1,0) [0|0] "" Vector__XXX
 SG_ DAS_sw051_unusedB0 m51 : 40|8@1+ (1,0) [0|0] "" Vector__XXX
 SG_ DAS_sw050_hostSpeed m50 : 40|8@1+ (1,0) [0|0] "" Vector__XXX
 SG_ DAS_sw042_cam_SunRay m42 : 40|1@1+ (1,0) [0|0] "" Vector__XXX
 SG_ DAS_sw040_epas_internal_sas m40 : 40|8@1+ (1,-128) [0|0] "" Vector__XXX
 SG_ DAS_sw027_Unused_Byte m27 : 40|8@1+ (1,0) [0|0] "" Vector__XXX
 SG_ DAS_sw025_offsetSide m25 : 40|2@1+ (1,0) [0|0] "" Vector__XXX
 SG_ DAS_sw021_currentTemperature m21 : 40|8@1- (1,0) [0|0] "" Vector__XXX
 SG_ DAS_sw017_numTransportErrors m17 : 40|8@1+ (1,0) [0|0] "" Vector__XXX
 SG_ DAS_sw016_hostSpeed m16 : 40|8@1+ (1,0) [0|0] "" Vector__XXX
 SG_ DAS_sw015_FoggyLights m15 : 40|2@1+ (1,0) [0|0] "" Vector__XXX
 SG_ DAS_sw013_numNaksReceived m13 : 40|8@1+ (1,0) [0|0] "" Vector__XXX
 SG_ DAS_sw006_brakePedal m6 : 40|1@1+ (1,0) [0|0] "" Vector__XXX
 SG_ DAS_sw005_dasDisabled m5 : 40|1@1+ (1,0) [0|0] "" Vector__XXX
 SG_ DAS_sw004_appMobileyeNotInVision m4 : 40|1@1+ (1,0) [0|0] "" Vector__XXX
 SG_ DAS_sw231_targetRelVelocity m231 : 39|6@1+ (0.5,0) [0|0] "" Vector__XXX
 SG_ DAS_sw202_sdiSystemStatus m202 : 39|1@1+ (1,0) [0|0] "" Vector__XXX
 SG_ DAS_sw195_sdiSystemStatus m195 : 39|1@1+ (1,0) [0|0] "" Vector__XXX
 SG_ DAS_sw053_a33steerAngValidity m53 : 39|1@1+ (1,0) [0|0] "" Vector__XXX
 SG_ DAS_sw027_Unused_Bit_4 m27 : 39|1@1+ (1,0) [0|0] "" Vector__XXX
 SG_ DAS_sw006_radSGUFailure m6 : 39|1@1+ (1,0) [0|0] "" Vector__XXX
 SG_ DAS_sw005_fcmSensitivity m5 : 39|1@1+ (1,0) [0|0] "" Vector__XXX
 SG_ DAS_sw004_DASFeaturesDisabled m4 : 39|1@1+ (1,0) [0|0] "" Vector__XXX
 SG_ DAS_sw053_a32gearValidity m53 : 38|1@1+ (1,0) [0|0] "" Vector__XXX
 SG_ DAS_sw027_LVD_2v7_IO m27 : 38|1@1+ (1,0) [0|0] "" Vector__XXX
 SG_ DAS_sw025_bottsDotsUsage m25 : 38|2@1+ (1,0) [0|0] "" Vector__XXX
 SG_ DAS_sw015_SmearedHalos m15 : 38|2@1+ (1,0) [0|0] "" Vector__XXX
 SG_ DAS_sw006_radSensorBlind m6 : 38|1@1+ (1,0) [0|0] "" Vector__XXX
 SG_ DAS_sw005_accelPedal m5 : 38|1@1+ (1,0) [0|0] "" Vector__XXX
 SG_ DAS_sw004_diSpeedInvalid m4 : 38|1@1+ (1,0) [0|0] "" Vector__XXX
 SG_ DAS_sw202_sdiSystemNoise m202 : 37|2@1+ (1,0) [0|0] "" Vector__XXX
 SG_ DAS_sw195_sdiSystemNoise m195 : 37|2@1+ (1,0) [0|0] "" Vector__XXX
 SG_ DAS_sw077_vehicleSpeed m77 : 37|10@1+ (0.05,-25) [0|0] "" Vector__XXX
 SG_ DAS_sw053_a31odoValidity m53 : 37|1@1+ (1,0) [0|0] "" Vector__XXX
 SG_ DAS_sw027_LVD_2v7_Flash m27 : 37|1@1+ (1,0) [0|0] "" Vector__XXX
 SG_ DAS_sw011_scaSteerAngle m11 : 37|10@1+ (0.1,-51.2) [0|0] "" Vector__XXX
 SG_ DAS_sw006_radHWFailure m6 : 37|1@1+ (1,0) [0|0] "" Vector__XXX
 SG_ DAS_sw005_longAccel m5 : 37|1@1+ (1,0) [0|0] "" Vector__XXX
 SG_ DAS_sw004_accelerationInvalid m4 : 37|1@1+ (1,0) [0|0] "" Vector__XXX
 SG_ DAS_sw194_numObstacles m194 : 36|4@1+ (1,0) [0|0] "" Vector__XXX
 SG_ DAS_sw072_vehicleHeading m72 : 36|10@1+ (0.005,-2.56) [0|0] "" Vector__XXX
 SG_ DAS_sw053_a30longAccValidity m53 : 36|1@1+ (1,0) [0|0] "" Vector__XXX
 SG_ DAS_sw042_epas_error_code m42 : 36|4@1+ (1,0) [0|0] "" Vector__XXX
 SG_ DAS_sw041_ego_speed m41 : 36|10@1+ (0.05,0) [0|0] "" Vector__XXX
 SG_ DAS_sw027_LVD_2v7_VREG m27 : 36|1@1+ (1,0) [0|0] "" Vector__XXX
 SG_ DAS_sw026_can_mean_utilization m26 : 36|7@1+ (1,0) [0|0] "" Vector__XXX
 SG_ DAS_sw025_modelUsage m25 : 36|2@1+ (1,0) [0|0] "" Vector__XXX
 SG_ DAS_sw015_SmearedSpots m15 : 36|2@1+ (1,0) [0|0] "" Vector__XXX
 SG_ DAS_sw010_VerticalMisalignment m10 : 36|10@1+ (0.087977,-45) [0|0] "" Vector__XXX
 SG_ DAS_sw006_radMia m6 : 36|1@1+ (1,0) [0|0] "" Vector__XXX
 SG_ DAS_sw005_yaw m5 : 36|1@1+ (1,0) [0|0] "" Vector__XXX
 SG_ DAS_sw004_stwAngleInvalid m4 : 36|1@1+ (1,0) [0|0] "" Vector__XXX
 SG_ DAS_sw085_leftLaneExist m85 : 35|6@1+ (2,0) [0|0] "" Vector__XXX
 SG_ DAS_sw077_oocHeight m77 : 35|2@1+ (1,0) [0|0] "" Vector__XXX
 SG_ DAS_sw053_a29longAccOffValidity m53 : 35|1@1+ (1,0) [0|0] "" Vector__XXX
 SG_ DAS_sw027_Unused_Bit_3 m27 : 35|1@1+ (1,0) [0|0] "" Vector__XXX
 SG_ DAS_sw006_accelPedal m6 : 35|1@1+ (1,0) [0|0] "" Vector__XXX
 SG_ DAS_sw005_blinkers m5 : 35|1@1+ (1,0) [0|0] "" Vector__XXX
 SG_ DAS_sw004_accelPedalInvalid m4 : 35|1@1+ (1,0) [0|0] "" Vector__XXX
 SG_ DAS_sw181_rRepeatCamExtYawCal m181 : 34|9@1- (0.05,0) [0|0] "" Vector__XXX
 SG_ DAS_sw180_lRepeatCamExtYawCal m180 : 34|9@1- (0.05,0) [0|0] "" Vector__XXX
 SG_ DAS_sw179_rPillarCamExtYawCal m179 : 34|9@1- (0.05,0) [0|0] "" Vector__XXX
 SG_ DAS_sw178_lPillarCamExtYawCal m178 : 34|9@1- (0.05,0) [0|0] "" Vector__XXX
 SG_ DAS_sw177_fisheyeCamExtYawCal m177 : 34|9@1- (0.05,0) [0|0] "" Vector__XXX
 SG_ DAS_sw142_problemCamPosition m142 : 34|4@1+ (1,0) [0|0] "" Vector__XXX
 SG_ DAS_sw132_narrowCamExtYawCal m132 : 34|9@1- (0.05,0) [0|0] "" Vector__XXX
 SG_ DAS_sw131_mainCamExtYawCal m131 : 34|9@1- (0.05,0) [0|0] "" Vector__XXX
 SG_ DAS_sw076_targetOverlap m76 : 34|6@1+ (0.1,0) [0|0] "" Vector__XXX
 SG_ DAS_sw060_targetOverlap m60 : 34|6@1+ (0.1,0) [0|0] "" Vector__XXX
 SG_ DAS_sw053_a28espValidity m53 : 34|1@1+ (1,0) [0|0] "" Vector__XXX
 SG_ DAS_sw051_unusedBits m51 : 34|6@1+ (1,0) [0|0] "" Vector__XXX
 SG_ DAS_sw050_targetOverlap m50 : 34|6@1+ (0.1,0) [0|0] "" Vector__XXX
 SG_ DAS_sw027_Watchdog m27 : 34|1@1+ (1,0) [0|0] "" Vector__XXX
 SG_ DAS_sw025_navigationUsage m25 : 34|2@1+ (1,0) [0|0] "" Vector__XXX
 SG_ DAS_sw016_targetOverlap m16 : 34|6@1+ (0.1,0) [0|0] "" Vector__XXX
 SG_ DAS_sw015_Splashes m15 : 34|2@1+ (1,0) [0|0] "" Vector__XXX
 SG_ DAS_sw012_mespFatalErrCode m12 : 34|8@1+ (1,0) [0|0] "" Vector__XXX
 SG_ DAS_sw006_seatbelt m6 : 34|1@1+ (1,0) [0|0] "" Vector__XXX
 SG_ DAS_sw005_stabilityControl m5 : 34|1@1+ (1,0) [0|0] "" Vector__XXX
 SG_ DAS_sw004_diMIA m4 : 34|1@1+ (1,0) [0|0] "" Vector__XXX
 SG_ DAS_sw203_slotSizeY m203 : 33|8@1+ (4,0) [0|0] "" Vector__XXX
 SG_ DAS_sw073_freespaceRightC0 m73 : 33|7@1+ (0.2,-12.8) [0|0] "" Vector__XXX
 SG_ DAS_sw053_a27CntryCdValidity m53 : 33|1@1+ (1,0) [0|0] "" Vector__XXX
 SG_ DAS_sw051_SGUFail m51 : 33|1@1+ (1,0) [0|0] "" Vector__XXX
 SG_ DAS_sw027_Unused_Bit_2 m27 : 33|1@1+ (1,0) [0|0] "" Vector__XXX
 SG_ DAS_sw006_blinkers m6 : 33|1@1+ (1,0) [0|0] "" Vector__XXX
 SG_ DAS_sw005_gear m5 : 33|1@1+ (1,0) [0|0] "" Vector__XXX
 SG_ DAS_sw004_diCruiseStateFault m4 : 33|1@1+ (1,0) [0|0] "" Vector__XXX
 SG_ DAS_sw231_targetDistance m231 : 32|7@1+ (0.1,0) [0|0] "" Vector__XXX
 SG_ DAS_sw218_pedalPosition m218 : 32|7@1+ (1,0) [0|0] "" Vector__XXX
 SG_ DAS_sw213_startSpeed m213 : 32|10@1+ (0.1,-10) [0|0] "" Vector__XXX
 SG_ DAS_sw207_lcUnavailableReason m207 : 32|8@1+ (1,0) [0|0] "" Vector__XXX
 SG_ DAS_sw205_rrLeftMiddle m205 : 32|8@1+ (1,0) [0|0] "" Vector__XXX
 SG_ DAS_sw204_frMiddle m204 : 32|8@1+ (1,0) [0|0] "" Vector__XXX
 SG_ DAS_sw202_sdiRearCC m202 : 32|5@1+ (1,0) [0|0] "" Vector__XXX
 SG_ DAS_sw201_timeHorizon m201 : 32|8@1+ (0.1,0) [0|0] "" Vector__XXX
 SG_ DAS_sw200_startSpeed m200 : 32|10@1+ (0.1,-10) [0|0] "" Vector__XXX
 SG_ DAS_sw195_sdiRearCC m195 : 32|5@1+ (1,0) [0|0] "" Vector__XXX
 SG_ DAS_sw141_tempSensorId m141 : 32|8@1+ (1,0) [0|0] "" Vector__XXX
 SG_ DAS_sw103_objectDy m103 : 32|8@1+ (0.5,-15.5) [0|0] "" Vector__XXX
 SG_ DAS_sw086_ellipseWidth m86 : 32|8@1+ (0.1,0) [0|0] "" Vector__XXX
 SG_ DAS_sw085_roadClass m85 : 32|3@1+ (1,0) [0|0] "" Vector__XXX
 SG_ DAS_sw084_ipsoDx m84 : 32|8@1+ (0.1,0) [0|0] "" Vector__XXX
 SG_ DAS_sw083_Targ5_dx m83 : 32|12@1+ (0.0625,0) [0|0] "" Vector__XXX
 SG_ DAS_sw082_L_Lane m82 : 32|8@1+ (0.05,-6.4) [0|0] "" Vector__XXX
 SG_ DAS_sw081_cameraDistance m81 : 32|8@1+ (0.0625,0) [0|0] "" Vector__XXX
 SG_ DAS_sw080_stw_angle_deg m80 : 32|8@1+ (1,0) [0|0] "" Vector__XXX
 SG_ DAS_sw078_radarTarg5_dx m78 : 32|8@1+ (0.0625,0) [0|0] "" Vector__XXX
 SG_ DAS_sw077_oocCollisionSide m77 : 32|3@1+ (1,0) [0|0] "" Vector__XXX
 SG_ DAS_sw075_unusedW0 m75 : 32|16@1+ (1,0) [0|0] "" Vector__XXX
 SG_ DAS_sw074_ipsoDz m74 : 32|6@1+ (0.2,-6.4) [0|0] "" Vector__XXX
 SG_ DAS_sw070_temperature m70 : 32|8@1+ (0.5,-40) [0|0] "" Vector__XXX
 SG_ DAS_sw066_unusedW0 m66 : 32|16@1+ (1,0) [0|0] "" Vector__XXX
 SG_ DAS_sw065_unusedW0 m65 : 32|16@1+ (1,0) [0|0] "" Vector__XXX
 SG_ DAS_sw063_expectedMinorVer m63 : 32|8@1+ (1,0) [0|0] "" Vector__XXX
 SG_ DAS_sw062_VerticalMisalignment m62 : 32|10@1+ (0.087977,-45) [0|0] "" Vector__XXX
 SG_ DAS_sw061_unusedW0 m61 : 32|16@1+ (1,0) [0|0] "" Vector__XXX
 SG_ DAS_sw059_unusedW0 m59 : 32|16@1+ (1,0) [0|0] "" Vector__XXX
 SG_ DAS_sw058_unusedW0 m58 : 32|16@1+ (1,0) [0|0] "" Vector__XXX
 SG_ DAS_sw056_unusedW0 m56 : 32|16@1+ (1,0) [0|0] "" Vector__XXX
 SG_ DAS_sw054_Autofix_yaw m54 : 32|8@1+ (1,0) [0|0] "" Vector__XXX
 SG_ DAS_sw053_a26brakeValidity m53 : 32|1@1+ (1,0) [0|0] "" Vector__XXX
 SG_ DAS_sw051_HWFail m51 : 32|1@1+ (1,0) [0|0] "" Vector__XXX
 SG_ DAS_sw049_app_version_msw m49 : 32|16@1+ (1,0) [0|0] "" Vector__XXX
 SG_ DAS_sw047_edrReturn m47 : 32|16@1+ (1,0) [0|0] "" Vector__XXX
 SG_ DAS_sw046_errorCode m46 : 32|32@1+ (1,0) [0|0] "" Vector__XXX
 SG_ DAS_sw045_unusedW0 m45 : 32|16@1+ (1,0) [0|0] "" Vector__XXX
 SG_ DAS_sw044_timestampms m44 : 32|32@1+ (1,0) [0|0] "" Vector__XXX
 SG_ DAS_sw043_mesp_health_main_state m43 : 32|16@1+ (1,0) [0|0] "" Vector__XXX
 SG_ DAS_sw042_state_before_abort m42 : 32|4@1+ (1,0) [0|0] "" Vector__XXX
 SG_ DAS_sw040_das_steering_req m40 : 32|8@1+ (1,-128) [0|0] "" Vector__XXX
 SG_ DAS_sw039_unusedW0 m39 : 32|16@1+ (1,0) [0|0] "" Vector__XXX
 SG_ DAS_sw037_unusedW0 m37 : 32|16@1+ (1,0) [0|0] "" Vector__XXX
 SG_ DAS_sw036_unusedW0 m36 : 32|16@1+ (1,0) [0|0] "" Vector__XXX
 SG_ DAS_sw035_unusedW0 m35 : 32|16@1+ (1,0) [0|0] "" Vector__XXX
 SG_ DAS_sw034_unusedW0 m34 : 32|16@1+ (1,0) [0|0] "" Vector__XXX
 SG_ DAS_sw033_unusedW0 m33 : 32|16@1+ (1,0) [0|0] "" Vector__XXX
 SG_ DAS_sw032_errorData1 m32 : 32|16@1+ (1,0) [0|0] "" Vector__XXX
 SG_ DAS_sw031_errorData1 m31 : 32|16@1+ (1,0) [0|0] "" Vector__XXX
 SG_ DAS_sw030_unusedW0 m30 : 32|16@1+ (1,0) [0|0] "" Vector__XXX
 SG_ DAS_sw029_highestSeqRcvd m29 : 32|16@1+ (1,0) [0|0] "" Vector__XXX
 SG_ DAS_sw028_highestSeqRcvd m28 : 32|16@1+ (1,0) [0|0] "" Vector__XXX
 SG_ DAS_sw027_LVD_1v2 m27 : 32|1@1+ (1,0) [0|0] "" Vector__XXX
 SG_ DAS_sw025_hppUsage m25 : 32|2@1+ (1,0) [0|0] "" Vector__XXX
 SG_ DAS_sw024_taskProgramCounter m24 : 32|32@1+ (1,0) [0|0] "" Vector__XXX
 SG_ DAS_sw022_errorCode m22 : 32|32@1+ (1,0) [0|0] "" Vector__XXX
 SG_ DAS_sw021_maxThreshold m21 : 32|8@1- (1,0) [0|0] "" Vector__XXX
 SG_ DAS_sw020_unusedW1 m20 : 32|16@1+ (1,0) [0|0] "" Vector__XXX
 SG_ DAS_sw019_timeStamp m19 : 32|32@1+ (1,0) [0|0] "" Vector__XXX
 SG_ DAS_sw018_maxThreshold m18 : 32|15@1+ (1,50) [0|0] "" Vector__XXX
 SG_ DAS_sw017_numSeqErrors m17 : 32|8@1+ (1,0) [0|0] "" Vector__XXX
 SG_ DAS_sw015_AutofixOOfCalibHorizon m15 : 32|2@1+ (1,0) [0|0] "" Vector__XXX
 SG_ DAS_sw014_lineNumberInCode m14 : 32|16@1+ (1,0) [0|0] "" Vector__XXX
 SG_ DAS_sw013_numSeqErrors m13 : 32|8@1+ (1,0) [0|0] "" Vector__XXX
 SG_ DAS_sw012_bootDDRTempStatus m12 : 32|2@1+ (1,0) [0|0] "" Vector__XXX
 SG_ DAS_sw011_scaSonicDist m11 : 32|5@1+ (0.05,0) [0|0] "" Vector__XXX
 SG_ DAS_sw006_SelfGlare m6 : 32|1@1+ (1,0) [0|0] "" Vector__XXX
 SG_ DAS_sw005_speed m5 : 32|1@1+ (1,0) [0|0] "" Vector__XXX
 SG_ DAS_sw213_epasHandsOnDetected m213 : 31|1@1+ (1,0) [0|0] "" Vector__XXX
 SG_ DAS_sw200_epasHandsOnDetected m200 : 31|1@1+ (1,0) [0|0] "" Vector__XXX
 SG_ DAS_sw053_a25ambTValidity m53 : 31|1@1+ (1,0) [0|0] "" Vector__XXX
 SG_ DAS_sw018_powerSequnceError m18 : 31|1@1+ (1,0) [0|0] "" Vector__XXX
 SG_ DAS_sw006_FoggyLights m6 : 31|1@1+ (1,0) [0|0] "" Vector__XXX
 SG_ DAS_sw005_steeringAngleRate m5 : 31|1@1+ (1,0) [0|0] "" Vector__XXX
 SG_ DAS_sw227_sensorMeasurement m227 : 30|9@1+ (1,0) [0|0] "" Vector__XXX
 SG_ DAS_sw194_leadVx m194 : 30|6@1- (0.2,0) [0|0] "" Vector__XXX
 SG_ DAS_sw071_endPosY m71 : 30|10@1+ (0.05,-25.6) [0|0] "" Vector__XXX
 SG_ DAS_sw069_torsionBar m69 : 30|12@1+ (0.01,-20.5) [0|0] "" Vector__XXX
 SG_ DAS_sw067_epasSTW m67 : 30|14@1+ (0.1,-819.2) [0|0] "" Vector__XXX
 SG_ DAS_sw053_a24absValidity m53 : 30|1@1+ (1,0) [0|0] "" Vector__XXX
 SG_ DAS_sw048_uiMiaAtBootup m48 : 30|1@1+ (1,0) [0|0] "" Vector__XXX
 SG_ DAS_sw047_edrBlackBox m47 : 30|2@1+ (1,0) [0|0] "" Vector__XXX
 SG_ DAS_sw015_AutofixOutOfCalibYaw m15 : 30|2@1+ (1,0) [0|0] "" Vector__XXX
 SG_ DAS_sw006_SmearedHalos m6 : 30|1@1+ (1,0) [0|0] "" Vector__XXX
 SG_ DAS_sw005_steeringAngle m5 : 30|1@1+ (1,0) [0|0] "" Vector__XXX
 SG_ DAS_sw218_mcuAutosteerRestricted m218 : 29|1@1+ (1,0) [0|0] "" Vector__XXX
 SG_ DAS_sw069_parkCal m69 : 29|1@1+ (1,0) [0|0] "" Vector__XXX
 SG_ DAS_sw053_a23sccmInvalidChkSm m53 : 29|1@1+ (1,0) [0|0] "" Vector__XXX
 SG_ DAS_sw048_prolongedUiMia m48 : 29|1@1+ (1,0) [0|0] "" Vector__XXX
 SG_ DAS_sw025_vehiclesUsage m25 : 29|2@1+ (1,0) [0|0] "" Vector__XXX
 SG_ DAS_sw018_railID m18 : 29|2@1+ (1,0) [0|0] "" Vector__XXX
 SG_ DAS_sw006_FullBlockage m6 : 29|1@1+ (1,0) [0|0] "" Vector__XXX
 SG_ DAS_sw005_brakePedal m5 : 29|1@1+ (1,0) [0|0] "" Vector__XXX
 SG_ DAS_sw140_backupCamHDMISerFault m140 : 28|1@1+ (1,0) [0|0] "" Vector__XXX
 SG_ DAS_sw070_accRail m70 : 28|1@1+ (1,0) [0|0] "" Vector__XXX
 SG_ DAS_sw053_a22sccmInvalidChkSm m53 : 28|1@1+ (1,0) [0|0] "" Vector__XXX
 SG_ DAS_sw048_parkerIssue m48 : 28|1@1+ (1,0) [0|0] "" Vector__XXX
 SG_ DAS_sw044_meMainState m44 : 28|4@1+ (1,0) [0|0] "" Vector__XXX
 SG_ DAS_sw027_Unused_Nibble m27 : 28|4@1+ (1,0) [0|0] "" Vector__XXX
 SG_ DAS_sw015_AutofixOutOfCalib m15 : 28|2@1+ (1,0) [0|0] "" Vector__XXX
 SG_ DAS_sw006_AutofixOutOfCalibYaw m6 : 28|1@1+ (1,0) [0|0] "" Vector__XXX
 SG_ DAS_sw005_radCalibration m5 : 28|1@1+ (1,0) [0|0] "" Vector__XXX
 SG_ DAS_sw004_appMobileyeStatus m4 : 28|5@1+ (1,0) [0|0] "" Vector__XXX
 SG_ DAS_sw230_sensor12Blocked m230 : 27|1@1+ (1,0) [0|0] "" Vector__XXX
 SG_ DAS_sw199_currentSTW m199 : 27|14@1+ (0.1,-819.2) [0|0] "" Vector__XXX
 SG_ DAS_sw140_backupCamUARTbusFault m140 : 27|1@1+ (1,0) [0|0] "" Vector__XXX
 SG_ DAS_sw070_driveRail m70 : 27|1@1+ (1,0) [0|0] "" Vector__XXX
 SG_ DAS_sw053_a21espInvalidChkSm m53 : 27|1@1+ (1,0) [0|0] "" Vector__XXX
 SG_ DAS_sw048_camIssue m48 : 27|1@1+ (1,0) [0|0] "" Vector__XXX
 SG_ DAS_sw027_f_PLL_1_Off m27 : 27|1@1+ (1,0) [0|0] "" Vector__XXX
 SG_ DAS_sw026_execution_time m26 : 27|9@1+ (0.125,0) [0|0] "" Vector__XXX
 SG_ DAS_sw025_rightLaneUsage m25 : 27|2@1+ (1,0) [0|0] "" Vector__XXX
 SG_ DAS_sw006_AutofixOutOfCalibHorzn m6 : 27|1@1+ (1,0) [0|0] "" Vector__XXX
 SG_ DAS_sw005_radMia m5 : 27|1@1+ (1,0) [0|0] "" Vector__XXX
 SG_ DAS_sw230_sensor11Blocked m230 : 26|1@1+ (1,0) [0|0] "" Vector__XXX
 SG_ DAS_sw073_freespaceLeftC0 m73 : 26|7@1+ (0.2,-12.8) [0|0] "" Vector__XXX
 SG_ DAS_sw072_vehicleY m72 : 26|10@1+ (0.05,-25.6) [0|0] "" Vector__XXX
 SG_ DAS_sw068_virtualLaneSTW m68 : 26|14@1+ (0.1,-819.2) [0|0] "" Vector__XXX
 SG_ DAS_sw053_a20bdyInvalidChkSm m53 : 26|1@1+ (1,0) [0|0] "" Vector__XXX
 SG_ DAS_sw048_eyeQVersionMismatch m48 : 26|1@1+ (1,0) [0|0] "" Vector__XXX
 SG_ DAS_sw041_max_rate m41 : 26|10@1- (1,0) [0|0] "" Vector__XXX
 SG_ DAS_sw027_Unused_Bit_1 m27 : 26|1@1+ (1,0) [0|0] "" Vector__XXX
 SG_ DAS_sw017_numCrcErrors m17 : 26|6@1+ (1,0) [0|0] "" Vector__XXX
 SG_ DAS_sw015_PartialBlockage m15 : 26|2@1+ (1,0) [0|0] "" Vector__XXX
 SG_ DAS_sw006_AutofixOutOfCalib m6 : 26|1@1+ (1,0) [0|0] "" Vector__XXX
 SG_ DAS_sw005_radSGUFailure m5 : 26|1@1+ (1,0) [0|0] "" Vector__XXX
 SG_ DAS_sw231_predImpactVelocity m231 : 25|7@1+ (0.5,0) [0|0] "" Vector__XXX
 SG_ DAS_sw230_sensor10Blocked m230 : 25|1@1+ (1,0) [0|0] "" Vector__XXX
 SG_ DAS_sw218_handsOnState m218 : 25|4@1+ (1,0) [0|0] "" Vector__XXX
 SG_ DAS_sw203_slotSizeX m203 : 25|8@1+ (4,0) [0|0] "" Vector__XXX
 SG_ DAS_sw181_rRepeatCamExtRollCal m181 : 25|9@1- (0.05,0) [0|0] "" Vector__XXX
 SG_ DAS_sw180_lRepeatCamExtRollCal m180 : 25|9@1- (0.05,0) [0|0] "" Vector__XXX
 SG_ DAS_sw179_rPillarCamExtRollCal m179 : 25|9@1- (0.05,0) [0|0] "" Vector__XXX
 SG_ DAS_sw178_lPillarCamExtRollCal m178 : 25|9@1- (0.05,0) [0|0] "" Vector__XXX
 SG_ DAS_sw177_fisheyeCamExtRollCal m177 : 25|9@1- (0.05,0) [0|0] "" Vector__XXX
 SG_ DAS_sw142_pitchOffsetAtmptVal m142 : 25|9@1+ (1,-256) [0|0] "" Vector__XXX
 SG_ DAS_sw132_narrowCamExtRollCal m132 : 25|9@1- (0.05,0) [0|0] "" Vector__XXX
 SG_ DAS_sw131_mainCamExtRollCal m131 : 25|9@1- (0.05,0) [0|0] "" Vector__XXX
 SG_ DAS_sw077_oocConfidence m77 : 25|7@1+ (1,0) [0|0] "" Vector__XXX
 SG_ DAS_sw076_targetRelSpeed m76 : 25|9@1+ (0.0625,-31) [0|0] "" Vector__XXX
 SG_ DAS_sw069_diAPState m69 : 25|4@1+ (1,0) [0|0] "" Vector__XXX
 SG_ DAS_sw060_targetRelSpeed m60 : 25|9@1+ (0.0625,-31) [0|0] "" Vector__XXX
 SG_ DAS_sw057_phoneLocStatusMia m57 : 25|1@1+ (1,0) [0|0] "" Vector__XXX
 SG_ DAS_sw053_a19sccmInvalidCount m53 : 25|1@1+ (1,0) [0|0] "" Vector__XXX
 SG_ DAS_sw050_targetRelSpeed m50 : 25|9@1+ (0.0625,-31) [0|0] "" Vector__XXX
 SG_ DAS_sw048_radcMia m48 : 25|1@1+ (1,0) [0|0] "" Vector__XXX
 SG_ DAS_sw027_PLL_1_Failure m27 : 25|1@1+ (1,0) [0|0] "" Vector__XXX
 SG_ DAS_sw025_leftLaneUsage m25 : 25|2@1+ (1,0) [0|0] "" Vector__XXX
 SG_ DAS_sw017_Any_TFL_Msg_Recd m17 : 25|1@1+ (1,0) [0|0] "" Vector__XXX
 SG_ DAS_sw016_targetRelSpeed m16 : 25|9@1+ (0.0625,-31) [0|0] "" Vector__XXX
 SG_ DAS_sw006_PartialBlockage m6 : 25|1@1+ (1,0) [0|0] "" Vector__XXX
 SG_ DAS_sw005_radSensorBlind m5 : 25|1@1+ (1,0) [0|0] "" Vector__XXX
 SG_ DAS_sw230_sensor9Blocked m230 : 24|1@1+ (1,0) [0|0] "" Vector__XXX
 SG_ DAS_sw218_drivingOnHighway m218 : 24|1@1+ (1,0) [0|0] "" Vector__XXX
 SG_ DAS_sw207_eyeq3MainState m207 : 24|8@1+ (1,0) [0|0] "" Vector__XXX
 SG_ DAS_sw205_rrLeft m205 : 24|8@1+ (1,0) [0|0] "" Vector__XXX
 SG_ DAS_sw204_frLeftMiddle m204 : 24|8@1+ (1,0) [0|0] "" Vector__XXX
 SG_ DAS_sw202_sdiFrontCC m202 : 24|5@1+ (1,0) [0|0] "" Vector__XXX
 SG_ DAS_sw201_stwAngleReq m201 : 24|8@1- (1,0) [0|0] "" Vector__XXX
 SG_ DAS_sw195_sdiFrontCC m195 : 24|5@1+ (1,0) [0|0] "" Vector__XXX
 SG_ DAS_sw144_selfieCamSerFault m144 : 24|3@1+ (1,0) [0|0] "" Vector__XXX
 SG_ DAS_sw141_minThreshold m141 : 24|8@1- (1,0) [0|0] "" Vector__XXX
 SG_ DAS_sw140_backupCamSensorFault m140 : 24|3@1+ (1,0) [0|0] "" Vector__XXX
 SG_ DAS_sw139_rhtRptrCamSerFault m139 : 24|3@1+ (1,0) [0|0] "" Vector__XXX
 SG_ DAS_sw138_lRepeatCamSerFault m138 : 24|3@1+ (1,0) [0|0] "" Vector__XXX
 SG_ DAS_sw137_rPillarCamSerFault m137 : 24|3@1+ (1,0) [0|0] "" Vector__XXX
 SG_ DAS_sw136_lPillarCamSerFault m136 : 24|3@1+ (1,0) [0|0] "" Vector__XXX
 SG_ DAS_sw135_fisheyeCamSerFault m135 : 24|3@1+ (1,0) [0|0] "" Vector__XXX
 SG_ DAS_sw134_narrowCamSerFault m134 : 24|3@1+ (1,0) [0|0] "" Vector__XXX
 SG_ DAS_sw133_mainCamSerFault m133 : 24|3@1+ (1,0) [0|0] "" Vector__XXX
 SG_ DAS_sw103_objectRCS m103 : 24|8@1+ (1,0) [0|0] "" Vector__XXX
 SG_ DAS_sw086_distanceEllipse m86 : 24|8@1+ (0.5,0) [0|0] "" Vector__XXX
 SG_ DAS_sw085_radarTTC m85 : 24|8@1+ (0.02,0) [0|0] "" Vector__XXX
 SG_ DAS_sw084_ipsoRCS m84 : 24|8@1+ (1,0) [0|0] "" Vector__XXX
 SG_ DAS_sw082_R_VL m82 : 24|8@1+ (0.05,-6.4) [0|0] "" Vector__XXX
 SG_ DAS_sw081_radarTTC m81 : 24|8@1+ (0.02,0) [0|0] "" Vector__XXX
 SG_ DAS_sw080_rad_tar_5_dist m80 : 24|6@1+ (1,0) [0|0] "" Vector__XXX
 SG_ DAS_sw078_ttc m78 : 24|8@1+ (0.02,0) [0|0] "" Vector__XXX
 SG_ DAS_sw075_unusedByte m75 : 24|8@1+ (1,0) [0|0] "" Vector__XXX
 SG_ DAS_sw074_ipsoDy m74 : 24|6@1+ (0.1,-3.2) [0|0] "" Vector__XXX
 SG_ DAS_sw073_freespaceLDW m73 : 24|2@1+ (1,0) [0|0] "" Vector__XXX
 SG_ DAS_sw070_diGear m70 : 24|3@1+ (1,0) [0|0] "" Vector__XXX
 SG_ DAS_sw066_mobileye_main_state m66 : 24|8@1+ (1,0) [0|0] "" Vector__XXX
 SG_ DAS_sw065_mobileye_main_state m65 : 24|8@1+ (1,0) [0|0] "" Vector__XXX
 SG_ DAS_sw063_detectedMajorVer m63 : 24|8@1+ (1,0) [0|0] "" Vector__XXX
 SG_ DAS_sw061_unusedByte m61 : 24|8@1+ (1,0) [0|0] "" Vector__XXX
 SG_ DAS_sw059_unusedByte m59 : 24|8@1+ (1,0) [0|0] "" Vector__XXX
 SG_ DAS_sw058_unusedByte m58 : 24|8@1+ (1,0) [0|0] "" Vector__XXX
 SG_ DAS_sw057_telemetryControlMia m57 : 24|1@1+ (1,0) [0|0] "" Vector__XXX
 SG_ DAS_sw056_unusedByte m56 : 24|8@1+ (1,0) [0|0] "" Vector__XXX
 SG_ DAS_sw054_Autofix_horizon m54 : 24|8@1+ (1,0) [0|0] "" Vector__XXX
 SG_ DAS_sw053_a18espInvalidCount m53 : 24|1@1+ (1,0) [0|0] "" Vector__XXX
 SG_ DAS_sw051_SCUTemperature m51 : 24|8@1- (1,0) [0|0] "" Vector__XXX
 SG_ DAS_sw048_radcCalibration m48 : 24|1@1+ (1,0) [0|0] "" Vector__XXX
 SG_ DAS_sw047_edrType m47 : 24|6@1+ (1,0) [0|0] "" Vector__XXX
 SG_ DAS_sw045_unusedByte m45 : 24|8@1+ (1,0) [0|0] "" Vector__XXX
 SG_ DAS_sw044_appStatus m44 : 24|4@1+ (1,0) [0|0] "" Vector__XXX
 SG_ DAS_sw042_view_range m42 : 24|8@1+ (1,0) [0|0] "" Vector__XXX
 SG_ DAS_sw040_ego_veh_speed m40 : 24|8@1+ (0.2,0) [0|0] "" Vector__XXX
 SG_ DAS_sw039_unusedByte m39 : 24|8@1+ (1,0) [0|0] "" Vector__XXX
 SG_ DAS_sw037_issue m37 : 24|8@1+ (1,0) [0|0] "" Vector__XXX
 SG_ DAS_sw036_unusedByte m36 : 24|8@1+ (1,0) [0|0] "" Vector__XXX
 SG_ DAS_sw035_unusedByte m35 : 24|8@1+ (1,0) [0|0] "" Vector__XXX
 SG_ DAS_sw034_unusedByte m34 : 24|8@1+ (1,0) [0|0] "" Vector__XXX
 SG_ DAS_sw033_unusedByte m33 : 24|8@1+ (1,0) [0|0] "" Vector__XXX
 SG_ DAS_sw032_errorType m32 : 24|8@1+ (1,0) [0|0] "" Vector__XXX
 SG_ DAS_sw031_errorType m31 : 24|8@1+ (1,0) [0|0] "" Vector__XXX
 SG_ DAS_sw030_unusedByte m30 : 24|8@1+ (1,0) [0|0] "" Vector__XXX
 SG_ DAS_sw027_Flash_Fatal_Error m27 : 24|1@1+ (1,0) [0|0] "" Vector__XXX
 SG_ DAS_sw025_controlled_access m25 : 24|1@1+ (1,0) [0|0] "" Vector__XXX
 SG_ DAS_sw024_currentVehicleApp m24 : 24|8@1+ (1,0) [0|0] "" Vector__XXX
 SG_ DAS_sw021_minThreshold m21 : 24|8@1- (1,0) [0|0] "" Vector__XXX
 SG_ DAS_sw019_numFreeBytes m19 : 24|8@1+ (1,-191) [0|0] "" Vector__XXX
 SG_ DAS_sw017_Any_Objects_Msg_Recd m17 : 24|1@1+ (1,0) [0|0] "" Vector__XXX
 SG_ DAS_sw015_FullBlockage m15 : 24|2@1+ (1,0) [0|0] "" Vector__XXX
 SG_ DAS_sw013_numCrcErrors m13 : 24|8@1+ (1,0) [0|0] "" Vector__XXX
 SG_ DAS_sw011_scaSpeed m11 : 24|7@1+ (1,0) [0|0] "" Vector__XXX
 SG_ DAS_sw006_SmearedSpots m6 : 24|1@1+ (1,0) [0|0] "" Vector__XXX
 SG_ DAS_sw005_radHWFailure m5 : 24|1@1+ (1,0) [0|0] "" Vector__XXX
 SG_ DAS_sw004_accState m4 : 24|4@1+ (1,0) [0|0] "" Vector__XXX
 SG_ DAS_sw230_sensor8Blocked m230 : 23|1@1+ (1,0) [0|0] "" Vector__XXX
 SG_ DAS_sw080_pedestrian_check m80 : 23|1@1+ (1,0) [0|0] "" Vector__XXX
 SG_ DAS_sw057_csaOfframpCurvMia m57 : 23|1@1+ (1,0) [0|0] "" Vector__XXX
 SG_ DAS_sw053_a17adasInvalidCount m53 : 23|1@1+ (1,0) [0|0] "" Vector__XXX
 SG_ DAS_sw052_sensorBlocked m52 : 23|1@1+ (1,0) [0|0] "" Vector__XXX
 SG_ DAS_sw048_radcVersionMismatch m48 : 23|1@1+ (1,0) [0|0] "" Vector__XXX
 SG_ DAS_sw047_controlledAccess m47 : 23|1@1+ (1,0) [0|0] "" Vector__XXX
 SG_ DAS_sw027_LVD_4v5 m27 : 23|1@1+ (1,0) [0|0] "" Vector__XXX
 SG_ DAS_sw025_road_match m25 : 23|1@1+ (1,0) [0|0] "" Vector__XXX
 SG_ DAS_sw017_Any_Lanes_Msg_Recd m17 : 23|1@1+ (1,0) [0|0] "" Vector__XXX
 SG_ DAS_sw011_scaThreshold m11 : 23|1@1+ (1,0) [0|0] "" Vector__XXX
 SG_ DAS_sw006_LowSun m6 : 23|1@1+ (1,0) [0|0] "" Vector__XXX
 SG_ DAS_sw005_camFcwPcwMsg m5 : 23|1@1+ (1,0) [0|0] "" Vector__XXX
 SG_ DAS_sw230_sensor7Blocked m230 : 22|1@1+ (1,0) [0|0] "" Vector__XXX
 SG_ DAS_sw203_roadClass m203 : 22|3@1+ (1,0) [0|0] "" Vector__XXX
 SG_ DAS_sw199_abortCodePARK m199 : 22|5@1+ (1,0) [0|0] "" Vector__XXX
 SG_ DAS_sw194_leadDx m194 : 22|8@1+ (0.1,0) [0|0] "" Vector__XXX
 SG_ DAS_sw193_smearedSpots m193 : 22|1@1+ (1,0) [0|0] "" Vector__XXX
 SG_ DAS_sw140_backupCamI2CbusFault m140 : 22|1@1+ (1,0) [0|0] "" Vector__XXX
 SG_ DAS_sw080_freespace_check m80 : 22|1@1+ (1,0) [0|0] "" Vector__XXX
 SG_ DAS_sw057_csaRoadCurvMia m57 : 22|1@1+ (1,0) [0|0] "" Vector__XXX
 SG_ DAS_sw053_a16bdyInvalidCount m53 : 22|1@1+ (1,0) [0|0] "" Vector__XXX
 SG_ DAS_sw052_rspError m52 : 22|1@1+ (1,0) [0|0] "" Vector__XXX
 SG_ DAS_sw048_ecuReset m48 : 22|1@1+ (1,0) [0|0] "" Vector__XXX
 SG_ DAS_sw038_TooManyResets m38 : 22|1@1+ (1,0) [0|0] "" Vector__XXX
 SG_ DAS_sw027_Clock_Monitor_0_Off m27 : 22|1@1+ (1,0) [0|0] "" Vector__XXX
 SG_ DAS_sw017_Camera_Msg_TFL_MIA m17 : 22|1@1+ (1,0) [0|0] "" Vector__XXX
 SG_ DAS_sw015_BlurredImage m15 : 22|2@1+ (1,0) [0|0] "" Vector__XXX
 SG_ DAS_sw006_BlurredImage m6 : 22|1@1+ (1,0) [0|0] "" Vector__XXX
 SG_ DAS_sw005_camCommonMsg m5 : 22|1@1+ (1,0) [0|0] "" Vector__XXX
 SG_ DAS_sw004_espMIA m4 : 22|1@1+ (1,0) [0|0] "" Vector__XXX
 SG_ DAS_sw230_sensor6Blocked m230 : 21|1@1+ (1,0) [0|0] "" Vector__XXX
 SG_ DAS_sw213_endSpeed m213 : 21|10@1+ (0.1,-10) [0|0] "" Vector__XXX
 SG_ DAS_sw202_s12Blocked m202 : 21|1@1+ (1,0) [0|0] "" Vector__XXX
 SG_ DAS_sw200_endSpeed m200 : 21|10@1+ (0.1,-10) [0|0] "" Vector__XXX
 SG_ DAS_sw195_s12Blocked m195 : 21|1@1+ (1,0) [0|0] "" Vector__XXX
 SG_ DAS_sw193_smearedHalos m193 : 21|1@1+ (1,0) [0|0] "" Vector__XXX
 SG_ DAS_sw080_ultrasonic_obs_check m80 : 21|1@1+ (1,0) [0|0] "" Vector__XXX
 SG_ DAS_sw073_rawMobileyeLDW m73 : 21|2@1+ (1,0) [0|0] "" Vector__XXX
 SG_ DAS_sw069_eacStatus m69 : 21|4@1+ (1,0) [0|0] "" Vector__XXX
 SG_ DAS_sw057_radarMapDataMia m57 : 21|1@1+ (1,0) [0|0] "" Vector__XXX
 SG_ DAS_sw053_a15adasMIA m53 : 21|1@1+ (1,0) [0|0] "" Vector__XXX
 SG_ DAS_sw052_chirpError m52 : 21|1@1+ (1,0) [0|0] "" Vector__XXX
 SG_ DAS_sw051_unused m51 : 21|3@1+ (1,0) [0|0] "" Vector__XXX
 SG_ DAS_sw048_ecuWatchdog m48 : 21|1@1+ (1,0) [0|0] "" Vector__XXX
 SG_ DAS_sw038_FullBlockage m38 : 21|1@1+ (1,0) [0|0] "" Vector__XXX
 SG_ DAS_sw028_unusedBits m28 : 21|11@1+ (1,0) [0|0] "" Vector__XXX
 SG_ DAS_sw027_Clock_Monitor_0_Low m27 : 21|1@1+ (1,0) [0|0] "" Vector__XXX
 SG_ DAS_sw017_Camera_Msg_FCW_PCW_MIA m17 : 21|1@1+ (1,0) [0|0] "" Vector__XXX
 SG_ DAS_sw013_numEyeqResets m13 : 21|3@1+ (1,0) [0|0] "" Vector__XXX
 SG_ DAS_sw011_scaBlinker m11 : 21|2@1+ (1,0) [0|0] "" Vector__XXX
 SG_ DAS_sw006_Splashes m6 : 21|1@1+ (1,0) [0|0] "" Vector__XXX
 SG_ DAS_sw005_camObjHeader m5 : 21|1@1+ (1,0) [0|0] "" Vector__XXX
 SG_ DAS_sw004_radDynamicsError m4 : 21|1@1+ (1,0) [0|0] "" Vector__XXX
 SG_ DAS_sw230_sensor5Blocked m230 : 20|1@1+ (1,0) [0|0] "" Vector__XXX
 SG_ DAS_sw220_vehicleSpeed m220 : 20|12@1+ (0.05,-25) [0|0] "" Vector__XXX
 SG_ DAS_sw219_vehicleSpeed m219 : 20|12@1+ (0.05,-25) [0|0] "" Vector__XXX
 SG_ DAS_sw213_autopilotRestricted m213 : 20|1@1+ (1,0) [0|0] "" Vector__XXX
 SG_ DAS_sw203_curbType m203 : 20|2@1+ (1,0) [0|0] "" Vector__XXX
 SG_ DAS_sw202_s11Blocked m202 : 20|1@1+ (1,0) [0|0] "" Vector__XXX
 SG_ DAS_sw200_autopilotRestricted m200 : 20|1@1+ (1,0) [0|0] "" Vector__XXX
 SG_ DAS_sw195_s11Blocked m195 : 20|1@1+ (1,0) [0|0] "" Vector__XXX
 SG_ DAS_sw193_partialBlockage m193 : 20|1@1+ (1,0) [0|0] "" Vector__XXX
 SG_ DAS_sw144_selfieCamSensorFault m144 : 20|3@1+ (1,0) [0|0] "" Vector__XXX
 SG_ DAS_sw139_rhtRptrCamSensorFault m139 : 20|3@1+ (1,0) [0|0] "" Vector__XXX
 SG_ DAS_sw138_lRepeatCamSensorFault m138 : 20|3@1+ (1,0) [0|0] "" Vector__XXX
 SG_ DAS_sw137_rPillarCamSensorFault m137 : 20|3@1+ (1,0) [0|0] "" Vector__XXX
 SG_ DAS_sw136_lPillarCamSensorFault m136 : 20|3@1+ (1,0) [0|0] "" Vector__XXX
 SG_ DAS_sw135_fisheyeCamSensorFault m135 : 20|3@1+ (1,0) [0|0] "" Vector__XXX
 SG_ DAS_sw134_narrowCamSensorFault m134 : 20|3@1+ (1,0) [0|0] "" Vector__XXX
 SG_ DAS_sw133_mainCamSensorFault m133 : 20|3@1+ (1,0) [0|0] "" Vector__XXX
 SG_ DAS_sw080_rad_tar_5_check m80 : 20|1@1+ (1,0) [0|0] "" Vector__XXX
 SG_ DAS_sw071_endPosX m71 : 20|10@1+ (0.05,-25.6) [0|0] "" Vector__XXX
 SG_ DAS_sw069_parkMismatch m69 : 20|1@1+ (1,0) [0|0] "" Vector__XXX
 SG_ DAS_sw057_dasRoadSignMia m57 : 20|1@1+ (1,0) [0|0] "" Vector__XXX
 SG_ DAS_sw053_a14sccmMIA m53 : 20|1@1+ (1,0) [0|0] "" Vector__XXX
 SG_ DAS_sw052_underTemperature m52 : 20|1@1+ (1,0) [0|0] "" Vector__XXX
 SG_ DAS_sw051_a52radomeHtrInop m51 : 20|1@1+ (1,0) [0|0] "" Vector__XXX
 SG_ DAS_sw048_checkStop m48 : 20|1@1+ (1,0) [0|0] "" Vector__XXX
 SG_ DAS_sw047_roadClass m47 : 20|3@1+ (1,0) [0|0] "" Vector__XXX
 SG_ DAS_sw038_AutofixOutOfCalibYaw m38 : 20|1@1+ (1,0) [0|0] "" Vector__XXX
 SG_ DAS_sw028_inv_multifrm_next m28 : 20|1@1+ (1,0) [0|0] "" Vector__XXX
 SG_ DAS_sw027_PLL_0_Failure m27 : 20|1@1+ (1,0) [0|0] "" Vector__XXX
 SG_ DAS_sw025_road_class m25 : 20|3@1+ (1,0) [0|0] "" Vector__XXX
 SG_ DAS_sw024_numVirtualLaneVeh m24 : 20|4@1+ (1,0) [0|0] "" Vector__XXX
 SG_ DAS_sw022_recordId m22 : 20|12@1+ (1,0) [0|0] "" Vector__XXX
 SG_ DAS_sw017_Camera_Msg_Common_MIA m17 : 20|1@1+ (1,0) [0|0] "" Vector__XXX
 SG_ DAS_sw015_LowSun m15 : 20|2@1+ (1,0) [0|0] "" Vector__XXX
 SG_ DAS_sw011_scaRight m11 : 20|1@1+ (1,0) [0|0] "" Vector__XXX
 SG_ DAS_sw010_HorizontalMisalignment m10 : 20|16@1+ (0.00137332,-45) [0|0] "" Vector__XXX
 SG_ DAS_sw006_SunRay m6 : 20|1@1+ (1,0) [0|0] "" Vector__XXX
 SG_ DAS_sw005_fullBlockage m5 : 20|1@1+ (1,0) [0|0] "" Vector__XXX
 SG_ DAS_sw004_radMia m4 : 20|1@1+ (1,0) [0|0] "" Vector__XXX
 SG_ DAS_sw230_sensor4Blocked m230 : 19|1@1+ (1,0) [0|0] "" Vector__XXX
 SG_ DAS_sw202_s8Blocked m202 : 19|1@1+ (1,0) [0|0] "" Vector__XXX
 SG_ DAS_sw201_steeringErrorOAL m201 : 19|3@1+ (1,0) [0|0] "" Vector__XXX
 SG_ DAS_sw198_tsrMsgInvalid m198 : 19|1@1+ (1,0) [0|0] "" Vector__XXX
 SG_ DAS_sw195_s8Blocked m195 : 19|1@1+ (1,0) [0|0] "" Vector__XXX
 SG_ DAS_sw193_outOfFocusImage m193 : 19|1@1+ (1,0) [0|0] "" Vector__XXX
 SG_ DAS_sw144_selfieCamI2CbusFault m144 : 19|1@1+ (1,0) [0|0] "" Vector__XXX
 SG_ DAS_sw140_backupCamDeserFault m140 : 19|3@1+ (1,0) [0|0] "" Vector__XXX
 SG_ DAS_sw139_rhtRptrCamI2CbusFault m139 : 19|1@1+ (1,0) [0|0] "" Vector__XXX
 SG_ DAS_sw138_lRepeatCamI2CbusFault m138 : 19|1@1+ (1,0) [0|0] "" Vector__XXX
 SG_ DAS_sw137_rPillarCamI2CbusFault m137 : 19|1@1+ (1,0) [0|0] "" Vector__XXX
 SG_ DAS_sw136_lPillarCamI2CbusFault m136 : 19|1@1+ (1,0) [0|0] "" Vector__XXX
 SG_ DAS_sw135_fisheyeCamI2CbusFault m135 : 19|1@1+ (1,0) [0|0] "" Vector__XXX
 SG_ DAS_sw134_narrowCamI2CbusFault m134 : 19|1@1+ (1,0) [0|0] "" Vector__XXX
 SG_ DAS_sw133_mainCamI2CbusFault m133 : 19|1@1+ (1,0) [0|0] "" Vector__XXX
 SG_ DAS_sw080_stw_angle_check m80 : 19|1@1+ (1,0) [0|0] "" Vector__XXX
 SG_ DAS_sw070_lastTireFitment m70 : 19|3@1+ (1,0) [0|0] "" Vector__XXX
 SG_ DAS_sw069_sccmMia m69 : 19|1@1+ (1,0) [0|0] "" Vector__XXX
 SG_ DAS_sw057_gpsVehSpeedMia m57 : 19|1@1+ (1,0) [0|0] "" Vector__XXX
 SG_ DAS_sw053_a13gtwMIA m53 : 19|1@1+ (1,0) [0|0] "" Vector__XXX
 SG_ DAS_sw052_overTemperature m52 : 19|1@1+ (1,0) [0|0] "" Vector__XXX
 SG_ DAS_sw051_a09configMismatch m51 : 19|1@1+ (1,0) [0|0] "" Vector__XXX
 SG_ DAS_sw048_stackOverflow m48 : 19|1@1+ (1,0) [0|0] "" Vector__XXX
 SG_ DAS_sw042_abort_reason m42 : 19|5@1+ (1,0) [0|0] "" Vector__XXX
 SG_ DAS_sw038_AutofixOutOfCalibHorzn m38 : 19|1@1+ (1,0) [0|0] "" Vector__XXX
 SG_ DAS_sw028_inv_multifrm_id m28 : 19|1@1+ (1,0) [0|0] "" Vector__XXX
 SG_ DAS_sw027_CPU_Checkstop_Error m27 : 19|1@1+ (1,0) [0|0] "" Vector__XXX
 SG_ DAS_sw017_Camera_Msg_Hlb_MIA m17 : 19|1@1+ (1,0) [0|0] "" Vector__XXX
 SG_ DAS_sw011_scaLeft m11 : 19|1@1+ (1,0) [0|0] "" Vector__XXX
 SG_ DAS_sw010_a08PlantMode m10 : 19|1@1+ (1,0) [0|0] "" Vector__XXX
 SG_ DAS_sw006_OutOfFocusImage m6 : 19|1@1+ (1,0) [0|0] "" Vector__XXX
 SG_ DAS_sw005_partialBlockage m5 : 19|1@1+ (1,0) [0|0] "" Vector__XXX
 SG_ DAS_sw004_radSGUFailure m4 : 19|1@1+ (1,0) [0|0] "" Vector__XXX
 SG_ DAS_sw230_sensor3Blocked m230 : 18|1@1+ (1,0) [0|0] "" Vector__XXX
 SG_ DAS_sw227_vehicleSpeed m227 : 18|12@1+ (0.05,-25) [0|0] "" Vector__XXX
 SG_ DAS_sw202_s7Blocked m202 : 18|1@1+ (1,0) [0|0] "" Vector__XXX
 SG_ DAS_sw198_tflMsgInvalid m198 : 18|1@1+ (1,0) [0|0] "" Vector__XXX
 SG_ DAS_sw195_s7Blocked m195 : 18|1@1+ (1,0) [0|0] "" Vector__XXX
 SG_ DAS_sw193_impairedVD m193 : 18|1@1+ (1,0) [0|0] "" Vector__XXX
 SG_ DAS_sw080_road_class_check m80 : 18|1@1+ (1,0) [0|0] "" Vector__XXX
 SG_ DAS_sw073_escalateLDWreason m73 : 18|3@1+ (1,0) [0|0] "" Vector__XXX
 SG_ DAS_sw069_parkMia m69 : 18|1@1+ (1,0) [0|0] "" Vector__XXX
 SG_ DAS_sw057_locStatusMia m57 : 18|1@1+ (1,0) [0|0] "" Vector__XXX
 SG_ DAS_sw053_a12espMIA m53 : 18|1@1+ (1,0) [0|0] "" Vector__XXX
 SG_ DAS_sw052_HWFail m52 : 18|1@1+ (1,0) [0|0] "" Vector__XXX
 SG_ DAS_sw051_a03vBatHigh m51 : 18|1@1+ (1,0) [0|0] "" Vector__XXX
 SG_ DAS_sw048_powerIssue m48 : 18|1@1+ (1,0) [0|0] "" Vector__XXX
 SG_ DAS_sw038_AutofixOutOfCalib m38 : 18|1@1+ (1,0) [0|0] "" Vector__XXX
 SG_ DAS_sw028_inv_multifrm_1st m28 : 18|1@1+ (1,0) [0|0] "" Vector__XXX
 SG_ DAS_sw027_Unused_Bit_0 m27 : 18|1@1+ (1,0) [0|0] "" Vector__XXX
 SG_ DAS_sw026_tardiness m26 : 18|9@1+ (0.25,0) [0|0] "" Vector__XXX
 SG_ DAS_sw017_Camera_Msg_Tsr_MIA m17 : 18|1@1+ (1,0) [0|0] "" Vector__XXX
 SG_ DAS_sw015_RadarMisalignment m15 : 18|2@1+ (1,0) [0|0] "" Vector__XXX
 SG_ DAS_sw010_a06calibNotOK m10 : 18|1@1+ (1,0) [0|0] "" Vector__XXX
 SG_ DAS_sw009_DI_MIA m9 : 18|1@1+ (1,0) [0|0] "" Vector__XXX
 SG_ DAS_sw006_radCalibration m6 : 18|1@1+ (1,0) [0|0] "" Vector__XXX
 SG_ DAS_sw005_RadarMisalignment m5 : 18|1@1+ (1,0) [0|0] "" Vector__XXX
 SG_ DAS_sw004_radSensorBlind m4 : 18|1@1+ (1,0) [0|0] "" Vector__XXX
 SG_ DAS_sw230_sensor2Blocked m230 : 17|1@1+ (1,0) [0|0] "" Vector__XXX
 SG_ DAS_sw227_sensorNumber m227 : 17|1@1+ (1,0) [0|0] "" Vector__XXX
 SG_ DAS_sw220_roadClass m220 : 17|3@1+ (1,0) [0|0] "" Vector__XXX
 SG_ DAS_sw219_roadClass m219 : 17|3@1+ (1,0) [0|0] "" Vector__XXX
 SG_ DAS_sw202_s6Blocked m202 : 17|1@1+ (1,0) [0|0] "" Vector__XXX
 SG_ DAS_sw198_partialBlockage m198 : 17|1@1+ (1,0) [0|0] "" Vector__XXX
 SG_ DAS_sw195_s6Blocked m195 : 17|1@1+ (1,0) [0|0] "" Vector__XXX
 SG_ DAS_sw193_fullBlockage m193 : 17|1@1+ (1,0) [0|0] "" Vector__XXX
 SG_ DAS_sw080_dist_travelled_check m80 : 17|1@1+ (1,0) [0|0] "" Vector__XXX
 SG_ DAS_sw073_silentEscalatedLDW m73 : 17|1@1+ (1,0) [0|0] "" Vector__XXX
 SG_ DAS_sw069_espMia m69 : 17|1@1+ (1,0) [0|0] "" Vector__XXX
 SG_ DAS_sw064_status m64 : 17|1@1+ (1,0) [0|0] "" Vector__XXX
 SG_ DAS_sw057_dasMapDataMia m57 : 17|1@1+ (1,0) [0|0] "" Vector__XXX
 SG_ DAS_sw053_a11bdyMIA m53 : 17|1@1+ (1,0) [0|0] "" Vector__XXX
 SG_ DAS_sw052_sensorDirty m52 : 17|1@1+ (1,0) [0|0] "" Vector__XXX
 SG_ DAS_sw051_a02flashPerformance m51 : 17|1@1+ (1,0) [0|0] "" Vector__XXX
 SG_ DAS_sw048_thermalIssue m48 : 17|1@1+ (1,0) [0|0] "" Vector__XXX
 SG_ DAS_sw038_OutOfFocusImage m38 : 17|1@1+ (1,0) [0|0] "" Vector__XXX
 SG_ DAS_sw029_unusedBits m29 : 17|15@1+ (1,0) [0|0] "" Vector__XXX
 SG_ DAS_sw028_rx_inv_len m28 : 17|1@1+ (1,0) [0|0] "" Vector__XXX
 SG_ DAS_sw027_Core_Reset m27 : 17|1@1+ (1,0) [0|0] "" Vector__XXX
 SG_ DAS_sw017_Camera_Msg_Objects_MIA m17 : 17|1@1+ (1,0) [0|0] "" Vector__XXX
 SG_ DAS_sw010_a05calibReqd m10 : 17|1@1+ (1,0) [0|0] "" Vector__XXX
 SG_ DAS_sw009_DI_aeb_unresponsive m9 : 17|1@1+ (1,0) [0|0] "" Vector__XXX
 SG_ DAS_sw006_RadarMisaligned m6 : 17|1@1+ (1,0) [0|0] "" Vector__XXX
 SG_ DAS_sw005_AutofixOutOfCalibYaw m5 : 17|1@1+ (1,0) [0|0] "" Vector__XXX
 SG_ DAS_sw004_radHWFailure m4 : 17|1@1+ (1,0) [0|0] "" Vector__XXX
 SG_ DAS_sw231_timeToImpact m231 : 16|9@1+ (1,0) [0|0] "" Vector__XXX
 SG_ DAS_sw230_sensor1Blocked m230 : 16|1@1+ (1,0) [0|0] "" Vector__XXX
 SG_ DAS_sw227_sensorSide m227 : 16|1@1+ (1,0) [0|0] "" Vector__XXX
 SG_ DAS_sw220_controlledAccess m220 : 16|1@1+ (1,0) [0|0] "" Vector__XXX
 SG_ DAS_sw219_controlledAccess m219 : 16|1@1+ (1,0) [0|0] "" Vector__XXX
 SG_ DAS_sw218_cipvDist m218 : 16|8@1+ (0.2,0) [0|0] "" Vector__XXX
 SG_ DAS_sw213_autopilotIntState m213 : 16|4@1+ (1,0) [0|0] "" Vector__XXX
 SG_ DAS_sw207_appMobileyeStatus m207 : 16|8@1+ (1,0) [0|0] "" Vector__XXX
 SG_ DAS_sw205_oocDistance m205 : 16|8@1+ (1,0) [0|0] "" Vector__XXX
 SG_ DAS_sw204_frLeft m204 : 16|8@1+ (1,0) [0|0] "" Vector__XXX
 SG_ DAS_sw203_controlType m203 : 16|4@1+ (1,0) [0|0] "" Vector__XXX
 SG_ DAS_sw202_s1Blocked m202 : 16|1@1+ (1,0) [0|0] "" Vector__XXX
 SG_ DAS_sw201_virtualLaneInputOAL m201 : 16|3@1+ (1,0) [0|0] "" Vector__XXX
 SG_ DAS_sw200_autopilotIntState m200 : 16|4@1+ (1,0) [0|0] "" Vector__XXX
 SG_ DAS_sw199_abortCodeDas m199 : 16|6@1+ (1,0) [0|0] "" Vector__XXX
 SG_ DAS_sw198_fullBlockage m198 : 16|1@1+ (1,0) [0|0] "" Vector__XXX
 SG_ DAS_sw195_s1Blocked m195 : 16|1@1+ (1,0) [0|0] "" Vector__XXX
 SG_ DAS_sw194_leadAx m194 : 16|6@1- (0.2,0) [0|0] "" Vector__XXX
 SG_ DAS_sw193_blurredImage m193 : 16|1@1+ (1,0) [0|0] "" Vector__XXX
 SG_ DAS_sw181_rRepeatCamExtPitchCal m181 : 16|9@1- (0.05,0) [0|0] "" Vector__XXX
 SG_ DAS_sw180_lRepeatCamExtPitchCal m180 : 16|9@1- (0.05,0) [0|0] "" Vector__XXX
 SG_ DAS_sw179_rPillarCamExtPitchCal m179 : 16|9@1- (0.05,0) [0|0] "" Vector__XXX
 SG_ DAS_sw178_lPillarCamExtPitchCal m178 : 16|9@1- (0.05,0) [0|0] "" Vector__XXX
 SG_ DAS_sw177_fisheyeCamExtPitchCal m177 : 16|9@1- (0.05,0) [0|0] "" Vector__XXX
 SG_ DAS_sw175_rRepeatCamExtNoCalFile m175 : 16|1@1+ (1,0) [0|0] "" Vector__XXX
 SG_ DAS_sw174_lRepeatCamExtNoCalFile m174 : 16|1@1+ (1,0) [0|0] "" Vector__XXX
 SG_ DAS_sw173_rPillarCamExtNoCalFile m173 : 16|1@1+ (1,0) [0|0] "" Vector__XXX
 SG_ DAS_sw172_lPillarCamExtNoCalFile m172 : 16|1@1+ (1,0) [0|0] "" Vector__XXX
 SG_ DAS_sw171_fisheyeCamExtNoCalFile m171 : 16|1@1+ (1,0) [0|0] "" Vector__XXX
 SG_ DAS_sw144_selfieCamDeserFault m144 : 16|3@1+ (1,0) [0|0] "" Vector__XXX
 SG_ DAS_sw142_camExtPitchCal m142 : 16|9@1+ (0.05,-12.5) [0|0] "" Vector__XXX
 SG_ DAS_sw141_maxThreshold m141 : 16|8@1- (1,0) [0|0] "" Vector__XXX
 SG_ DAS_sw140_backupCamCSIBridgeFlt m140 : 16|3@1+ (1,0) [0|0] "" Vector__XXX
 SG_ DAS_sw139_rhtRptrCamDeserFault m139 : 16|3@1+ (1,0) [0|0] "" Vector__XXX
 SG_ DAS_sw138_lRepeatCamDeserFault m138 : 16|3@1+ (1,0) [0|0] "" Vector__XXX
 SG_ DAS_sw137_rPillarCamDeserFault m137 : 16|3@1+ (1,0) [0|0] "" Vector__XXX
 SG_ DAS_sw136_lPillarCamDeserFault m136 : 16|3@1+ (1,0) [0|0] "" Vector__XXX
 SG_ DAS_sw135_fisheyeCamDeserFault m135 : 16|3@1+ (1,0) [0|0] "" Vector__XXX
 SG_ DAS_sw134_narrowCamDeserFault m134 : 16|3@1+ (1,0) [0|0] "" Vector__XXX
 SG_ DAS_sw133_mainCamDeserFault m133 : 16|3@1+ (1,0) [0|0] "" Vector__XXX
 SG_ DAS_sw132_narrowCamExtPitchCal m132 : 16|9@1- (0.05,0) [0|0] "" Vector__XXX
 SG_ DAS_sw131_mainCamExtPitchCal m131 : 16|9@1- (0.05,0) [0|0] "" Vector__XXX
 SG_ DAS_sw130_narrowCamExtNoCalFile m130 : 16|1@1+ (1,0) [0|0] "" Vector__XXX
 SG_ DAS_sw129_mainCamExtNoCalFile m129 : 16|1@1+ (1,0) [0|0] "" Vector__XXX
 SG_ DAS_sw106_torsionBarOffset m106 : 16|8@1+ (0.005,-0.64) [0|0] "" Vector__XXX
 SG_ DAS_sw103_objectDx m103 : 16|8@1+ (0.5,0) [0|0] "" Vector__XXX
 SG_ DAS_sw086_distanceException m86 : 16|8@1+ (1,90) [0|0] "" Vector__XXX
 SG_ DAS_sw085_radarDistance m85 : 16|8@1+ (0.0625,0) [0|0] "" Vector__XXX
 SG_ DAS_sw084_ipsoTTC m84 : 16|8@1+ (0.02,0) [0|0] "" Vector__XXX
 SG_ DAS_sw083_Targ5_RCS m83 : 16|16@1+ (0.0039063096,0) [0|0] "" Vector__XXX
 SG_ DAS_sw082_L_VL m82 : 16|8@1+ (0.05,-6.4) [0|0] "" Vector__XXX
 SG_ DAS_sw081_radarDistance m81 : 16|8@1+ (0.0625,0) [0|0] "" Vector__XXX
 SG_ DAS_sw080_sensors_healty_check m80 : 16|1@1+ (1,0) [0|0] "" Vector__XXX
 SG_ DAS_sw078_camCipv_dx m78 : 16|8@1+ (0.2,0) [0|0] "" Vector__XXX
 SG_ DAS_sw077_oocDistance m77 : 16|9@1+ (1,0) [0|0] "" Vector__XXX
 SG_ DAS_sw076_targetDist m76 : 16|9@1+ (0.2,0) [0|0] "" Vector__XXX
 SG_ DAS_sw075_scMia m75 : 16|8@1+ (1,0) [0|0] "" Vector__XXX
 SG_ DAS_sw074_ipsoDx m74 : 16|6@1+ (2,0) [0|0] "" Vector__XXX
 SG_ DAS_sw073_escalateLDWs m73 : 16|1@1+ (1,0) [0|0] "" Vector__XXX
 SG_ DAS_sw072_vehicleX m72 : 16|10@1+ (0.05,-25.6) [0|0] "" Vector__XXX
 SG_ DAS_sw071_selfParkType m71 : 16|4@1+ (1,0) [0|0] "" Vector__XXX
 SG_ DAS_sw070_currTireFitment m70 : 16|3@1+ (1,0) [0|0] "" Vector__XXX
 SG_ DAS_sw069_epasMia m69 : 16|1@1+ (1,0) [0|0] "" Vector__XXX
 SG_ DAS_sw068_percentConsistency m68 : 16|10@1+ (0.1,0) [0|0] "" Vector__XXX
 SG_ DAS_sw067_sccmSTW m67 : 16|14@1+ (0.1,-819.2) [0|0] "" Vector__XXX
 SG_ DAS_sw066_app_mobileye_status m66 : 16|8@1+ (1,0) [0|0] "" Vector__XXX
 SG_ DAS_sw065_app_mobileye_status m65 : 16|8@1+ (1,0) [0|0] "" Vector__XXX
 SG_ DAS_sw064_sysStatus m64 : 16|1@1+ (1,0) [0|0] "" Vector__XXX
 SG_ DAS_sw063_expectedMajorVer m63 : 16|8@1+ (1,0) [0|0] "" Vector__XXX
 SG_ DAS_sw062_HorizontalMisalignment m62 : 16|16@1+ (0.00137332,-45) [0|0] "" Vector__XXX
 SG_ DAS_sw061_airSuspensionMia m61 : 16|8@1+ (1,0) [0|0] "" Vector__XXX
 SG_ DAS_sw060_targetDist m60 : 16|9@1+ (0.2,0) [0|0] "" Vector__XXX
 SG_ DAS_sw059_parkMia m59 : 16|8@1+ (1,0) [0|0] "" Vector__XXX
 SG_ DAS_sw058_epbMia m58 : 16|8@1+ (1,0) [0|0] "" Vector__XXX
 SG_ DAS_sw057_chCtrlMia m57 : 16|1@1+ (1,0) [0|0] "" Vector__XXX
 SG_ DAS_sw056_diMia m56 : 16|8@1+ (1,0) [0|0] "" Vector__XXX
 SG_ DAS_sw055_detectedRadcVersion m55 : 16|32@1+ (1,0) [0|0] "" Vector__XXX
 SG_ DAS_sw054_Autofix_cnvrgnceStatus m54 : 16|8@1+ (1,0) [0|0] "" Vector__XXX
 SG_ DAS_sw053_a10canBusOff m53 : 16|1@1+ (1,0) [0|0] "" Vector__XXX
 SG_ DAS_sw052_a07sensorBlinded m52 : 16|1@1+ (1,0) [0|0] "" Vector__XXX
 SG_ DAS_sw051_a01ecuInternalPerf m51 : 16|1@1+ (1,0) [0|0] "" Vector__XXX
 SG_ DAS_sw050_targetDist m50 : 16|9@1+ (0.2,0) [0|0] "" Vector__XXX
 SG_ DAS_sw049_boot_version_msw m49 : 16|16@1+ (1,0) [0|0] "" Vector__XXX
 SG_ DAS_sw048_swAssert m48 : 16|1@1+ (1,0) [0|0] "" Vector__XXX
 SG_ DAS_sw047_edrStatus m47 : 16|4@1+ (1,0) [0|0] "" Vector__XXX
 SG_ DAS_sw046_recordId m46 : 16|16@1+ (1,0) [0|0] "" Vector__XXX
 SG_ DAS_sw045_radMia m45 : 16|5@1+ (1,0) [0|0] "" Vector__XXX
 SG_ DAS_sw044_countLSB m44 : 16|8@1+ (1,0) [0|0] "" Vector__XXX
 SG_ DAS_sw043_mobileye_status m43 : 16|16@1+ (1,0) [0|0] "" Vector__XXX
 SG_ DAS_sw042_health_state m42 : 16|3@1+ (1,0) [0|0] "" Vector__XXX
 SG_ DAS_sw041_rate m41 : 16|10@1- (1,0) [0|0] "" Vector__XXX
 SG_ DAS_sw040_accel_pedal_pos m40 : 16|8@1+ (0.5,0) [0|0] "" Vector__XXX
 SG_ DAS_sw039_sdm_rcm_Mia m39 : 16|8@1+ (1,0) [0|0] "" Vector__XXX
 SG_ DAS_sw038_RadarMisalignment m38 : 16|1@1+ (1,0) [0|0] "" Vector__XXX
 SG_ DAS_sw037_camera m37 : 16|8@1+ (1,0) [0|0] "" Vector__XXX
 SG_ DAS_sw036_bdyMia m36 : 16|8@1+ (1,0) [0|0] "" Vector__XXX
 SG_ DAS_sw035_espMia m35 : 16|8@1+ (1,0) [0|0] "" Vector__XXX
 SG_ DAS_sw034_sccmMia m34 : 16|8@1+ (1,0) [0|0] "" Vector__XXX
 SG_ DAS_sw033_gtwMia m33 : 16|8@1+ (1,0) [0|0] "" Vector__XXX
 SG_ DAS_sw032_canBus m32 : 16|4@1+ (1,0) [0|0] "" Vector__XXX
 SG_ DAS_sw031_canBus m31 : 16|4@1+ (1,0) [0|0] "" Vector__XXX
 SG_ DAS_sw030_heaterState m30 : 16|8@1+ (1,0) [0|0] "" Vector__XXX
 SG_ DAS_sw029_tx_buffer_full m29 : 16|1@1+ (1,0) [0|0] "" Vector__XXX
 SG_ DAS_sw028_rx_buffer_full m28 : 16|1@1+ (1,0) [0|0] "" Vector__XXX
 SG_ DAS_sw027_JTAG_Reset m27 : 16|1@1+ (1,0) [0|0] "" Vector__XXX
 SG_ DAS_sw026_task_id m26 : 16|2@1+ (1,0) [0|0] "" Vector__XXX
 SG_ DAS_sw025_state_before_override m25 : 16|4@1+ (1,0) [0|0] "" Vector__XXX
 SG_ DAS_sw024_Task_ID m24 : 16|4@1+ (1,0) [0|0] "" Vector__XXX
 SG_ DAS_sw022_operation m22 : 16|4@1+ (1,0) [0|0] "" Vector__XXX
 SG_ DAS_sw021_tempSensorId m21 : 16|8@1+ (1,0) [0|0] "" Vector__XXX
 SG_ DAS_sw020_unusedW0 m20 : 16|16@1+ (1,0) [0|0] "" Vector__XXX
 SG_ DAS_sw019_taskId m19 : 16|8@1+ (1,0) [0|0] "" Vector__XXX
 SG_ DAS_sw018_minThreshold m18 : 16|13@1+ (1,0) [0|0] "" Vector__XXX
 SG_ DAS_sw017_Camera_Msg_Lanes_MIA m17 : 16|1@1+ (1,0) [0|0] "" Vector__XXX
 SG_ DAS_sw016_targetDist m16 : 16|9@1+ (0.2,0) [0|0] "" Vector__XXX
 SG_ DAS_sw015_RadarLowVisibility m15 : 16|2@1+ (1,0) [0|0] "" Vector__XXX
 SG_ DAS_sw014_fileNameHash m14 : 16|16@1+ (1,0) [0|0] "" Vector__XXX
 SG_ DAS_sw013_stateBeforeWatchdog m13 : 16|5@1+ (1,0) [0|0] "" Vector__XXX
 SG_ DAS_sw012_bootTestResults m12 : 16|16@1+ (1,0) [0|0] "" Vector__XXX
 SG_ DAS_sw011_scaState m11 : 16|3@1+ (1,0) [0|0] "" Vector__XXX
 SG_ DAS_sw010_a04calibNotDone m10 : 16|1@1+ (1,0) [0|0] "" Vector__XXX
 SG_ DAS_sw009_DIaebState_fault m9 : 16|1@1+ (1,0) [0|0] "" Vector__XXX
 SG_ DAS_sw006_RadarLowVisibility m6 : 16|1@1+ (1,0) [0|0] "" Vector__XXX
 SG_ DAS_sw005_AutofixOutOfCalib m5 : 16|1@1+ (1,0) [0|0] "" Vector__XXX
 SG_ DAS_sw004_radIssue m4 : 16|1@1+ (1,0) [0|0] "" Vector__XXX
 SG_ DAS_alertState : 15|1@1+ (1,0) [0|0] "" Vector__XXX
 SG_ DAS_alertID M : 0|15@1+ (1,0) [0|0] "" Vector__XXX

BO_ 1467 SDCR_alertMatrix: 8 Vector__XXX
 SG_ SDCR_a034_phaseCurrentIrrational m0 : 37|1@1+ (1,0) [0|0] "" Vector__XXX
 SG_ SDCR_a033_placeholder33 m0 : 36|1@1+ (1,0) [0|0] "" Vector__XXX
 SG_ SDCR_a032_placeholder32 m0 : 35|1@1+ (1,0) [0|0] "" Vector__XXX
 SG_ SDCR_a031_placeholder31 m0 : 34|1@1+ (1,0) [0|0] "" Vector__XXX
 SG_ SDCR_a030_placeholder30 m0 : 33|1@1+ (1,0) [0|0] "" Vector__XXX
 SG_ SDCR_a029_diMIA m0 : 32|1@1+ (1,0) [0|0] "" Vector__XXX
 SG_ SDCR_a028_vcLVStateMIA m0 : 31|1@1+ (1,0) [0|0] "" Vector__XXX
 SG_ SDCR_a027_diCanMIA m0 : 30|1@1+ (1,0) [0|0] "" Vector__XXX
 SG_ SDCR_a026_faultCurrentMonitoring m0 : 29|1@1+ (1,0) [0|0] "" Vector__XXX
 SG_ SDCR_a025_diSwitchingFdbkIrratio m0 : 28|1@1+ (1,0) [0|0] "" Vector__XXX
 SG_ SDCR_a024_gtwMIA m0 : 27|1@1+ (1,0) [0|0] "" Vector__XXX
 SG_ SDCR_a023_ecuLogAvailable m0 : 26|1@1+ (1,0) [0|0] "" Vector__XXX
 SG_ SDCR_a022_TaskInitError m0 : 25|1@1+ (1,0) [0|0] "" Vector__XXX
 SG_ SDCR_a021_busBarTempIrrational m0 : 24|1@1+ (1,0) [0|0] "" Vector__XXX
 SG_ SDCR_a020_eepromSPIError m0 : 23|1@1+ (1,0) [0|0] "" Vector__XXX
 SG_ SDCR_a019_historicalFaultCurrent m0 : 22|1@1+ (1,0) [0|0] "" Vector__XXX
 SG_ SDCR_a018_historicalPyroTrigger m0 : 21|1@1+ (1,0) [0|0] "" Vector__XXX
 SG_ SDCR_a017_adcSPIError m0 : 20|1@1+ (1,0) [0|0] "" Vector__XXX
 SG_ SDCR_a016_systemReset m0 : 19|1@1+ (1,0) [0|0] "" Vector__XXX
 SG_ SDCR_a015_phaseVIrrational m0 : 18|1@1+ (1,0) [0|0] "" Vector__XXX
 SG_ SDCR_a014_vBusIrrational m0 : 17|1@1+ (1,0) [0|0] "" Vector__XXX
 SG_ SDCR_a013_vBkupIrrational m0 : 16|1@1+ (1,0) [0|0] "" Vector__XXX
 SG_ SDCR_a012_vBoostSecIrrational m0 : 15|1@1+ (1,0) [0|0] "" Vector__XXX
 SG_ SDCR_a011_phaseCurrentOffset m0 : 14|1@1+ (1,0) [0|0] "" Vector__XXX
 SG_ SDCR_a010_vrefIrrational m0 : 13|1@1+ (1,0) [0|0] "" Vector__XXX
 SG_ SDCR_a009_uartVersionMismatch m0 : 12|1@1+ (1,0) [0|0] "" Vector__XXX
 SG_ SDCR_a008_hvlinkMIA m0 : 11|1@1+ (1,0) [0|0] "" Vector__XXX
 SG_ SDCR_a007_faultCurrentsDetected m0 : 10|1@1+ (1,0) [0|0] "" Vector__XXX
 SG_ SDCR_a006_pyroTriggered m0 : 9|1@1+ (1,0) [0|0] "" Vector__XXX
 SG_ SDCR_a005_motorSpeedIrrational m0 : 8|1@1+ (1,0) [0|0] "" Vector__XXX
 SG_ SDCR_a004_pmRunningFdbkIrrationa m0 : 7|1@1+ (1,0) [0|0] "" Vector__XXX
 SG_ SDCR_a003_diUartMIA m0 : 6|1@1+ (1,0) [0|0] "" Vector__XXX
 SG_ SDCR_a002_diPstSkipped m0 : 5|1@1+ (1,0) [0|0] "" Vector__XXX
 SG_ SDCR_a001_powerOnSelfTestFailed m0 : 4|1@1+ (1,0) [0|0] "" Vector__XXX
 SG_ SDCR_matrixIndex M : 0|4@1+ (1,0) [0|0] "" Vector__XXX

BO_ 1469 IBST_alertLog: 8 Vector__XXX
 SG_ IBST_alertState : 15|1@1+ (1,0) [0|0] "" Vector__XXX
 SG_ IBST_alertID : 0|8@1+ (1,0) [0|0] "" Vector__XXX

BO_ 1480 EPBL_alertLog: 8 Vector__XXX
 SG_ EPBL_a058_faultReason m58 : 63|1@1+ (1,0) [0|0] "" Vector__XXX
 SG_ EPBL_a086_VEH_pcsInterface m86 : 63|1@1+ (1,0) [0|0] "" Vector__XXX
 SG_ EPBL_a086_VEH_LVHealth m86 : 62|1@1+ (1,0) [0|0] "" Vector__XXX
 SG_ EPBL_a198_version m198 : 61|3@1+ (1,0) [0|0] "" Vector__XXX
 SG_ EPBL_a183_redundantBrakingEnable m183 : 60|1@1+ (1,0) [0|0] "" Vector__XXX
 SG_ EPBL_a183_lastFactoryMode m183 : 59|1@1+ (1,0) [0|0] "" Vector__XXX
 SG_ EPBL_a183_espInvalidOrUnsure m183 : 58|1@1+ (1,0) [0|0] "" Vector__XXX
 SG_ EPBL_a183_lastLowBrakeFluid m183 : 57|1@1+ (1,0) [0|0] "" Vector__XXX
 SG_ EPBL_a022_TaskInitError4 m22 : 56|8@1+ (1,0) [0|0] "" Vector__XXX
 SG_ EPBL_a031_uds_bytes_5 m31 : 56|8@1+ (1,0) [0|0] "" Vector__XXX
 SG_ EPBL_a041_CPULoadNVMMTask m41 : 56|8@1+ (1,0) [0|0] "" Vector__XXX
 SG_ EPBL_a042_UsageNVMMTask m42 : 56|8@1+ (1,0) [0|0] "" Vector__XXX
 SG_ EPBL_a174_nonterminalReason m174 : 56|5@1+ (1,0) [0|0] "" Vector__XXX
 SG_ EPBL_a175_nonterminalReason m175 : 56|5@1+ (1,0) [0|0] "" Vector__XXX
 SG_ EPBL_a176_nonterminalReason m176 : 56|5@1+ (1,0) [0|0] "" Vector__XXX
 SG_ EPBL_a177_nonterminalReason m177 : 56|5@1+ (1,0) [0|0] "" Vector__XXX
 SG_ EPBL_a179_nonterminalReason m179 : 56|5@1+ (1,0) [0|0] "" Vector__XXX
 SG_ EPBL_a183_remoteEpbStatusUnsure m183 : 56|1@1+ (1,0) [0|0] "" Vector__XXX
 SG_ EPBL_a190_nonterminalReason m190 : 56|5@1+ (1,0) [0|0] "" Vector__XXX
 SG_ EPBL_a191_nonterminalReason m191 : 56|5@1+ (1,0) [0|0] "" Vector__XXX
 SG_ EPBL_a247_nonterminalReason m247 : 56|5@1+ (1,0) [0|0] "" Vector__XXX
 SG_ EPBL_a248_nonterminalReason m248 : 56|5@1+ (1,0) [0|0] "" Vector__XXX
 SG_ EPBL_a183_cdpCannotBeCommanded m183 : 55|1@1+ (1,0) [0|0] "" Vector__XXX
 SG_ EPBL_a183_lastLocalEpbDynamic m183 : 54|1@1+ (1,0) [0|0] "" Vector__XXX
 SG_ EPBL_a183_lastRemoteEpbDynamic m183 : 53|1@1+ (1,0) [0|0] "" Vector__XXX
 SG_ EPBL_a198_ambientTemp m198 : 53|8@1+ (0.5,-40) [0|0] "" Vector__XXX
 SG_ EPBL_a357_trailerDetected m357 : 53|1@1+ (1,0) [0|0] "" Vector__XXX
 SG_ EPBL_a358_trailerDetected m358 : 53|1@1+ (1,0) [0|0] "" Vector__XXX
 SG_ EPBL_a183_brakeFluidConfirmedLow m183 : 52|1@1+ (1,0) [0|0] "" Vector__XXX
 SG_ EPBL_a352_duration m352 : 52|10@1+ (1,0) [0|0] "" Vector__XXX
 SG_ EPBL_a357_uiTrailerDetected m357 : 52|1@1+ (1,0) [0|0] "" Vector__XXX
 SG_ EPBL_a358_uiTrailerDetected m358 : 52|1@1+ (1,0) [0|0] "" Vector__XXX
 SG_ EPBL_a058_newREstimate m58 : 51|12@1+ (0.00061,0) [0|0] "" Vector__XXX
 SG_ EPBL_a140_monitorState m140 : 51|3@1+ (1,0) [0|0] "" Vector__XXX
 SG_ EPBL_a183_espConfirmedInvalid m183 : 51|1@1+ (1,0) [0|0] "" Vector__XXX
 SG_ EPBL_a357_vcTrailerDetected m357 : 51|1@1+ (1,0) [0|0] "" Vector__XXX
 SG_ EPBL_a358_vcTrailerDetected m358 : 51|1@1+ (1,0) [0|0] "" Vector__XXX
 SG_ EPBL_a113_VEH_odo m113 : 50|1@1+ (1,0) [0|0] "" Vector__XXX
 SG_ EPBL_a183_epbmInvalidated m183 : 50|1@1+ (1,0) [0|0] "" Vector__XXX
 SG_ EPBL_a104_BDY_bodyControls m104 : 49|1@1+ (1,0) [0|0] "" Vector__XXX
 SG_ EPBL_a113_CH_vehicleControl2 m113 : 49|1@1+ (1,0) [0|0] "" Vector__XXX
 SG_ EPBL_a183_localEpbDynamic m183 : 49|1@1+ (1,0) [0|0] "" Vector__XXX
 SG_ EPBL_a198_learnedEpbConfig m198 : 49|4@1+ (1,0) [0|0] "" Vector__XXX
 SG_ EPBL_a000_alertDataW2 m0 : 48|16@1+ (1,0) [0|0] "" Vector__XXX
 SG_ EPBL_a003_Data m3 : 48|16@1+ (1,0) [0|0] "" Vector__XXX
 SG_ EPBL_a022_TaskInitError3 m22 : 48|8@1+ (1,0) [0|0] "" Vector__XXX
 SG_ EPBL_a031_uds_bytes_4 m31 : 48|8@1+ (1,0) [0|0] "" Vector__XXX
 SG_ EPBL_a041_CPULoad1000msTask m41 : 48|8@1+ (1,0) [0|0] "" Vector__XXX
 SG_ EPBL_a042_UsageUDSTask m42 : 48|8@1+ (1,0) [0|0] "" Vector__XXX
 SG_ EPBL_a104_VEH_redundantBrakingCo m104 : 48|1@1+ (1,0) [0|0] "" Vector__XXX
 SG_ EPBL_a113_VEH_driverAssistMapDat m113 : 48|1@1+ (1,0) [0|0] "" Vector__XXX
 SG_ EPBL_a120_BDY_speed m120 : 48|1@1+ (1,0) [0|0] "" Vector__XXX
 SG_ EPBL_a140_localState m140 : 48|3@1+ (1,0) [0|0] "" Vector__XXX
 SG_ EPBL_a174_esmOpTrigger m174 : 48|6@1+ (1,0) [0|0] "" Vector__XXX
 SG_ EPBL_a175_esmOpTrigger m175 : 48|6@1+ (1,0) [0|0] "" Vector__XXX
 SG_ EPBL_a176_esmOpTrigger m176 : 48|6@1+ (1,0) [0|0] "" Vector__XXX
 SG_ EPBL_a177_esmOpTrigger m177 : 48|6@1+ (1,0) [0|0] "" Vector__XXX
 SG_ EPBL_a179_esmOpTrigger m179 : 48|6@1+ (1,0) [0|0] "" Vector__XXX
 SG_ EPBL_a183_remoteEpbDynamic m183 : 48|1@1+ (1,0) [0|0] "" Vector__XXX
 SG_ EPBL_a190_esmOpTrigger m190 : 48|6@1+ (1,0) [0|0] "" Vector__XXX
 SG_ EPBL_a191_esmOpTrigger m191 : 48|6@1+ (1,0) [0|0] "" Vector__XXX
 SG_ EPBL_a216_byte3 m216 : 48|8@1+ (1,0) [0|0] "" Vector__XXX
 SG_ EPBL_a247_esmOpTrigger m247 : 48|6@1+ (1,0) [0|0] "" Vector__XXX
 SG_ EPBL_a248_esmOpTrigger m248 : 48|6@1+ (1,0) [0|0] "" Vector__XXX
 SG_ EPBL_a301_oocDistanceFiltered m301 : 48|16@1+ (0.01,0) [0|0] "" Vector__XXX
 SG_ EPBL_a363_outputRodAct m363 : 48|10@1+ (0.1,-10) [0|0] "" Vector__XXX
 SG_ EPBL_a370_messageBitmask m370 : 48|16@1+ (1,0) [0|0] "" Vector__XXX
 SG_ EPBL_a104_VEH_control m104 : 47|1@1+ (1,0) [0|0] "" Vector__XXX
 SG_ EPBL_a113_VEH_ambientLightingCtr m113 : 47|1@1+ (1,0) [0|0] "" Vector__XXX
 SG_ EPBL_a120_VEH_motorStatus m120 : 47|1@1+ (1,0) [0|0] "" Vector__XXX
 SG_ EPBL_a183_cdpNotStarting m183 : 47|1@1+ (1,0) [0|0] "" Vector__XXX
 SG_ EPBL_a104_VEH_wirelessChargingSt m104 : 46|1@1+ (1,0) [0|0] "" Vector__XXX
 SG_ EPBL_a113_VEH_autopilotControl m113 : 46|1@1+ (1,0) [0|0] "" Vector__XXX
 SG_ EPBL_a120_PARTY_motorStatus m120 : 46|1@1+ (1,0) [0|0] "" Vector__XXX
 SG_ EPBL_a183_cdpNotStopping m183 : 46|1@1+ (1,0) [0|0] "" Vector__XXX
 SG_ EPBL_a104_BDY_autonomyControl m104 : 45|1@1+ (1,0) [0|0] "" Vector__XXX
 SG_ EPBL_a113_VEH_status2 m113 : 45|1@1+ (1,0) [0|0] "" Vector__XXX
 SG_ EPBL_a120_VEH_vehicleEstimates m120 : 45|1@1+ (1,0) [0|0] "" Vector__XXX
 SG_ EPBL_a251_temperature m251 : 45|9@1- (0.5,-40) [0|0] "" Vector__XXX
 SG_ EPBL_a303_temperature m303 : 45|9@1- (0.5,-40) [0|0] "" Vector__XXX
 SG_ EPBL_a104_CH_autonomyControl m104 : 44|1@1+ (1,0) [0|0] "" Vector__XXX
 SG_ EPBL_a113_VEH_gpsVehicleSpeed m113 : 44|1@1+ (1,0) [0|0] "" Vector__XXX
 SG_ EPBL_a118_PARTY_VCFRONT_cameraCl m118 : 44|1@1+ (1,0) [0|0] "" Vector__XXX
 SG_ EPBL_a120_VEH_prndControl m120 : 44|1@1+ (1,0) [0|0] "" Vector__XXX
 SG_ EPBL_a063_faulted m63 : 43|1@1+ (1,0) [0|0] "" Vector__XXX
 SG_ EPBL_a104_VEH_autonomyControl m104 : 43|1@1+ (1,0) [0|0] "" Vector__XXX
 SG_ EPBL_a113_VEH_gpsTime m113 : 43|1@1+ (1,0) [0|0] "" Vector__XXX
 SG_ EPBL_a118_BDY_AP_vehicleState1Hz m118 : 43|1@1+ (1,0) [0|0] "" Vector__XXX
 SG_ EPBL_a120_VEH_locStatus2 m120 : 43|1@1+ (1,0) [0|0] "" Vector__XXX
 SG_ EPBL_a063_stuckActive m63 : 42|1@1+ (1,0) [0|0] "" Vector__XXX
 SG_ EPBL_a104_PARTY_autonomyControl m104 : 42|1@1+ (1,0) [0|0] "" Vector__XXX
 SG_ EPBL_a113_VEH_locationStatus m113 : 42|1@1+ (1,0) [0|0] "" Vector__XXX
 SG_ EPBL_a118_PARTY_AP_vehicleState1 m118 : 42|1@1+ (1,0) [0|0] "" Vector__XXX
 SG_ EPBL_a120_VEH_locStatus m120 : 42|1@1+ (1,0) [0|0] "" Vector__XXX
 SG_ EPBL_a182_trailerDetected m182 : 42|1@1+ (1,0) [0|0] "" Vector__XXX
 SG_ EPBL_a350_ensTimedOut m350 : 42|1@1+ (1,0) [0|0] "" Vector__XXX
 SG_ EPBL_a352_startTime m352 : 42|10@1+ (10,0) [0|0] "" Vector__XXX
 SG_ EPBL_a365_trailerDetected m365 : 42|1@1+ (1,0) [0|0] "" Vector__XXX
 SG_ EPBL_a366_trailerDetected m366 : 42|1@1+ (1,0) [0|0] "" Vector__XXX
 SG_ EPBL_a063_indeterminate m63 : 41|1@1+ (1,0) [0|0] "" Vector__XXX
 SG_ EPBL_a104_BDY_status m104 : 41|1@1+ (1,0) [0|0] "" Vector__XXX
 SG_ EPBL_a113_CH_odo m113 : 41|1@1+ (1,0) [0|0] "" Vector__XXX
 SG_ EPBL_a117_PARTY_lightingSecondar m117 : 41|1@1+ (1,0) [0|0] "" Vector__XXX
 SG_ EPBL_a118_BDY_vehicleTime m118 : 41|1@1+ (1,0) [0|0] "" Vector__XXX
 SG_ EPBL_a120_CH_locStatus2 m120 : 41|1@1+ (1,0) [0|0] "" Vector__XXX
 SG_ EPBL_a182_uiTrailerDetected m182 : 41|1@1+ (1,0) [0|0] "" Vector__XXX
 SG_ EPBL_a365_uiTrailerDetected m365 : 41|1@1+ (1,0) [0|0] "" Vector__XXX
 SG_ EPBL_a366_uiTrailerDetected m366 : 41|1@1+ (1,0) [0|0] "" Vector__XXX
 SG_ EPBL_a022_TaskInitError2 m22 : 40|8@1+ (1,0) [0|0] "" Vector__XXX
 SG_ EPBL_a031_uds_bytes_3 m31 : 40|8@1+ (1,0) [0|0] "" Vector__XXX
 SG_ EPBL_a041_CPULoad100msTask m41 : 40|8@1+ (1,0) [0|0] "" Vector__XXX
 SG_ EPBL_a042_Usage1000msTask m42 : 40|8@1+ (1,0) [0|0] "" Vector__XXX
 SG_ EPBL_a043_CallTrace1 m43 : 40|24@1+ (1,0) [0|0] "" Vector__XXX
 SG_ EPBL_a044_CallTrace1 m44 : 40|24@1+ (1,0) [0|0] "" Vector__XXX
 SG_ EPBL_a045_CallTrace1 m45 : 40|24@1+ (1,0) [0|0] "" Vector__XXX
 SG_ EPBL_a046_CallTrace1 m46 : 40|24@1+ (1,0) [0|0] "" Vector__XXX
 SG_ EPBL_a059_current m59 : 40|12@1+ (0.05,0) [0|0] "" Vector__XXX
 SG_ EPBL_a063_disconnected m63 : 40|1@1+ (1,0) [0|0] "" Vector__XXX
 SG_ EPBL_a104_BDY_control m104 : 40|1@1+ (1,0) [0|0] "" Vector__XXX
 SG_ EPBL_a113_VEH_vehicleControlTher m113 : 40|1@1+ (1,0) [0|0] "" Vector__XXX
 SG_ EPBL_a116_BDY_switchStatus m116 : 40|1@1+ (1,0) [0|0] "" Vector__XXX
 SG_ EPBL_a117_PARTY_prndStatus m117 : 40|1@1+ (1,0) [0|0] "" Vector__XXX
 SG_ EPBL_a118_BDY_outputPowerStatus m118 : 40|1@1+ (1,0) [0|0] "" Vector__XXX
 SG_ EPBL_a120_VEH_chassisCntl m120 : 40|1@1+ (1,0) [0|0] "" Vector__XXX
 SG_ EPBL_a125_12vFilt m125 : 40|12@1+ (0.005443676098,0) [0|0] "" Vector__XXX
 SG_ EPBL_a126_12vFilt m126 : 40|12@1+ (0.005443676098,0) [0|0] "" Vector__XXX
 SG_ EPBL_a127_12vFilt m127 : 40|12@1+ (0.005443676098,0) [0|0] "" Vector__XXX
 SG_ EPBL_a128_12vFilt m128 : 40|12@1+ (0.005443676098,0) [0|0] "" Vector__XXX
 SG_ EPBL_a134_12vFilt m134 : 40|12@1+ (0.005443676098,0) [0|0] "" Vector__XXX
 SG_ EPBL_a135_12vFilt m135 : 40|12@1+ (0.005443676098,0) [0|0] "" Vector__XXX
 SG_ EPBL_a136_12vFilt m136 : 40|12@1+ (0.005443676098,0) [0|0] "" Vector__XXX
 SG_ EPBL_a137_12vFilt m137 : 40|12@1+ (0.005443676098,0) [0|0] "" Vector__XXX
 SG_ EPBL_a170_12vFilt m170 : 40|12@1+ (0.005443676098,0) [0|0] "" Vector__XXX
 SG_ EPBL_a171_12vFilt m171 : 40|12@1+ (0.005443676098,0) [0|0] "" Vector__XXX
 SG_ EPBL_a174_csmFaultReason m174 : 40|5@1+ (1,0) [0|0] "" Vector__XXX
 SG_ EPBL_a175_csmFaultReason m175 : 40|5@1+ (1,0) [0|0] "" Vector__XXX
 SG_ EPBL_a176_csmFaultReason m176 : 40|5@1+ (1,0) [0|0] "" Vector__XXX
 SG_ EPBL_a177_csmFaultReason m177 : 40|5@1+ (1,0) [0|0] "" Vector__XXX
 SG_ EPBL_a179_csmFaultReason m179 : 40|5@1+ (1,0) [0|0] "" Vector__XXX
 SG_ EPBL_a182_vcTrailerDetected m182 : 40|1@1+ (1,0) [0|0] "" Vector__XXX
 SG_ EPBL_a183_esmOperationTrigger m183 : 40|6@1+ (1,0) [0|0] "" Vector__XXX
 SG_ EPBL_a190_csmFaultReason m190 : 40|5@1+ (1,0) [0|0] "" Vector__XXX
 SG_ EPBL_a191_csmFaultReason m191 : 40|5@1+ (1,0) [0|0] "" Vector__XXX
 SG_ EPBL_a216_byte2 m216 : 40|8@1+ (1,0) [0|0] "" Vector__XXX
 SG_ EPBL_a217_byte7 m217 : 40|8@1+ (1,0) [0|0] "" Vector__XXX
 SG_ EPBL_a246_esmOpTrigger m246 : 40|6@1+ (1,0) [0|0] "" Vector__XXX
 SG_ EPBL_a247_csmFaultReason m247 : 40|5@1+ (1,0) [0|0] "" Vector__XXX
 SG_ EPBL_a248_csmFaultReason m248 : 40|5@1+ (1,0) [0|0] "" Vector__XXX
 SG_ EPBL_a249_esmOpTrigger m249 : 40|6@1+ (1,0) [0|0] "" Vector__XXX
 SG_ EPBL_a253_steeringDriveStatusBlo m253 : 40|1@1+ (1,0) [0|0] "" Vector__XXX
 SG_ EPBL_a357_brakeTemp m357 : 40|11@1+ (1,-40) [0|0] "" Vector__XXX
 SG_ EPBL_a358_brakeTemp m358 : 40|11@1+ (1,-40) [0|0] "" Vector__XXX
 SG_ EPBL_a365_vcTrailerDetected m365 : 40|1@1+ (1,0) [0|0] "" Vector__XXX
 SG_ EPBL_a366_vcTrailerDetected m366 : 40|1@1+ (1,0) [0|0] "" Vector__XXX
 SG_ EPBL_a058_prevREstimate m58 : 39|12@1+ (0.00061,0) [0|0] "" Vector__XXX
 SG_ EPBL_a104_BDY_gpsAccuracies m104 : 39|1@1+ (1,0) [0|0] "" Vector__XXX
 SG_ EPBL_a113_VEH_vehicleControl3 m113 : 39|1@1+ (1,0) [0|0] "" Vector__XXX
 SG_ EPBL_a116_BDY_restraintStatus m116 : 39|1@1+ (1,0) [0|0] "" Vector__XXX
 SG_ EPBL_a117_VEH_status m117 : 39|1@1+ (1,0) [0|0] "" Vector__XXX
 SG_ EPBL_a118_CH_alertMatrix m118 : 39|1@1+ (1,0) [0|0] "" Vector__XXX
 SG_ EPBL_a120_PARTY_locStatus2 m120 : 39|1@1+ (1,0) [0|0] "" Vector__XXX
 SG_ EPBL_a253_lvDriveStatusBlock m253 : 39|1@1+ (1,0) [0|0] "" Vector__XXX
 SG_ EPBL_a104_CH_pscControl m104 : 38|1@1+ (1,0) [0|0] "" Vector__XXX
 SG_ EPBL_a113_VEH_tripPlanning m113 : 38|1@1+ (1,0) [0|0] "" Vector__XXX
 SG_ EPBL_a116_BDY_epbmStatus m116 : 38|1@1+ (1,0) [0|0] "" Vector__XXX
 SG_ EPBL_a117_PARTY_doorStatus m117 : 38|1@1+ (1,0) [0|0] "" Vector__XXX
 SG_ EPBL_a118_CH_LVBMS_statusHigh m118 : 38|1@1+ (1,0) [0|0] "" Vector__XXX
 SG_ EPBL_a120_PARTY_prndControl m120 : 38|1@1+ (1,0) [0|0] "" Vector__XXX
 SG_ EPBL_a180_activeDecelRequest m180 : 38|1@1+ (1,0) [0|0] "" Vector__XXX
 SG_ EPBL_a184_activeDecelRequest m184 : 38|1@1+ (1,0) [0|0] "" Vector__XXX
 SG_ EPBL_a186_activeDecelRequest m186 : 38|1@1+ (1,0) [0|0] "" Vector__XXX
 SG_ EPBL_a187_activeDecelRequest m187 : 38|1@1+ (1,0) [0|0] "" Vector__XXX
 SG_ EPBL_a188_activeDecelRequest m188 : 38|1@1+ (1,0) [0|0] "" Vector__XXX
 SG_ EPBL_a189_activeDecelRequest m189 : 38|1@1+ (1,0) [0|0] "" Vector__XXX
 SG_ EPBL_a225_activeDecelRequest m225 : 38|1@1+ (1,0) [0|0] "" Vector__XXX
 SG_ EPBL_a362_inputRodDriver m362 : 38|10@1+ (0.1,-10) [0|0] "" Vector__XXX
 SG_ EPBL_a363_inputRodDriver m363 : 38|10@1+ (0.1,-10) [0|0] "" Vector__XXX
 SG_ EPBL_a016_NVMMWriteFailed m16 : 37|1@1+ (1,0) [0|0] "" Vector__XXX
 SG_ EPBL_a104_VEH_status m104 : 37|1@1+ (1,0) [0|0] "" Vector__XXX
 SG_ EPBL_a113_CH_powertrainControl m113 : 37|1@1+ (1,0) [0|0] "" Vector__XXX
 SG_ EPBL_a116_PARTY_doorStatus m116 : 37|1@1+ (1,0) [0|0] "" Vector__XXX
 SG_ EPBL_a117_VEH_thermalStatus m117 : 37|1@1+ (1,0) [0|0] "" Vector__XXX
 SG_ EPBL_a118_CH_12VBatteryStatus m118 : 37|1@1+ (1,0) [0|0] "" Vector__XXX
 SG_ EPBL_a120_VEH_estimatedBrakeTemp m120 : 37|1@1+ (1,0) [0|0] "" Vector__XXX
 SG_ EPBL_a174_monitorFaultStatus m174 : 37|2@1+ (1,0) [0|0] "" Vector__XXX
 SG_ EPBL_a175_monitorFaultStatus m175 : 37|2@1+ (1,0) [0|0] "" Vector__XXX
 SG_ EPBL_a176_monitorFaultStatus m176 : 37|2@1+ (1,0) [0|0] "" Vector__XXX
 SG_ EPBL_a177_monitorFaultStatus m177 : 37|2@1+ (1,0) [0|0] "" Vector__XXX
 SG_ EPBL_a179_monitorFaultStatus m179 : 37|2@1+ (1,0) [0|0] "" Vector__XXX
 SG_ EPBL_a180_panicModeLatched m180 : 37|1@1+ (1,0) [0|0] "" Vector__XXX
 SG_ EPBL_a184_panicModeLatched m184 : 37|1@1+ (1,0) [0|0] "" Vector__XXX
 SG_ EPBL_a186_panicModeLatched m186 : 37|1@1+ (1,0) [0|0] "" Vector__XXX
 SG_ EPBL_a187_panicModeLatched m187 : 37|1@1+ (1,0) [0|0] "" Vector__XXX
 SG_ EPBL_a188_panicModeLatched m188 : 37|1@1+ (1,0) [0|0] "" Vector__XXX
 SG_ EPBL_a189_panicModeLatched m189 : 37|1@1+ (1,0) [0|0] "" Vector__XXX
 SG_ EPBL_a190_monitorFaultStatus m190 : 37|2@1+ (1,0) [0|0] "" Vector__XXX
 SG_ EPBL_a191_monitorFaultStatus m191 : 37|2@1+ (1,0) [0|0] "" Vector__XXX
 SG_ EPBL_a198_resistanceCalc m198 : 37|12@1+ (0.005,0) [0|0] "" Vector__XXX
 SG_ EPBL_a225_panicModeLatched m225 : 37|1@1+ (1,0) [0|0] "" Vector__XXX
 SG_ EPBL_a246_faultStatus m246 : 37|2@1+ (1,0) [0|0] "" Vector__XXX
 SG_ EPBL_a247_monitorFaultStatus m247 : 37|2@1+ (1,0) [0|0] "" Vector__XXX
 SG_ EPBL_a248_monitorFaultStatus m248 : 37|2@1+ (1,0) [0|0] "" Vector__XXX
 SG_ EPBL_a249_faultStatus m249 : 37|2@1+ (1,0) [0|0] "" Vector__XXX
 SG_ EPBL_a264_frunkOpen m264 : 37|1@1+ (1,0) [0|0] "" Vector__XXX
 SG_ EPBL_a005_faults1 m5 : 36|12@1+ (1,0) [0|0] "" Vector__XXX
 SG_ EPBL_a016_NVMMMemOverflow m16 : 36|1@1+ (1,0) [0|0] "" Vector__XXX
 SG_ EPBL_a104_VEH_summonCommand m104 : 36|1@1+ (1,0) [0|0] "" Vector__XXX
 SG_ EPBL_a113_CH_chassisControl m113 : 36|1@1+ (1,0) [0|0] "" Vector__XXX
 SG_ EPBL_a116_PARTY_restraintStatus m116 : 36|1@1+ (1,0) [0|0] "" Vector__XXX
 SG_ EPBL_a117_PARTY_restraintStatus m117 : 36|1@1+ (1,0) [0|0] "" Vector__XXX
 SG_ EPBL_a118_PARTY_vehNm m118 : 36|1@1+ (1,0) [0|0] "" Vector__XXX
 SG_ EPBL_a120_CH_speed m120 : 36|1@1+ (1,0) [0|0] "" Vector__XXX
 SG_ EPBL_a253_summonState m253 : 36|3@1+ (1,0) [0|0] "" Vector__XXX
 SG_ EPBL_a256_steeringDriveStatusBlo m256 : 36|1@1+ (1,0) [0|0] "" Vector__XXX
 SG_ EPBL_a264_uiServiceModePlus m264 : 36|1@1+ (1,0) [0|0] "" Vector__XXX
 SG_ EPBL_a016_NVMMRecordUpgraded m16 : 35|1@1+ (1,0) [0|0] "" Vector__XXX
 SG_ EPBL_a104_VEH_matrixHighBeamRequ m104 : 35|1@1+ (1,0) [0|0] "" Vector__XXX
 SG_ EPBL_a113_VEH_LVControl m113 : 35|1@1+ (1,0) [0|0] "" Vector__XXX
 SG_ EPBL_a114_CH_status m114 : 35|1@1+ (1,0) [0|0] "" Vector__XXX
 SG_ EPBL_a116_VEH_windowStatus m116 : 35|1@1+ (1,0) [0|0] "" Vector__XXX
 SG_ EPBL_a117_VEH_seatStatus2 m117 : 35|1@1+ (1,0) [0|0] "" Vector__XXX
 SG_ EPBL_a118_VEH_lightStatus m118 : 35|1@1+ (1,0) [0|0] "" Vector__XXX
 SG_ EPBL_a120_PARTY_stalklessInterfa m120 : 35|1@1+ (1,0) [0|0] "" Vector__XXX
 SG_ EPBL_a253_driverDynamicRequest m253 : 35|1@1+ (1,0) [0|0] "" Vector__XXX
 SG_ EPBL_a256_lvDriveStatusBlock m256 : 35|1@1+ (1,0) [0|0] "" Vector__XXX
 SG_ EPBL_a264_uiServiceMode m264 : 35|1@1+ (1,0) [0|0] "" Vector__XXX
 SG_ EPBL_a016_NVMMVersionMismatch m16 : 34|1@1+ (1,0) [0|0] "" Vector__XXX
 SG_ EPBL_a104_PARTY_matrixBendAngleR m104 : 34|1@1+ (1,0) [0|0] "" Vector__XXX
 SG_ EPBL_a113_VEH_elevationStatus m113 : 34|1@1+ (1,0) [0|0] "" Vector__XXX
 SG_ EPBL_a114_CH_party3 m114 : 34|1@1+ (1,0) [0|0] "" Vector__XXX
 SG_ EPBL_a116_VEH_thermalCommand m116 : 34|1@1+ (1,0) [0|0] "" Vector__XXX
 SG_ EPBL_a117_VEH_liftgateStatus m117 : 34|1@1+ (1,0) [0|0] "" Vector__XXX
 SG_ EPBL_a118_CH_lighting m118 : 34|1@1+ (1,0) [0|0] "" Vector__XXX
 SG_ EPBL_a120_PT_systemPower m120 : 34|1@1+ (1,0) [0|0] "" Vector__XXX
 SG_ EPBL_a210_driverSeated m210 : 34|2@1+ (1,0) [0|0] "" Vector__XXX
 SG_ EPBL_a253_driverParkRequest m253 : 34|1@1+ (1,0) [0|0] "" Vector__XXX
 SG_ EPBL_a256_activeDecelRequest m256 : 34|1@1+ (1,0) [0|0] "" Vector__XXX
 SG_ EPBL_a262_dirLVOn m262 : 34|1@1+ (1,0) [0|0] "" Vector__XXX
 SG_ EPBL_a264_hvDownForMoreThanTwoMi m264 : 34|1@1+ (1,0) [0|0] "" Vector__XXX
 SG_ EPBL_a352_prevFilteredCurrent m352 : 34|8@1+ (0.1,0) [0|0] "" Vector__XXX
 SG_ EPBL_a016_NVMMCRCMismatch m16 : 33|1@1+ (1,0) [0|0] "" Vector__XXX
 SG_ EPBL_a104_PARTY_integratedSafety m104 : 33|1@1+ (1,0) [0|0] "" Vector__XXX
 SG_ EPBL_a110_PARTY_carConfig m110 : 33|1@1+ (1,0) [0|0] "" Vector__XXX
 SG_ EPBL_a113_VEH_status m113 : 33|1@1+ (1,0) [0|0] "" Vector__XXX
 SG_ EPBL_a114_CH_party1 m114 : 33|1@1+ (1,0) [0|0] "" Vector__XXX
 SG_ EPBL_a116_VEH_status m116 : 33|1@1+ (1,0) [0|0] "" Vector__XXX
 SG_ EPBL_a117_VEH_intrusionSensorSta m117 : 33|1@1+ (1,0) [0|0] "" Vector__XXX
 SG_ EPBL_a118_VEH_interNodeResistanc m118 : 33|1@1+ (1,0) [0|0] "" Vector__XXX
 SG_ EPBL_a120_VEH_autonomyHealth m120 : 33|1@1+ (1,0) [0|0] "" Vector__XXX
 SG_ EPBL_a253_isDriverLeaving m253 : 33|1@1+ (1,0) [0|0] "" Vector__XXX
 SG_ EPBL_a256_diStandStillApply m256 : 33|1@1+ (1,0) [0|0] "" Vector__XXX
 SG_ EPBL_a262_hvDownForMoreThanTwoMi m262 : 33|1@1+ (1,0) [0|0] "" Vector__XXX
 SG_ EPBL_a263_isJumpPostTripped m263 : 33|1@1+ (1,0) [0|0] "" Vector__XXX
 SG_ EPBL_a264_ignoreLvBatteryCanSupp m264 : 33|1@1+ (1,0) [0|0] "" Vector__XXX
 SG_ EPBL_a000_alertDataW1 m0 : 32|16@1+ (1,0) [0|0] "" Vector__XXX
 SG_ EPBL_a003_LineNumber m3 : 32|16@1+ (1,0) [0|0] "" Vector__XXX
 SG_ EPBL_a005_busID1 m5 : 32|4@1+ (1,0) [0|0] "" Vector__XXX
 SG_ EPBL_a006_messageID m6 : 32|29@1+ (1,0) [0|0] "" Vector__XXX
 SG_ EPBL_a016_NVMMRecordNotFound m16 : 32|1@1+ (1,0) [0|0] "" Vector__XXX
 SG_ EPBL_a022_TaskInitError1 m22 : 32|8@1+ (1,0) [0|0] "" Vector__XXX
 SG_ EPBL_a031_uds_bytes_2 m31 : 32|8@1+ (1,0) [0|0] "" Vector__XXX
 SG_ EPBL_a041_CPULoad10msTask m41 : 32|8@1+ (1,0) [0|0] "" Vector__XXX
 SG_ EPBL_a042_Usage100msTask m42 : 32|8@1+ (1,0) [0|0] "" Vector__XXX
 SG_ EPBL_a063_ADCVoltage m63 : 32|8@1+ (0.025,0) [0|0] "" Vector__XXX
 SG_ EPBL_a104_VEH_steeringControl m104 : 32|1@1+ (1,0) [0|0] "" Vector__XXX
 SG_ EPBL_a110_CH_epochTimeGtw m110 : 32|1@1+ (1,0) [0|0] "" Vector__XXX
 SG_ EPBL_a113_VEH_debugECU m113 : 32|1@1+ (1,0) [0|0] "" Vector__XXX
 SG_ EPBL_a114_BDY_wheelSpeeds m114 : 32|1@1+ (1,0) [0|0] "" Vector__XXX
 SG_ EPBL_a116_VEH_seatStatus2 m116 : 32|1@1+ (1,0) [0|0] "" Vector__XXX
 SG_ EPBL_a117_VEH_switchStatus m117 : 32|1@1+ (1,0) [0|0] "" Vector__XXX
 SG_ EPBL_a118_CH_sensors m118 : 32|1@1+ (1,0) [0|0] "" Vector__XXX
 SG_ EPBL_a120_PARTY_autonomyHealth m120 : 32|1@1+ (1,0) [0|0] "" Vector__XXX
 SG_ EPBL_a173_csmState m173 : 32|4@1+ (1,0) [0|0] "" Vector__XXX
 SG_ EPBL_a174_monitorUnitStatus m174 : 32|5@1+ (1,0) [0|0] "" Vector__XXX
 SG_ EPBL_a175_monitorUnitStatus m175 : 32|5@1+ (1,0) [0|0] "" Vector__XXX
 SG_ EPBL_a176_monitorUnitStatus m176 : 32|5@1+ (1,0) [0|0] "" Vector__XXX
 SG_ EPBL_a177_monitorUnitStatus m177 : 32|5@1+ (1,0) [0|0] "" Vector__XXX
 SG_ EPBL_a179_monitorUnitStatus m179 : 32|5@1+ (1,0) [0|0] "" Vector__XXX
 SG_ EPBL_a180_nextState m180 : 32|5@1+ (1,0) [0|0] "" Vector__XXX
 SG_ EPBL_a182_temperature m182 : 32|8@1+ (0.5,-40) [0|0] "" Vector__XXX
 SG_ EPBL_a183_esmStateRequest m183 : 32|5@1+ (1,0) [0|0] "" Vector__XXX
 SG_ EPBL_a184_nextState m184 : 32|5@1+ (1,0) [0|0] "" Vector__XXX
 SG_ EPBL_a186_nextState m186 : 32|5@1+ (1,0) [0|0] "" Vector__XXX
 SG_ EPBL_a187_nextState m187 : 32|5@1+ (1,0) [0|0] "" Vector__XXX
 SG_ EPBL_a188_nextState m188 : 32|5@1+ (1,0) [0|0] "" Vector__XXX
 SG_ EPBL_a189_nextState m189 : 32|5@1+ (1,0) [0|0] "" Vector__XXX
 SG_ EPBL_a190_monitorUnitStatus m190 : 32|5@1+ (1,0) [0|0] "" Vector__XXX
 SG_ EPBL_a191_monitorUnitStatus m191 : 32|5@1+ (1,0) [0|0] "" Vector__XXX
 SG_ EPBL_a210_driverBuckled m210 : 32|2@1+ (1,0) [0|0] "" Vector__XXX
 SG_ EPBL_a216_byte1 m216 : 32|8@1+ (1,0) [0|0] "" Vector__XXX
 SG_ EPBL_a217_byte6 m217 : 32|8@1+ (1,0) [0|0] "" Vector__XXX
 SG_ EPBL_a225_nextState m225 : 32|5@1+ (1,0) [0|0] "" Vector__XXX
 SG_ EPBL_a246_esmStateRequest m246 : 32|5@1+ (1,0) [0|0] "" Vector__XXX
 SG_ EPBL_a247_monitorUnitStatus m247 : 32|5@1+ (1,0) [0|0] "" Vector__XXX
 SG_ EPBL_a248_monitorUnitStatus m248 : 32|5@1+ (1,0) [0|0] "" Vector__XXX
 SG_ EPBL_a249_esmStateRequest m249 : 32|5@1+ (1,0) [0|0] "" Vector__XXX
 SG_ EPBL_a251_pistonPosition m251 : 32|13@1- (9.768009768009769,0) [0|0] "" Vector__XXX
 SG_ EPBL_a253_diStandStillApply m253 : 32|1@1+ (1,0) [0|0] "" Vector__XXX
 SG_ EPBL_a256_passiveApplyRequested m256 : 32|1@1+ (1,0) [0|0] "" Vector__XXX
 SG_ EPBL_a262_wasHVUpSinceLastWake m262 : 32|1@1+ (1,0) [0|0] "" Vector__XXX
 SG_ EPBL_a263_isPowerStateParkReques m263 : 32|1@1+ (1,0) [0|0] "" Vector__XXX
 SG_ EPBL_a264_lvBatteryCanSupportVeh m264 : 32|1@1+ (1,0) [0|0] "" Vector__XXX
 SG_ EPBL_a301_oocConfidence m301 : 32|12@1+ (1,0) [0|0] "" Vector__XXX
 SG_ EPBL_a302_deltaCurrent m302 : 32|15@1+ (0.01,0) [0|0] "" Vector__XXX
 SG_ EPBL_a303_pistonPosition m303 : 32|13@1- (9.768009768009769,0) [0|0] "" Vector__XXX
 SG_ EPBL_a350_ensDuty m350 : 32|10@1+ (0.00098,0) [0|0] "" Vector__XXX
 SG_ EPBL_a357_ambientTemp m357 : 32|8@1+ (0.5,-40) [0|0] "" Vector__XXX
 SG_ EPBL_a358_ambientTemp m358 : 32|8@1+ (0.5,-40) [0|0] "" Vector__XXX
 SG_ EPBL_a365_ambientTemp m365 : 32|8@1+ (0.5,-40) [0|0] "" Vector__XXX
 SG_ EPBL_a366_ambientTemp m366 : 32|8@1+ (0.5,-40) [0|0] "" Vector__XXX
 SG_ EPBL_a370_count m370 : 32|16@1+ (1,0) [0|0] "" Vector__XXX
 SG_ EPBL_a104_CH_steeringControl m104 : 31|1@1+ (1,0) [0|0] "" Vector__XXX
 SG_ EPBL_a109_CH_status m109 : 31|1@1+ (1,0) [0|0] "" Vector__XXX
 SG_ EPBL_a110_CH_chNm m110 : 31|1@1+ (1,0) [0|0] "" Vector__XXX
 SG_ EPBL_a113_VEH_ventCntlReg m113 : 31|1@1+ (1,0) [0|0] "" Vector__XXX
 SG_ EPBL_a114_BDY_wheelRotation m114 : 31|1@1+ (1,0) [0|0] "" Vector__XXX
 SG_ EPBL_a116_VEH_logging1Hz m116 : 31|1@1+ (1,0) [0|0] "" Vector__XXX
 SG_ EPBL_a117_VEH_windowStatus m117 : 31|1@1+ (1,0) [0|0] "" Vector__XXX
 SG_ EPBL_a118_PARTY_sensors m118 : 31|1@1+ (1,0) [0|0] "" Vector__XXX
 SG_ EPBL_a120_VEH_systemPower m120 : 31|1@1+ (1,0) [0|0] "" Vector__XXX
 SG_ EPBL_a253_passiveApplyRequested m253 : 31|1@1+ (1,0) [0|0] "" Vector__XXX
 SG_ EPBL_a256_vehiclePowerState m256 : 31|1@1+ (1,0) [0|0] "" Vector__XXX
 SG_ EPBL_a262_hvUp m262 : 31|1@1+ (1,0) [0|0] "" Vector__XXX
 SG_ EPBL_a264_chargeCableStateUnknow m264 : 31|1@1+ (1,0) [0|0] "" Vector__XXX
 SG_ EPBL_a104_PARTY_steeringControl m104 : 30|1@1+ (1,0) [0|0] "" Vector__XXX
 SG_ EPBL_a109_CH_inertial2 m109 : 30|1@1+ (1,0) [0|0] "" Vector__XXX
 SG_ EPBL_a110_CH_vin m110 : 30|1@1+ (1,0) [0|0] "" Vector__XXX
 SG_ EPBL_a113_VEH_driverProfile_0000 m113 : 30|1@1+ (1,0) [0|0] "" Vector__XXX
 SG_ EPBL_a114_BDY_status m114 : 30|1@1+ (1,0) [0|0] "" Vector__XXX
 SG_ EPBL_a116_VEH_switchStatus m116 : 30|1@1+ (1,0) [0|0] "" Vector__XXX
 SG_ EPBL_a117_VEH_doorStatus2 m117 : 30|1@1+ (1,0) [0|0] "" Vector__XXX
 SG_ EPBL_a118_CH_LVPowerState m118 : 30|1@1+ (1,0) [0|0] "" Vector__XXX
 SG_ EPBL_a120_PARTY_aggregatedAxleSp m120 : 30|1@1+ (1,0) [0|0] "" Vector__XXX
 SG_ EPBL_a210_secondaryDriverDoorClo m210 : 30|2@1+ (1,0) [0|0] "" Vector__XXX
 SG_ EPBL_a250_isJumpPostTripped m250 : 30|1@1+ (1,0) [0|0] "" Vector__XXX
 SG_ EPBL_a262_uiServiceModePlus m262 : 30|1@1+ (1,0) [0|0] "" Vector__XXX
 SG_ EPBL_a264_diDriveMode m264 : 30|1@1+ (1,0) [0|0] "" Vector__XXX
 SG_ EPBL_a098_VEH_motorStatus m98 : 29|1@1+ (1,0) [0|0] "" Vector__XXX
 SG_ EPBL_a104_PARTY_status m104 : 29|1@1+ (1,0) [0|0] "" Vector__XXX
 SG_ EPBL_a107_VEH_chargeInfo m107 : 29|1@1+ (1,0) [0|0] "" Vector__XXX
 SG_ EPBL_a108_CH_torque m108 : 29|1@1+ (1,0) [0|0] "" Vector__XXX
 SG_ EPBL_a109_CH_inertial1 m109 : 29|1@1+ (1,0) [0|0] "" Vector__XXX
 SG_ EPBL_a110_CH_carState m110 : 29|1@1+ (1,0) [0|0] "" Vector__XXX
 SG_ EPBL_a113_VEH_driverProfileRecal m113 : 29|1@1+ (1,0) [0|0] "" Vector__XXX
 SG_ EPBL_a114_BDY_party3 m114 : 29|1@1+ (1,0) [0|0] "" Vector__XXX
 SG_ EPBL_a116_VEH_restraintStatus m116 : 29|1@1+ (1,0) [0|0] "" Vector__XXX
 SG_ EPBL_a117_VEH_doorStatus m117 : 29|1@1+ (1,0) [0|0] "" Vector__XXX
 SG_ EPBL_a118_VEH_thermalCommand m118 : 29|1@1+ (1,0) [0|0] "" Vector__XXX
 SG_ EPBL_a120_VEH_aggregatedAxleSpee m120 : 29|1@1+ (1,0) [0|0] "" Vector__XXX
 SG_ EPBL_a174_faultStatus m174 : 29|2@1+ (1,0) [0|0] "" Vector__XXX
 SG_ EPBL_a175_faultStatus m175 : 29|2@1+ (1,0) [0|0] "" Vector__XXX
 SG_ EPBL_a176_faultStatus m176 : 29|2@1+ (1,0) [0|0] "" Vector__XXX
 SG_ EPBL_a177_faultStatus m177 : 29|2@1+ (1,0) [0|0] "" Vector__XXX
 SG_ EPBL_a179_faultStatus m179 : 29|2@1+ (1,0) [0|0] "" Vector__XXX
 SG_ EPBL_a190_faultStatus m190 : 29|2@1+ (1,0) [0|0] "" Vector__XXX
 SG_ EPBL_a191_faultStatus m191 : 29|2@1+ (1,0) [0|0] "" Vector__XXX
 SG_ EPBL_a247_faultStatus m247 : 29|2@1+ (1,0) [0|0] "" Vector__XXX
 SG_ EPBL_a248_faultStatus m248 : 29|2@1+ (1,0) [0|0] "" Vector__XXX
 SG_ EPBL_a253_lvStatusReadyforDrive m253 : 29|2@1+ (1,0) [0|0] "" Vector__XXX
 SG_ EPBL_a256_lvStatusReadyforDrive m256 : 29|2@1+ (1,0) [0|0] "" Vector__XXX
 SG_ EPBL_a262_uiServiceMode m262 : 29|1@1+ (1,0) [0|0] "" Vector__XXX
 SG_ EPBL_a263_esmSpeedClass m263 : 29|3@1+ (1,0) [0|0] "" Vector__XXX
 SG_ EPBL_a264_vehiclePowerStateDrive m264 : 29|1@1+ (1,0) [0|0] "" Vector__XXX
 SG_ EPBL_a058_current m58 : 28|11@1+ (0.1,0) [0|0] "" Vector__XXX
 SG_ EPBL_a059_resistanceEstimate m59 : 28|12@1+ (0.00244,0) [0|0] "" Vector__XXX
 SG_ EPBL_a098_PARTY_motorStatus m98 : 28|1@1+ (1,0) [0|0] "" Vector__XXX
 SG_ EPBL_a104_CH_status m104 : 28|1@1+ (1,0) [0|0] "" Vector__XXX
 SG_ EPBL_a107_VEH_energyStatus m107 : 28|1@1+ (1,0) [0|0] "" Vector__XXX
 SG_ EPBL_a108_VEH_motorStatus m108 : 28|1@1+ (1,0) [0|0] "" Vector__XXX
 SG_ EPBL_a109_VEH_inertial2 m109 : 28|1@1+ (1,0) [0|0] "" Vector__XXX
 SG_ EPBL_a110_CH_carConfig m110 : 28|1@1+ (1,0) [0|0] "" Vector__XXX
 SG_ EPBL_a113_VEH_vehicleModes m113 : 28|1@1+ (1,0) [0|0] "" Vector__XXX
 SG_ EPBL_a114_BDY_offsets m114 : 28|1@1+ (1,0) [0|0] "" Vector__XXX
 SG_ EPBL_a116_VEH_seatHeatStatus m116 : 28|1@1+ (1,0) [0|0] "" Vector__XXX
 SG_ EPBL_a117_BDY_falconSwitchStatus m117 : 28|1@1+ (1,0) [0|0] "" Vector__XXX
 SG_ EPBL_a118_PARTY_vehicleTime m118 : 28|1@1+ (1,0) [0|0] "" Vector__XXX
 SG_ EPBL_a120_PARTY_vehicleEstimates m120 : 28|1@1+ (1,0) [0|0] "" Vector__XXX
 SG_ EPBL_a125_nvFilt m125 : 28|12@1+ (0.005443676098,0) [0|0] "" Vector__XXX
 SG_ EPBL_a126_nvFilt m126 : 28|12@1+ (0.005443676098,0) [0|0] "" Vector__XXX
 SG_ EPBL_a127_nvFilt m127 : 28|12@1+ (0.005443676098,0) [0|0] "" Vector__XXX
 SG_ EPBL_a128_nvFilt m128 : 28|12@1+ (0.005443676098,0) [0|0] "" Vector__XXX
 SG_ EPBL_a134_nvFilt m134 : 28|12@1+ (0.005443676098,0) [0|0] "" Vector__XXX
 SG_ EPBL_a135_nvFilt m135 : 28|12@1+ (0.005443676098,0) [0|0] "" Vector__XXX
 SG_ EPBL_a136_nvFilt m136 : 28|12@1+ (0.005443676098,0) [0|0] "" Vector__XXX
 SG_ EPBL_a137_nvFilt m137 : 28|12@1+ (0.005443676098,0) [0|0] "" Vector__XXX
 SG_ EPBL_a170_nvFilt m170 : 28|12@1+ (0.005443676098,0) [0|0] "" Vector__XXX
 SG_ EPBL_a171_nvFilt m171 : 28|12@1+ (0.005443676098,0) [0|0] "" Vector__XXX
 SG_ EPBL_a210_primaryDriverDoorClose m210 : 28|2@1+ (1,0) [0|0] "" Vector__XXX
 SG_ EPBL_a241_hasLockoutRequest m241 : 28|1@1+ (1,0) [0|0] "" Vector__XXX
 SG_ EPBL_a242_hasLockoutRequest m242 : 28|1@1+ (1,0) [0|0] "" Vector__XXX
 SG_ EPBL_a262_ignoreLvBatteryCanSupp m262 : 28|1@1+ (1,0) [0|0] "" Vector__XXX
 SG_ EPBL_a264_jumpPostConfirmedTripp m264 : 28|1@1+ (1,0) [0|0] "" Vector__XXX
 SG_ EPBL_a362_outputRodDriver m362 : 28|10@1+ (0.1,-10) [0|0] "" Vector__XXX
 SG_ EPBL_a363_outputRodDriver m363 : 28|10@1+ (0.1,-10) [0|0] "" Vector__XXX
 SG_ EPBL_a021_Task1000msMissed m21 : 27|1@1+ (1,0) [0|0] "" Vector__XXX
 SG_ EPBL_a098_PT_temperature m98 : 27|1@1+ (1,0) [0|0] "" Vector__XXX
 SG_ EPBL_a104_PARTY_gpsAccuracies m104 : 27|1@1+ (1,0) [0|0] "" Vector__XXX
 SG_ EPBL_a107_VEH_packConfig m107 : 27|1@1+ (1,0) [0|0] "" Vector__XXX
 SG_ EPBL_a108_PARTY_motorStatus m108 : 27|1@1+ (1,0) [0|0] "" Vector__XXX
 SG_ EPBL_a109_VEH_inertial1 m109 : 27|1@1+ (1,0) [0|0] "" Vector__XXX
 SG_ EPBL_a110_CH_airbagCutoffStatus m110 : 27|1@1+ (1,0) [0|0] "" Vector__XXX
 SG_ EPBL_a111_CH_status m111 : 27|1@1+ (1,0) [0|0] "" Vector__XXX
 SG_ EPBL_a113_VEH_powertrainControl m113 : 27|1@1+ (1,0) [0|0] "" Vector__XXX
 SG_ EPBL_a114_PARTY_offsets m114 : 27|1@1+ (1,0) [0|0] "" Vector__XXX
 SG_ EPBL_a116_VEH_doorStatus m116 : 27|1@1+ (1,0) [0|0] "" Vector__XXX
 SG_ EPBL_a117_VEH_seatStatus m117 : 27|1@1+ (1,0) [0|0] "" Vector__XXX
 SG_ EPBL_a118_PARTY_outputPowerStatu m118 : 27|1@1+ (1,0) [0|0] "" Vector__XXX
 SG_ EPBL_a120_PT_systemStatus m120 : 27|1@1+ (1,0) [0|0] "" Vector__XXX
 SG_ EPBL_a210_remoteDriverIsLeavingA m210 : 27|1@1+ (1,0) [0|0] "" Vector__XXX
 SG_ EPBL_a241_monitorDataGood m241 : 27|1@1+ (1,0) [0|0] "" Vector__XXX
 SG_ EPBL_a242_monitorDataGood m242 : 27|1@1+ (1,0) [0|0] "" Vector__XXX
 SG_ EPBL_a243_brakeDiscWipingActive m243 : 27|1@1+ (1,0) [0|0] "" Vector__XXX
 SG_ EPBL_a262_lvBatteryCanSupportVeh m262 : 27|1@1+ (1,0) [0|0] "" Vector__XXX
 SG_ EPBL_a264_vehicleSpeedUnknown m264 : 27|1@1+ (1,0) [0|0] "" Vector__XXX
 SG_ EPBL_a021_Task1000msStarved m21 : 26|1@1+ (1,0) [0|0] "" Vector__XXX
 SG_ EPBL_a098_PT_thermalControl m98 : 26|1@1+ (1,0) [0|0] "" Vector__XXX
 SG_ EPBL_a104_PARTY_bodyControls m104 : 26|1@1+ (1,0) [0|0] "" Vector__XXX
 SG_ EPBL_a107_VEH_socStatus m107 : 26|1@1+ (1,0) [0|0] "" Vector__XXX
 SG_ EPBL_a108_PT_thermalControl m108 : 26|1@1+ (1,0) [0|0] "" Vector__XXX
 SG_ EPBL_a109_BDY_status m109 : 26|1@1+ (1,0) [0|0] "" Vector__XXX
 SG_ EPBL_a110_VEH_canLogAvailability m110 : 26|1@1+ (1,0) [0|0] "" Vector__XXX
 SG_ EPBL_a111_PARTY_status m111 : 26|1@1+ (1,0) [0|0] "" Vector__XXX
 SG_ EPBL_a112_CH_status m112 : 26|1@1+ (1,0) [0|0] "" Vector__XXX
 SG_ EPBL_a113_VEH_trackModeSettings m113 : 26|1@1+ (1,0) [0|0] "" Vector__XXX
 SG_ EPBL_a114_PARTY_brakeTorque m114 : 26|1@1+ (1,0) [0|0] "" Vector__XXX
 SG_ EPBL_a116_VEH_thsStatus m116 : 26|1@1+ (1,0) [0|0] "" Vector__XXX
 SG_ EPBL_a117_VEH_lightStatus m117 : 26|1@1+ (1,0) [0|0] "" Vector__XXX
 SG_ EPBL_a118_PARTY_LVPowerState m118 : 26|1@1+ (1,0) [0|0] "" Vector__XXX
 SG_ EPBL_a120_PT_speed m120 : 26|1@1+ (1,0) [0|0] "" Vector__XXX
 SG_ EPBL_a210_remoteDriverIsLeaving m210 : 26|1@1+ (1,0) [0|0] "" Vector__XXX
 SG_ EPBL_a241_highCurrent m241 : 26|1@1+ (1,0) [0|0] "" Vector__XXX
 SG_ EPBL_a242_highCurrent m242 : 26|1@1+ (1,0) [0|0] "" Vector__XXX
 SG_ EPBL_a243_vehiclePowerState m243 : 26|1@1+ (1,0) [0|0] "" Vector__XXX
 SG_ EPBL_a262_chargeCableStateUnknow m262 : 26|1@1+ (1,0) [0|0] "" Vector__XXX
 SG_ EPBL_a264_vehicleSpeedTooFast m264 : 26|1@1+ (1,0) [0|0] "" Vector__XXX
 SG_ EPBL_a352_maxCurrent m352 : 26|8@1+ (0.1,0) [0|0] "" Vector__XXX
 SG_ EPBL_a021_Task1000msLate m21 : 25|1@1+ (1,0) [0|0] "" Vector__XXX
 SG_ EPBL_a089_VEH_party3 m89 : 25|1@1+ (1,0) [0|0] "" Vector__XXX
 SG_ EPBL_a098_PARTY_torque m98 : 25|1@1+ (1,0) [0|0] "" Vector__XXX
 SG_ EPBL_a104_PARTY_control m104 : 25|1@1+ (1,0) [0|0] "" Vector__XXX
 SG_ EPBL_a107_PT_socStatus m107 : 25|1@1+ (1,0) [0|0] "" Vector__XXX
 SG_ EPBL_a108_PT_temperature m108 : 25|1@1+ (1,0) [0|0] "" Vector__XXX
 SG_ EPBL_a109_BDY_inertial2 m109 : 25|1@1+ (1,0) [0|0] "" Vector__XXX
 SG_ EPBL_a110_VEH_gearControl m110 : 25|1@1+ (1,0) [0|0] "" Vector__XXX
 SG_ EPBL_a111_VEH_seatStatus m111 : 25|1@1+ (1,0) [0|0] "" Vector__XXX
 SG_ EPBL_a112_PARTY_status m112 : 25|1@1+ (1,0) [0|0] "" Vector__XXX
 SG_ EPBL_a113_VEH_chassisControl m113 : 25|1@1+ (1,0) [0|0] "" Vector__XXX
 SG_ EPBL_a114_VEH_wheelRotation m114 : 25|1@1+ (1,0) [0|0] "" Vector__XXX
 SG_ EPBL_a116_VEH_seatStatus m116 : 25|1@1+ (1,0) [0|0] "" Vector__XXX
 SG_ EPBL_a117_VEH_restraintStatus m117 : 25|1@1+ (1,0) [0|0] "" Vector__XXX
 SG_ EPBL_a118_VEH_systemStatus m118 : 25|1@1+ (1,0) [0|0] "" Vector__XXX
 SG_ EPBL_a120_PARTY_status m120 : 25|1@1+ (1,0) [0|0] "" Vector__XXX
 SG_ EPBL_a181_trailerDetected m181 : 25|1@1+ (1,0) [0|0] "" Vector__XXX
 SG_ EPBL_a198_currentAvg m198 : 25|12@1+ (0.01,0) [0|0] "" Vector__XXX
 SG_ EPBL_a210_localDriverIsLeavingAn m210 : 25|1@1+ (1,0) [0|0] "" Vector__XXX
 SG_ EPBL_a243_wiperSpeed m243 : 25|1@1+ (1,0) [0|0] "" Vector__XXX
 SG_ EPBL_a262_lvBatteryBlocking m262 : 25|1@1+ (1,0) [0|0] "" Vector__XXX
 SG_ EPBL_a264_lvBatteryBlocking m264 : 25|1@1+ (1,0) [0|0] "" Vector__XXX
 SG_ EPBL_a006_mailboxID m6 : 24|8@1+ (1,0) [0|0] "" Vector__XXX
 SG_ EPBL_a021_Task100msMissed m21 : 24|1@1+ (1,0) [0|0] "" Vector__XXX
 SG_ EPBL_a022_TaskInitError0 m22 : 24|8@1+ (1,0) [0|0] "" Vector__XXX
 SG_ EPBL_a031_uds_bytes_1 m31 : 24|8@1+ (1,0) [0|0] "" Vector__XXX
 SG_ EPBL_a041_CPULoad1msTask m41 : 24|8@1+ (1,0) [0|0] "" Vector__XXX
 SG_ EPBL_a042_Usage10msTask m42 : 24|8@1+ (1,0) [0|0] "" Vector__XXX
 SG_ EPBL_a063_switchType m63 : 24|8@1+ (1,0) [0|0] "" Vector__XXX
 SG_ EPBL_a086_VEH_vehNm m86 : 24|1@1+ (1,0) [0|0] "" Vector__XXX
 SG_ EPBL_a087_VEH_motorStatus m87 : 24|1@1+ (1,0) [0|0] "" Vector__XXX
 SG_ EPBL_a088_VEH_motorStatus m88 : 24|1@1+ (1,0) [0|0] "" Vector__XXX
 SG_ EPBL_a089_VEH_party1 m89 : 24|1@1+ (1,0) [0|0] "" Vector__XXX
 SG_ EPBL_a098_PARTY_thermalControl m98 : 24|1@1+ (1,0) [0|0] "" Vector__XXX
 SG_ EPBL_a104_CH_control m104 : 24|1@1+ (1,0) [0|0] "" Vector__XXX
 SG_ EPBL_a107_PT_thermalStatus m107 : 24|1@1+ (1,0) [0|0] "" Vector__XXX
 SG_ EPBL_a108_PARTY_thermalControl m108 : 24|1@1+ (1,0) [0|0] "" Vector__XXX
 SG_ EPBL_a109_BDY_inertial1 m109 : 24|1@1+ (1,0) [0|0] "" Vector__XXX
 SG_ EPBL_a110_VEH_bmpDebug m110 : 24|1@1+ (1,0) [0|0] "" Vector__XXX
 SG_ EPBL_a111_VEH_LVPowerState m111 : 24|1@1+ (1,0) [0|0] "" Vector__XXX
 SG_ EPBL_a112_VEH_LVPowerState m112 : 24|1@1+ (1,0) [0|0] "" Vector__XXX
 SG_ EPBL_a113_VEH_ventCntlReq m113 : 24|1@1+ (1,0) [0|0] "" Vector__XXX
 SG_ EPBL_a114_CH_wheelRotation m114 : 24|1@1+ (1,0) [0|0] "" Vector__XXX
 SG_ EPBL_a116_VEH_lightStatus m116 : 24|1@1+ (1,0) [0|0] "" Vector__XXX
 SG_ EPBL_a117_VEH_LVPowerState m117 : 24|1@1+ (1,0) [0|0] "" Vector__XXX
 SG_ EPBL_a118_VEH_12VBatteryStatus m118 : 24|1@1+ (1,0) [0|0] "" Vector__XXX
 SG_ EPBL_a120_VEH_speed m120 : 24|1@1+ (1,0) [0|0] "" Vector__XXX
 SG_ EPBL_a141_toState m141 : 24|5@1+ (1,0) [0|0] "" Vector__XXX
 SG_ EPBL_a173_esmStateRequest m173 : 24|5@1+ (1,0) [0|0] "" Vector__XXX
 SG_ EPBL_a174_esmStateRequest m174 : 24|5@1+ (1,0) [0|0] "" Vector__XXX
 SG_ EPBL_a175_esmStateRequest m175 : 24|5@1+ (1,0) [0|0] "" Vector__XXX
 SG_ EPBL_a176_esmStateRequest m176 : 24|5@1+ (1,0) [0|0] "" Vector__XXX
 SG_ EPBL_a177_esmStateRequest m177 : 24|5@1+ (1,0) [0|0] "" Vector__XXX
 SG_ EPBL_a179_esmStateRequest m179 : 24|5@1+ (1,0) [0|0] "" Vector__XXX
 SG_ EPBL_a180_previousState m180 : 24|5@1+ (1,0) [0|0] "" Vector__XXX
 SG_ EPBL_a181_uiTrailerDetected m181 : 24|1@1+ (1,0) [0|0] "" Vector__XXX
 SG_ EPBL_a182_grade m182 : 24|7@1- (1,0) [0|0] "" Vector__XXX
 SG_ EPBL_a183_esmState m183 : 24|5@1+ (1,0) [0|0] "" Vector__XXX
 SG_ EPBL_a184_previousState m184 : 24|5@1+ (1,0) [0|0] "" Vector__XXX
 SG_ EPBL_a186_previousState m186 : 24|5@1+ (1,0) [0|0] "" Vector__XXX
 SG_ EPBL_a187_previousState m187 : 24|5@1+ (1,0) [0|0] "" Vector__XXX
 SG_ EPBL_a188_previousState m188 : 24|5@1+ (1,0) [0|0] "" Vector__XXX
 SG_ EPBL_a189_previousState m189 : 24|5@1+ (1,0) [0|0] "" Vector__XXX
 SG_ EPBL_a190_esmStateRequest m190 : 24|5@1+ (1,0) [0|0] "" Vector__XXX
 SG_ EPBL_a191_esmStateRequest m191 : 24|5@1+ (1,0) [0|0] "" Vector__XXX
 SG_ EPBL_a210_localDriverIsLeaving m210 : 24|1@1+ (1,0) [0|0] "" Vector__XXX
 SG_ EPBL_a216_byte0 m216 : 24|8@1+ (1,0) [0|0] "" Vector__XXX
 SG_ EPBL_a217_byte5 m217 : 24|8@1+ (1,0) [0|0] "" Vector__XXX
 SG_ EPBL_a225_previousState m225 : 24|5@1+ (1,0) [0|0] "" Vector__XXX
 SG_ EPBL_a241_vehiclePowerState m241 : 24|2@1+ (1,0) [0|0] "" Vector__XXX
 SG_ EPBL_a242_vehiclePowerState m242 : 24|2@1+ (1,0) [0|0] "" Vector__XXX
 SG_ EPBL_a243_thermistorTMin m243 : 24|1@1+ (1,0) [0|0] "" Vector__XXX
 SG_ EPBL_a246_nextState m246 : 24|5@1+ (1,0) [0|0] "" Vector__XXX
 SG_ EPBL_a247_esmStateRequest m247 : 24|5@1+ (1,0) [0|0] "" Vector__XXX
 SG_ EPBL_a248_esmStateRequest m248 : 24|5@1+ (1,0) [0|0] "" Vector__XXX
 SG_ EPBL_a249_nextState m249 : 24|5@1+ (1,0) [0|0] "" Vector__XXX
 SG_ EPBL_a250_esmOperationTrigger m250 : 24|6@1+ (1,0) [0|0] "" Vector__XXX
 SG_ EPBL_a253_esmStateRequest m253 : 24|5@1+ (1,0) [0|0] "" Vector__XXX
 SG_ EPBL_a256_esmStateRequest m256 : 24|5@1+ (1,0) [0|0] "" Vector__XXX
 SG_ EPBL_a262_showroomModeActive m262 : 24|1@1+ (1,0) [0|0] "" Vector__XXX
 SG_ EPBL_a263_esmStateRequest m263 : 24|5@1+ (1,0) [0|0] "" Vector__XXX
 SG_ EPBL_a264_chargeCableDefinitelyA m264 : 24|1@1+ (1,0) [0|0] "" Vector__XXX
 SG_ EPBL_a300_subUsageId m300 : 24|8@1+ (1,0) [0|0] "" Vector__XXX
 SG_ EPBL_a357_grade m357 : 24|7@1- (1,0) [0|0] "" Vector__XXX
 SG_ EPBL_a358_grade m358 : 24|7@1- (1,0) [0|0] "" Vector__XXX
 SG_ EPBL_a365_grade m365 : 24|7@1- (1,0) [0|0] "" Vector__XXX
 SG_ EPBL_a366_grade m366 : 24|7@1- (1,0) [0|0] "" Vector__XXX
 SG_ EPBL_a021_Task100msStarved m21 : 23|1@1+ (1,0) [0|0] "" Vector__XXX
 SG_ EPBL_a086_VEH_thermalStatus m86 : 23|1@1+ (1,0) [0|0] "" Vector__XXX
 SG_ EPBL_a087_PARTY_thermalControl m87 : 23|1@1+ (1,0) [0|0] "" Vector__XXX
 SG_ EPBL_a088_PARTY_thermalControl m88 : 23|1@1+ (1,0) [0|0] "" Vector__XXX
 SG_ EPBL_a089_CH_party3 m89 : 23|1@1+ (1,0) [0|0] "" Vector__XXX
 SG_ EPBL_a098_PARTY_temperature m98 : 23|1@1+ (1,0) [0|0] "" Vector__XXX
 SG_ EPBL_a104_VEH_thermalStatus m104 : 23|1@1+ (1,0) [0|0] "" Vector__XXX
 SG_ EPBL_a107_PT_status m107 : 23|1@1+ (1,0) [0|0] "" Vector__XXX
 SG_ EPBL_a108_PARTY_temperature m108 : 23|1@1+ (1,0) [0|0] "" Vector__XXX
 SG_ EPBL_a109_BDY_imuOffsets m109 : 23|1@1+ (1,0) [0|0] "" Vector__XXX
 SG_ EPBL_a110_VEH_vin m110 : 23|1@1+ (1,0) [0|0] "" Vector__XXX
 SG_ EPBL_a111_RIPC_switchStatus m111 : 23|1@1+ (1,0) [0|0] "" Vector__XXX
 SG_ EPBL_a112_LIPC_switchStatus m112 : 23|1@1+ (1,0) [0|0] "" Vector__XXX
 SG_ EPBL_a113_VEH_solarData m113 : 23|1@1+ (1,0) [0|0] "" Vector__XXX
 SG_ EPBL_a114_PARTY_wheelRotation m114 : 23|1@1+ (1,0) [0|0] "" Vector__XXX
 SG_ EPBL_a115_CH_TPMSDisplay m115 : 23|1@1+ (1,0) [0|0] "" Vector__XXX
 SG_ EPBL_a116_VEH_LVPowerState m116 : 23|1@1+ (1,0) [0|0] "" Vector__XXX
 SG_ EPBL_a117_VEH_hvacBlowerFdb m117 : 23|1@1+ (1,0) [0|0] "" Vector__XXX
 SG_ EPBL_a118_VEH_vehicleStatus m118 : 23|1@1+ (1,0) [0|0] "" Vector__XXX
 SG_ EPBL_a120_PARTY_speed m120 : 23|1@1+ (1,0) [0|0] "" Vector__XXX
 SG_ EPBL_a181_vcTrailerDetected m181 : 23|1@1+ (1,0) [0|0] "" Vector__XXX
 SG_ EPBL_a243_tempAmbient m243 : 23|1@1+ (1,0) [0|0] "" Vector__XXX
 SG_ EPBL_a262_vcfrontMIA m262 : 23|1@1+ (1,0) [0|0] "" Vector__XXX
 SG_ EPBL_a264_userConfirmedChargeCab m264 : 23|1@1+ (1,0) [0|0] "" Vector__XXX
 SG_ EPBL_a021_Task100msLate m21 : 22|1@1+ (1,0) [0|0] "" Vector__XXX
 SG_ EPBL_a086_VEH_systemStatus m86 : 22|1@1+ (1,0) [0|0] "" Vector__XXX
 SG_ EPBL_a087_PARTY_temperature m87 : 22|1@1+ (1,0) [0|0] "" Vector__XXX
 SG_ EPBL_a088_PARTY_temperature m88 : 22|1@1+ (1,0) [0|0] "" Vector__XXX
 SG_ EPBL_a089_CH_party1 m89 : 22|1@1+ (1,0) [0|0] "" Vector__XXX
 SG_ EPBL_a098_PARTY_status m98 : 22|1@1+ (1,0) [0|0] "" Vector__XXX
 SG_ EPBL_a104_BDY_bodyControls3 m104 : 22|1@1+ (1,0) [0|0] "" Vector__XXX
 SG_ EPBL_a107_PT_ptNm m107 : 22|1@1+ (1,0) [0|0] "" Vector__XXX
 SG_ EPBL_a108_PARTY_status m108 : 22|1@1+ (1,0) [0|0] "" Vector__XXX
 SG_ EPBL_a109_PARTY_inertial1 m109 : 22|1@1+ (1,0) [0|0] "" Vector__XXX
 SG_ EPBL_a110_VEH_mismatchFault m110 : 22|1@1+ (1,0) [0|0] "" Vector__XXX
 SG_ EPBL_a111_RIPC_remoteADC m111 : 22|1@1+ (1,0) [0|0] "" Vector__XXX
 SG_ EPBL_a112_LIPC_remoteADC m112 : 22|1@1+ (1,0) [0|0] "" Vector__XXX
 SG_ EPBL_a113_VEH_corianderVehicleCo m113 : 22|1@1+ (1,0) [0|0] "" Vector__XXX
 SG_ EPBL_a114_VEH_status m114 : 22|1@1+ (1,0) [0|0] "" Vector__XXX
 SG_ EPBL_a115_UI_corianderVehicleCon m115 : 22|1@1+ (1,0) [0|0] "" Vector__XXX
 SG_ EPBL_a116_VEH_hvacStatus m116 : 22|1@1+ (1,0) [0|0] "" Vector__XXX
 SG_ EPBL_a117_VEH_vehNm m117 : 22|1@1+ (1,0) [0|0] "" Vector__XXX
 SG_ EPBL_a118_VEH_coolant m118 : 22|1@1+ (1,0) [0|0] "" Vector__XXX
 SG_ EPBL_a120_PARTY_locStatus m120 : 22|1@1+ (1,0) [0|0] "" Vector__XXX
 SG_ EPBL_a243_vehicleSpeed m243 : 22|1@1+ (1,0) [0|0] "" Vector__XXX
 SG_ EPBL_a262_brakeNotConfirmedPress m262 : 22|1@1+ (1,0) [0|0] "" Vector__XXX
 SG_ EPBL_a264_chargeCablePotentially m264 : 22|1@1+ (1,0) [0|0] "" Vector__XXX
 SG_ EPBL_a012_ExternalReset m12 : 21|1@1+ (1,0) [0|0] "" Vector__XXX
 SG_ EPBL_a021_Task10msMissed m21 : 21|1@1+ (1,0) [0|0] "" Vector__XXX
 SG_ EPBL_a086_VEH_lightStatus m86 : 21|1@1+ (1,0) [0|0] "" Vector__XXX
 SG_ EPBL_a087_PARTY_status m87 : 21|1@1+ (1,0) [0|0] "" Vector__XXX
 SG_ EPBL_a088_PARTY_status m88 : 21|1@1+ (1,0) [0|0] "" Vector__XXX
 SG_ EPBL_a089_CH_status m89 : 21|1@1+ (1,0) [0|0] "" Vector__XXX
 SG_ EPBL_a098_VEH_torque m98 : 21|1@1+ (1,0) [0|0] "" Vector__XXX
 SG_ EPBL_a103_VEH_evseStatus m103 : 21|1@1+ (1,0) [0|0] "" Vector__XXX
 SG_ EPBL_a104_VEH_bodyControls3 m104 : 21|1@1+ (1,0) [0|0] "" Vector__XXX
 SG_ EPBL_a107_VEH_powerAvailable m107 : 21|1@1+ (1,0) [0|0] "" Vector__XXX
 SG_ EPBL_a108_PARTY_torque m108 : 21|1@1+ (1,0) [0|0] "" Vector__XXX
 SG_ EPBL_a109_VEH_imuOffsets m109 : 21|1@1+ (1,0) [0|0] "" Vector__XXX
 SG_ EPBL_a110_VEH_vehNm m110 : 21|1@1+ (1,0) [0|0] "" Vector__XXX
 SG_ EPBL_a111_RIPC_railStatus m111 : 21|1@1+ (1,0) [0|0] "" Vector__XXX
 SG_ EPBL_a112_LIPC_railStatus m112 : 21|1@1+ (1,0) [0|0] "" Vector__XXX
 SG_ EPBL_a113_VEH_peripheralPowerReq m113 : 21|1@1+ (1,0) [0|0] "" Vector__XXX
 SG_ EPBL_a114_VEH_party3 m114 : 21|1@1+ (1,0) [0|0] "" Vector__XXX
 SG_ EPBL_a115_REM_authentication m115 : 21|1@1+ (1,0) [0|0] "" Vector__XXX
 SG_ EPBL_a116_VEH_hvacRequest m116 : 21|1@1+ (1,0) [0|0] "" Vector__XXX
 SG_ EPBL_a117_PARTY_epbmStatus m117 : 21|1@1+ (1,0) [0|0] "" Vector__XXX
 SG_ EPBL_a118_VEH_LVPowerState m118 : 21|1@1+ (1,0) [0|0] "" Vector__XXX
 SG_ EPBL_a119_PARTY_steerAngle m119 : 21|1@1+ (1,0) [0|0] "" Vector__XXX
 SG_ EPBL_a120_VEH_torque m120 : 21|1@1+ (1,0) [0|0] "" Vector__XXX
 SG_ EPBL_a183_espCdpStatus m183 : 21|2@1+ (1,0) [0|0] "" Vector__XXX
 SG_ EPBL_a210_driverIsLeavingSpeedCl m210 : 21|3@1+ (1,0) [0|0] "" Vector__XXX
 SG_ EPBL_a243_DIFtorqueActual m243 : 21|1@1+ (1,0) [0|0] "" Vector__XXX
 SG_ EPBL_a262_userConfirmedChargeCab m262 : 21|1@1+ (1,0) [0|0] "" Vector__XXX
 SG_ EPBL_a264_inputVoltageTooLow m264 : 21|1@1+ (1,0) [0|0] "" Vector__XXX
 SG_ EPBL_a005_faults0 m5 : 20|12@1+ (1,0) [0|0] "" Vector__XXX
 SG_ EPBL_a006_fault m6 : 20|4@1+ (1,0) [0|0] "" Vector__XXX
 SG_ EPBL_a012_DebugReset m12 : 20|1@1+ (1,0) [0|0] "" Vector__XXX
 SG_ EPBL_a021_Task10msStarved m21 : 20|1@1+ (1,0) [0|0] "" Vector__XXX
 SG_ EPBL_a086_VEH_LVPowerState m86 : 20|1@1+ (1,0) [0|0] "" Vector__XXX
 SG_ EPBL_a087_PARTY_torque m87 : 20|1@1+ (1,0) [0|0] "" Vector__XXX
 SG_ EPBL_a088_PARTY_torque m88 : 20|1@1+ (1,0) [0|0] "" Vector__XXX
 SG_ EPBL_a089_BDY_status m89 : 20|1@1+ (1,0) [0|0] "" Vector__XXX
 SG_ EPBL_a098_VEH_temperature m98 : 20|1@1+ (1,0) [0|0] "" Vector__XXX
 SG_ EPBL_a100_OBD m100 : 20|1@1+ (1,0) [0|0] "" Vector__XXX
 SG_ EPBL_a101_BDY_locState m101 : 20|1@1+ (1,0) [0|0] "" Vector__XXX
 SG_ EPBL_a103_PT_status m103 : 20|1@1+ (1,0) [0|0] "" Vector__XXX
 SG_ EPBL_a104_VEH_bodyControls m104 : 20|1@1+ (1,0) [0|0] "" Vector__XXX
 SG_ EPBL_a106_CH_alertMatrix m106 : 20|1@1+ (1,0) [0|0] "" Vector__XXX
 SG_ EPBL_a107_VEH_bmbMinMax m107 : 20|1@1+ (1,0) [0|0] "" Vector__XXX
 SG_ EPBL_a108_VEH_status m108 : 20|1@1+ (1,0) [0|0] "" Vector__XXX
 SG_ EPBL_a109_VEH_status m109 : 20|1@1+ (1,0) [0|0] "" Vector__XXX
 SG_ EPBL_a110_VEH_updateStatus m110 : 20|1@1+ (1,0) [0|0] "" Vector__XXX
 SG_ EPBL_a111_RIPC_epbPrivateState m111 : 20|1@1+ (1,0) [0|0] "" Vector__XXX
 SG_ EPBL_a112_LIPC_epbPrivateState m112 : 20|1@1+ (1,0) [0|0] "" Vector__XXX
 SG_ EPBL_a113_VEH_vehicleControl2 m113 : 20|1@1+ (1,0) [0|0] "" Vector__XXX
 SG_ EPBL_a114_PARTY_party3 m114 : 20|1@1+ (1,0) [0|0] "" Vector__XXX
 SG_ EPBL_a115_VEH_requests2 m115 : 20|1@1+ (1,0) [0|0] "" Vector__XXX
 SG_ EPBL_a116_VEH_vehNm m116 : 20|1@1+ (1,0) [0|0] "" Vector__XXX
 SG_ EPBL_a117_VEH_prndStatus m117 : 20|1@1+ (1,0) [0|0] "" Vector__XXX
 SG_ EPBL_a118_VEH_okToUseHighPwr m118 : 20|1@1+ (1,0) [0|0] "" Vector__XXX
 SG_ EPBL_a119_CH_steerAngle m119 : 20|1@1+ (1,0) [0|0] "" Vector__XXX
 SG_ EPBL_a120_PARTY_torque m120 : 20|1@1+ (1,0) [0|0] "" Vector__XXX
 SG_ EPBL_a202_remoteEpbConfig m202 : 20|4@1+ (1,0) [0|0] "" Vector__XXX
 SG_ EPBL_a203_epbConfig m203 : 20|4@1+ (1,0) [0|0] "" Vector__XXX
 SG_ EPBL_a210_driverLeftForInactivit m210 : 20|1@1+ (1,0) [0|0] "" Vector__XXX
 SG_ EPBL_a242_hvState m242 : 20|3@1+ (1,0) [0|0] "" Vector__XXX
 SG_ EPBL_a243_DIR2torqueActual m243 : 20|1@1+ (1,0) [0|0] "" Vector__XXX
 SG_ EPBL_a262_chargeCablePotentially m262 : 20|1@1+ (1,0) [0|0] "" Vector__XXX
 SG_ EPBL_a264_backupPrndParkPressed m264 : 20|1@1+ (1,0) [0|0] "" Vector__XXX
 SG_ EPBL_a355_epbHwConfig m355 : 20|4@1+ (1,0) [0|0] "" Vector__XXX
 SG_ EPBL_a012_CheckstopReset m12 : 19|1@1+ (1,0) [0|0] "" Vector__XXX
 SG_ EPBL_a021_Task10msLate m21 : 19|1@1+ (1,0) [0|0] "" Vector__XXX
 SG_ EPBL_a082_RIPC_remoteMux m82 : 19|1@1+ (1,0) [0|0] "" Vector__XXX
 SG_ EPBL_a083_LIPC_HSDFaults m83 : 19|1@1+ (1,0) [0|0] "" Vector__XXX
 SG_ EPBL_a086_VEH_12VBatteryStatus m86 : 19|1@1+ (1,0) [0|0] "" Vector__XXX
 SG_ EPBL_a087_VEH_status m87 : 19|1@1+ (1,0) [0|0] "" Vector__XXX
 SG_ EPBL_a088_VEH_status m88 : 19|1@1+ (1,0) [0|0] "" Vector__XXX
 SG_ EPBL_a089_BDY_party1 m89 : 19|1@1+ (1,0) [0|0] "" Vector__XXX
 SG_ EPBL_a090_CH_eacMonitor m90 : 19|1@1+ (1,0) [0|0] "" Vector__XXX
 SG_ EPBL_a092_VEH_vehNm m92 : 19|1@1+ (1,0) [0|0] "" Vector__XXX
 SG_ EPBL_a093_VEH_vehNm m93 : 19|1@1+ (1,0) [0|0] "" Vector__XXX
 SG_ EPBL_a098_VEH_thermalControl m98 : 19|1@1+ (1,0) [0|0] "" Vector__XXX
 SG_ EPBL_a100_CH m100 : 19|1@1+ (1,0) [0|0] "" Vector__XXX
 SG_ EPBL_a101_VEH_locState m101 : 19|1@1+ (1,0) [0|0] "" Vector__XXX
 SG_ EPBL_a102_VEH_rods m102 : 19|1@1+ (1,0) [0|0] "" Vector__XXX
 SG_ EPBL_a103_PT_ptNm m103 : 19|1@1+ (1,0) [0|0] "" Vector__XXX
 SG_ EPBL_a104_VEH_chNm m104 : 19|1@1+ (1,0) [0|0] "" Vector__XXX
 SG_ EPBL_a106_CH_dcdcRailStatus m106 : 19|1@1+ (1,0) [0|0] "" Vector__XXX
 SG_ EPBL_a107_VEH_thermalStatus m107 : 19|1@1+ (1,0) [0|0] "" Vector__XXX
 SG_ EPBL_a108_VEH_torque m108 : 19|1@1+ (1,0) [0|0] "" Vector__XXX
 SG_ EPBL_a109_PARTY_collision m109 : 19|1@1+ (1,0) [0|0] "" Vector__XXX
 SG_ EPBL_a110_VEH_time m110 : 19|1@1+ (1,0) [0|0] "" Vector__XXX
 SG_ EPBL_a111_RIPC_LVPowerState m111 : 19|1@1+ (1,0) [0|0] "" Vector__XXX
 SG_ EPBL_a112_LIPC_LVPowerState m112 : 19|1@1+ (1,0) [0|0] "" Vector__XXX
 SG_ EPBL_a113_VEH_vehicleControl m113 : 19|1@1+ (1,0) [0|0] "" Vector__XXX
 SG_ EPBL_a114_CH_wheelSpeeds m114 : 19|1@1+ (1,0) [0|0] "" Vector__XXX
 SG_ EPBL_a115_VEH_requests m115 : 19|1@1+ (1,0) [0|0] "" Vector__XXX
 SG_ EPBL_a116_PARTY_epbmStatus m116 : 19|1@1+ (1,0) [0|0] "" Vector__XXX
 SG_ EPBL_a117_BDY_restraintStatus m117 : 19|1@1+ (1,0) [0|0] "" Vector__XXX
 SG_ EPBL_a118_VEH_status m118 : 19|1@1+ (1,0) [0|0] "" Vector__XXX
 SG_ EPBL_a119_PARTY_rightStalk m119 : 19|1@1+ (1,0) [0|0] "" Vector__XXX
 SG_ EPBL_a120_PARTY_systemStatus m120 : 19|1@1+ (1,0) [0|0] "" Vector__XXX
 SG_ EPBL_a138_monitorState m138 : 19|3@1+ (1,0) [0|0] "" Vector__XXX
 SG_ EPBL_a139_monitorState m139 : 19|3@1+ (1,0) [0|0] "" Vector__XXX
 SG_ EPBL_a178_monitorCaliperState m178 : 19|3@1+ (1,0) [0|0] "" Vector__XXX
 SG_ EPBL_a183_remoteCdpState m183 : 19|2@1+ (1,0) [0|0] "" Vector__XXX
 SG_ EPBL_a210_driverLeftForUnbuckled m210 : 19|1@1+ (1,0) [0|0] "" Vector__XXX
 SG_ EPBL_a216_monitor_MIA m216 : 19|1@1+ (1,0) [0|0] "" Vector__XXX
 SG_ EPBL_a241_epbSysStatus m241 : 19|4@1+ (1,0) [0|0] "" Vector__XXX
 SG_ EPBL_a242_contCurrentState m242 : 19|1@1+ (1,0) [0|0] "" Vector__XXX
 SG_ EPBL_a243_DIR1torqueActual m243 : 19|1@1+ (1,0) [0|0] "" Vector__XXX
 SG_ EPBL_a262_chargeCableDefinitelyA m262 : 19|1@1+ (1,0) [0|0] "" Vector__XXX
 SG_ EPBL_a264_stalkParkPressed m264 : 19|1@1+ (1,0) [0|0] "" Vector__XXX
 SG_ EPBL_a353_uiMia m353 : 19|1@1+ (1,0) [0|0] "" Vector__XXX
 SG_ EPBL_a012_SoftwareReset m12 : 18|1@1+ (1,0) [0|0] "" Vector__XXX
 SG_ EPBL_a015_NVMMRecordIDError m15 : 18|1@1+ (1,0) [0|0] "" Vector__XXX
 SG_ EPBL_a021_Task1msMissed m21 : 18|1@1+ (1,0) [0|0] "" Vector__XXX
 SG_ EPBL_a082_RIPC_railStatus m82 : 18|1@1+ (1,0) [0|0] "" Vector__XXX
 SG_ EPBL_a083_LIPC_railStatus m83 : 18|1@1+ (1,0) [0|0] "" Vector__XXX
 SG_ EPBL_a086_VEH_status m86 : 18|1@1+ (1,0) [0|0] "" Vector__XXX
 SG_ EPBL_a087_VEH_torque m87 : 18|1@1+ (1,0) [0|0] "" Vector__XXX
 SG_ EPBL_a088_VEH_torque m88 : 18|1@1+ (1,0) [0|0] "" Vector__XXX
 SG_ EPBL_a089_VEH_status m89 : 18|1@1+ (1,0) [0|0] "" Vector__XXX
 SG_ EPBL_a090_PARTY_eacMonitor m90 : 18|1@1+ (1,0) [0|0] "" Vector__XXX
 SG_ EPBL_a091_VEH_state m91 : 18|1@1+ (1,0) [0|0] "" Vector__XXX
 SG_ EPBL_a092_VEH_seatStatus2 m92 : 18|1@1+ (1,0) [0|0] "" Vector__XXX
 SG_ EPBL_a093_VEH_seatStatus2 m93 : 18|1@1+ (1,0) [0|0] "" Vector__XXX
 SG_ EPBL_a098_VEH_status m98 : 18|1@1+ (1,0) [0|0] "" Vector__XXX
 SG_ EPBL_a100_PT m100 : 18|1@1+ (1,0) [0|0] "" Vector__XXX
 SG_ EPBL_a101_LIPC_externalWatchdogH m101 : 18|1@1+ (1,0) [0|0] "" Vector__XXX
 SG_ EPBL_a102_VEH_sensorStatus m102 : 18|1@1+ (1,0) [0|0] "" Vector__XXX
 SG_ EPBL_a103_VEH_status m103 : 18|1@1+ (1,0) [0|0] "" Vector__XXX
 SG_ EPBL_a104_LIPC_status m104 : 18|1@1+ (1,0) [0|0] "" Vector__XXX
 SG_ EPBL_a105_VEH_dampingStates m105 : 18|1@1+ (1,0) [0|0] "" Vector__XXX
 SG_ EPBL_a106_VEH_dcdcRailStatus m106 : 18|1@1+ (1,0) [0|0] "" Vector__XXX
 SG_ EPBL_a107_VEH_status m107 : 18|1@1+ (1,0) [0|0] "" Vector__XXX
 SG_ EPBL_a108_VEH_thermalControl m108 : 18|1@1+ (1,0) [0|0] "" Vector__XXX
 SG_ EPBL_a109_PARTY_nearDeploy m109 : 18|1@1+ (1,0) [0|0] "" Vector__XXX
 SG_ EPBL_a110_VEH_carConfig m110 : 18|1@1+ (1,0) [0|0] "" Vector__XXX
 SG_ EPBL_a111_VEH_vehNm m111 : 18|1@1+ (1,0) [0|0] "" Vector__XXX
 SG_ EPBL_a112_VEH_vehNm m112 : 18|1@1+ (1,0) [0|0] "" Vector__XXX
 SG_ EPBL_a113_VEH_chargeRequest m113 : 18|1@1+ (1,0) [0|0] "" Vector__XXX
 SG_ EPBL_a114_VEH_wheelSpeeds m114 : 18|1@1+ (1,0) [0|0] "" Vector__XXX
 SG_ EPBL_a115_VEH_BLEResetRequest m115 : 18|1@1+ (1,0) [0|0] "" Vector__XXX
 SG_ EPBL_a116_RIPC_epbManagement m116 : 18|1@1+ (1,0) [0|0] "" Vector__XXX
 SG_ EPBL_a117_BDY_epbmStatus m117 : 18|1@1+ (1,0) [0|0] "" Vector__XXX
 SG_ EPBL_a118_VEH_sensors m118 : 18|1@1+ (1,0) [0|0] "" Vector__XXX
 SG_ EPBL_a119_VEH_rightStalk m119 : 18|1@1+ (1,0) [0|0] "" Vector__XXX
 SG_ EPBL_a120_CH_chassisCntl m120 : 18|1@1+ (1,0) [0|0] "" Vector__XXX
 SG_ EPBL_a210_driverLeftForDoorOpen m210 : 18|1@1+ (1,0) [0|0] "" Vector__XXX
 SG_ EPBL_a216_CRC_error m216 : 18|1@1+ (1,0) [0|0] "" Vector__XXX
 SG_ EPBL_a241_diKeepAlive m241 : 18|1@1+ (1,0) [0|0] "" Vector__XXX
 SG_ EPBL_a242_contDesiredState m242 : 18|1@1+ (1,0) [0|0] "" Vector__XXX
 SG_ EPBL_a243_drivetrainType m243 : 18|1@1+ (1,0) [0|0] "" Vector__XXX
 SG_ EPBL_a262_notSecure m262 : 18|1@1+ (1,0) [0|0] "" Vector__XXX
 SG_ EPBL_a264_uiControlsParkingBrake m264 : 18|1@1+ (1,0) [0|0] "" Vector__XXX
 SG_ EPBL_a272_actualState m272 : 18|2@1+ (1,0) [0|0] "" Vector__XXX
 SG_ EPBL_a353_gtwMia m353 : 18|1@1+ (1,0) [0|0] "" Vector__XXX
 SG_ EPBL_a002_PowerOnReset m2 : 17|1@1+ (1,0) [0|0] "" Vector__XXX
 SG_ EPBL_a012_FlashError m12 : 17|1@1+ (1,0) [0|0] "" Vector__XXX
 SG_ EPBL_a013_ClearQueueFull m13 : 17|1@1+ (1,0) [0|0] "" Vector__XXX
 SG_ EPBL_a015_NVMMFilesystemError m15 : 17|1@1+ (1,0) [0|0] "" Vector__XXX
 SG_ EPBL_a021_Task1msStarved m21 : 17|1@1+ (1,0) [0|0] "" Vector__XXX
 SG_ EPBL_a060_resetUnlocked m60 : 17|1@1+ (1,0) [0|0] "" Vector__XXX
 SG_ EPBL_a082_RIPC_remoteHSD m82 : 17|1@1+ (1,0) [0|0] "" Vector__XXX
 SG_ EPBL_a083_LIPC_remoteHSD m83 : 17|1@1+ (1,0) [0|0] "" Vector__XXX
 SG_ EPBL_a086_VEH_LVBMS_statusLow m86 : 17|1@1+ (1,0) [0|0] "" Vector__XXX
 SG_ EPBL_a087_VEH_thermalControl m87 : 17|1@1+ (1,0) [0|0] "" Vector__XXX
 SG_ EPBL_a088_VEH_thermalControl m88 : 17|1@1+ (1,0) [0|0] "" Vector__XXX
 SG_ EPBL_a089_PARTY_status m89 : 17|1@1+ (1,0) [0|0] "" Vector__XXX
 SG_ EPBL_a090_VEH_state m90 : 17|1@1+ (1,0) [0|0] "" Vector__XXX
 SG_ EPBL_a091_VEH_info m91 : 17|1@1+ (1,0) [0|0] "" Vector__XXX
 SG_ EPBL_a092_VEH_switchStatus m92 : 17|1@1+ (1,0) [0|0] "" Vector__XXX
 SG_ EPBL_a093_VEH_switchStatus m93 : 17|1@1+ (1,0) [0|0] "" Vector__XXX
 SG_ EPBL_a094_PARTY_sysStatus m94 : 17|1@1+ (1,0) [0|0] "" Vector__XXX
 SG_ EPBL_a095_PT_status m95 : 17|1@1+ (1,0) [0|0] "" Vector__XXX
 SG_ EPBL_a096_CH_status m96 : 17|1@1+ (1,0) [0|0] "" Vector__XXX
 SG_ EPBL_a097_VEH_state m97 : 17|1@1+ (1,0) [0|0] "" Vector__XXX
 SG_ EPBL_a098_VEH_hvStatus m98 : 17|1@1+ (1,0) [0|0] "" Vector__XXX
 SG_ EPBL_a100_PARTY m100 : 17|1@1+ (1,0) [0|0] "" Vector__XXX
 SG_ EPBL_a101_PARTY_locState m101 : 17|1@1+ (1,0) [0|0] "" Vector__XXX
 SG_ EPBL_a102_VEH_feedbackStatus m102 : 17|1@1+ (1,0) [0|0] "" Vector__XXX
 SG_ EPBL_a103_VEH_vehNm m103 : 17|1@1+ (1,0) [0|0] "" Vector__XXX
 SG_ EPBL_a104_CH_redundantBrakingCon m104 : 17|1@1+ (1,0) [0|0] "" Vector__XXX
 SG_ EPBL_a105_VEH_chNm m105 : 17|1@1+ (1,0) [0|0] "" Vector__XXX
 SG_ EPBL_a106_VEH_thermalControl m106 : 17|1@1+ (1,0) [0|0] "" Vector__XXX
 SG_ EPBL_a107_VEH_vehNm m107 : 17|1@1+ (1,0) [0|0] "" Vector__XXX
 SG_ EPBL_a108_VEH_temperature m108 : 17|1@1+ (1,0) [0|0] "" Vector__XXX
 SG_ EPBL_a109_PARTY_inertial2 m109 : 17|1@1+ (1,0) [0|0] "" Vector__XXX
 SG_ EPBL_a110_VEH_carState m110 : 17|1@1+ (1,0) [0|0] "" Vector__XXX
 SG_ EPBL_a111_VEH_status m111 : 17|1@1+ (1,0) [0|0] "" Vector__XXX
 SG_ EPBL_a112_VEH_status m112 : 17|1@1+ (1,0) [0|0] "" Vector__XXX
 SG_ EPBL_a113_VEH_hvacRequest m113 : 17|1@1+ (1,0) [0|0] "" Vector__XXX
 SG_ EPBL_a114_PARTY_wheelSpeeds m114 : 17|1@1+ (1,0) [0|0] "" Vector__XXX
 SG_ EPBL_a115_VEH_authentication m115 : 17|1@1+ (1,0) [0|0] "" Vector__XXX
 SG_ EPBL_a116_RIPC_doorStatus m116 : 17|1@1+ (1,0) [0|0] "" Vector__XXX
 SG_ EPBL_a117_RIPC_doorStatus m117 : 17|1@1+ (1,0) [0|0] "" Vector__XXX
 SG_ EPBL_a118_VEH_lighting m118 : 17|1@1+ (1,0) [0|0] "" Vector__XXX
 SG_ EPBL_a119_VEH_leftStalk m119 : 17|1@1+ (1,0) [0|0] "" Vector__XXX
 SG_ EPBL_a120_VEH_systemStatus m120 : 17|1@1+ (1,0) [0|0] "" Vector__XXX
 SG_ EPBL_a183_localCdpState m183 : 17|2@1+ (1,0) [0|0] "" Vector__XXX
 SG_ EPBL_a210_driverLeftForAllSensor m210 : 17|1@1+ (1,0) [0|0] "" Vector__XXX
 SG_ EPBL_a216_spiFault m216 : 17|1@1+ (1,0) [0|0] "" Vector__XXX
 SG_ EPBL_a241_currentState m241 : 17|1@1+ (1,0) [0|0] "" Vector__XXX
 SG_ EPBL_a242_hvcCurrentState m242 : 17|1@1+ (1,0) [0|0] "" Vector__XXX
 SG_ EPBL_a243_brakeMasterCylPressQF m243 : 17|1@1+ (1,0) [0|0] "" Vector__XXX
 SG_ EPBL_a262_notStopped m262 : 17|1@1+ (1,0) [0|0] "" Vector__XXX
 SG_ EPBL_a264_uiGearStripParkPressed m264 : 17|1@1+ (1,0) [0|0] "" Vector__XXX
 SG_ EPBL_a000_alertDataW0 m0 : 16|16@1+ (1,0) [0|0] "" Vector__XXX
 SG_ EPBL_a001_InternalWatchdog m1 : 16|1@1+ (1,0) [0|0] "" Vector__XXX
 SG_ EPBL_a002_CPUUndervoltage m2 : 16|1@1+ (1,0) [0|0] "" Vector__XXX
 SG_ EPBL_a003_AssertID m3 : 16|16@1+ (1,0) [0|0] "" Vector__XXX
 SG_ EPBL_a005_busID0 m5 : 16|4@1+ (1,0) [0|0] "" Vector__XXX
 SG_ EPBL_a006_busID m6 : 16|4@1+ (1,0) [0|0] "" Vector__XXX
 SG_ EPBL_a012_ClockError m12 : 16|1@1+ (1,0) [0|0] "" Vector__XXX
 SG_ EPBL_a013_LogQueueFull m13 : 16|1@1+ (1,0) [0|0] "" Vector__XXX
 SG_ EPBL_a015_NVMMMemOverflow m15 : 16|1@1+ (1,0) [0|0] "" Vector__XXX
 SG_ EPBL_a016_NVMMRecordID m16 : 16|16@1+ (1,0) [0|0] "" Vector__XXX
 SG_ EPBL_a021_Task1msLate m21 : 16|1@1+ (1,0) [0|0] "" Vector__XXX
 SG_ EPBL_a022_TaskInitErrorCount m22 : 16|8@1+ (1,0) [0|0] "" Vector__XXX
 SG_ EPBL_a030_logId m30 : 16|4@1+ (1,0) [0|0] "" Vector__XXX
 SG_ EPBL_a031_uds_bytes_0 m31 : 16|8@1+ (1,0) [0|0] "" Vector__XXX
 SG_ EPBL_a041_CPULoadTotal m41 : 16|8@1+ (1,0) [0|0] "" Vector__XXX
 SG_ EPBL_a042_Usage1msTask m42 : 16|8@1+ (1,0) [0|0] "" Vector__XXX
 SG_ EPBL_a043_CallTrace0 m43 : 16|24@1+ (1,0) [0|0] "" Vector__XXX
 SG_ EPBL_a044_CallTrace0 m44 : 16|24@1+ (1,0) [0|0] "" Vector__XXX
 SG_ EPBL_a045_CallTrace0 m45 : 16|24@1+ (1,0) [0|0] "" Vector__XXX
 SG_ EPBL_a046_CallTrace0 m46 : 16|24@1+ (1,0) [0|0] "" Vector__XXX
 SG_ EPBL_a057_VEH_cpControl m57 : 16|1@1+ (1,0) [0|0] "" Vector__XXX
 SG_ EPBL_a058_voltageDrop m58 : 16|12@1+ (0.005443676098,0) [0|0] "" Vector__XXX
 SG_ EPBL_a059_voltageDrop m59 : 16|12@1+ (0.005443676098,0) [0|0] "" Vector__XXX
 SG_ EPBL_a060_lockoutDisabled m60 : 16|1@1+ (1,0) [0|0] "" Vector__XXX
 SG_ EPBL_a063_switchChannel m63 : 16|8@1+ (1,0) [0|0] "" Vector__XXX
 SG_ EPBL_a064_busBitField m64 : 16|8@1+ (1,0) [0|0] "" Vector__XXX
 SG_ EPBL_a081_VEH_defogInfoMessage m81 : 16|1@1+ (1,0) [0|0] "" Vector__XXX
 SG_ EPBL_a082_RIPC_epbPrivateState m82 : 16|1@1+ (1,0) [0|0] "" Vector__XXX
 SG_ EPBL_a083_LIPC_epbPrivateState m83 : 16|1@1+ (1,0) [0|0] "" Vector__XXX
 SG_ EPBL_a084_CH_StatusC m84 : 16|1@1+ (1,0) [0|0] "" Vector__XXX
 SG_ EPBL_a085_PARTY_buttonStatus m85 : 16|1@1+ (1,0) [0|0] "" Vector__XXX
 SG_ EPBL_a086_VEH_LVBMS_statusHigh m86 : 16|1@1+ (1,0) [0|0] "" Vector__XXX
 SG_ EPBL_a087_VEH_temperature m87 : 16|1@1+ (1,0) [0|0] "" Vector__XXX
 SG_ EPBL_a088_VEH_temperature m88 : 16|1@1+ (1,0) [0|0] "" Vector__XXX
 SG_ EPBL_a089_PARTY_party1 m89 : 16|1@1+ (1,0) [0|0] "" Vector__XXX
 SG_ EPBL_a090_VEH_chNm m90 : 16|1@1+ (1,0) [0|0] "" Vector__XXX
 SG_ EPBL_a091_VEH_faultsAndExtras m91 : 16|1@1+ (1,0) [0|0] "" Vector__XXX
 SG_ EPBL_a092_VEH_restraintStatus m92 : 16|1@1+ (1,0) [0|0] "" Vector__XXX
 SG_ EPBL_a093_VEH_restraintStatus m93 : 16|1@1+ (1,0) [0|0] "" Vector__XXX
 SG_ EPBL_a094_VEH_sysStatus m94 : 16|1@1+ (1,0) [0|0] "" Vector__XXX
 SG_ EPBL_a095_PT_ptNm m95 : 16|1@1+ (1,0) [0|0] "" Vector__XXX
 SG_ EPBL_a096_VEH_status m96 : 16|1@1+ (1,0) [0|0] "" Vector__XXX
 SG_ EPBL_a097_VEH_HVStatus m97 : 16|1@1+ (1,0) [0|0] "" Vector__XXX
 SG_ EPBL_a098_CH_torque m98 : 16|1@1+ (1,0) [0|0] "" Vector__XXX
 SG_ EPBL_a099_VEH_oocStatus m99 : 16|1@1+ (1,0) [0|0] "" Vector__XXX
 SG_ EPBL_a100_VEH m100 : 16|1@1+ (1,0) [0|0] "" Vector__XXX
 SG_ EPBL_a101_VEH_state m101 : 16|1@1+ (1,0) [0|0] "" Vector__XXX
 SG_ EPBL_a102_VEH_faultsAndExtras m102 : 16|1@1+ (1,0) [0|0] "" Vector__XXX
 SG_ EPBL_a103_VEH_hvsNm m103 : 16|1@1+ (1,0) [0|0] "" Vector__XXX
 SG_ EPBL_a104_PARTY_redundantBraking m104 : 16|1@1+ (1,0) [0|0] "" Vector__XXX
 SG_ EPBL_a105_VEH_states m105 : 16|1@1+ (1,0) [0|0] "" Vector__XXX
 SG_ EPBL_a106_VEH_dcdcStatus m106 : 16|1@1+ (1,0) [0|0] "" Vector__XXX
 SG_ EPBL_a107_VEH_hvsNm m107 : 16|1@1+ (1,0) [0|0] "" Vector__XXX
 SG_ EPBL_a108_VEH_hvStatus m108 : 16|1@1+ (1,0) [0|0] "" Vector__XXX
 SG_ EPBL_a109_PARTY_status m109 : 16|1@1+ (1,0) [0|0] "" Vector__XXX
 SG_ EPBL_a110_VEH_powerRequests m110 : 16|1@1+ (1,0) [0|0] "" Vector__XXX
 SG_ EPBL_a111_VEH_internalStatus m111 : 16|1@1+ (1,0) [0|0] "" Vector__XXX
 SG_ EPBL_a112_VEH_internalStatus m112 : 16|1@1+ (1,0) [0|0] "" Vector__XXX
 SG_ EPBL_a113_VEH_ethNm m113 : 16|1@1+ (1,0) [0|0] "" Vector__XXX
 SG_ EPBL_a114_PARTY_status m114 : 16|1@1+ (1,0) [0|0] "" Vector__XXX
 SG_ EPBL_a115_VEH_vehNm m115 : 16|1@1+ (1,0) [0|0] "" Vector__XXX
 SG_ EPBL_a116_LIPC_doorStatus m116 : 16|1@1+ (1,0) [0|0] "" Vector__XXX
 SG_ EPBL_a117_LIPC_doorStatus m117 : 16|1@1+ (1,0) [0|0] "" Vector__XXX
 SG_ EPBL_a118_VEH_vehNm m118 : 16|1@1+ (1,0) [0|0] "" Vector__XXX
 SG_ EPBL_a119_VEH_steerAngle m119 : 16|1@1+ (1,0) [0|0] "" Vector__XXX
 SG_ EPBL_a120_PARTY_chassisCntl m120 : 16|1@1+ (1,0) [0|0] "" Vector__XXX
 SG_ EPBL_a121_caliperState m121 : 16|4@1+ (1,0) [0|0] "" Vector__XXX
 SG_ EPBL_a122_filteredCurrentCal m122 : 16|12@1+ (0.01,0) [0|0] "" Vector__XXX
 SG_ EPBL_a123_filteredCurrentCal m123 : 16|12@1+ (0.01,0) [0|0] "" Vector__XXX
 SG_ EPBL_a124_calOutOfBoundsData m124 : 16|1@1+ (1,0) [0|0] "" Vector__XXX
 SG_ EPBL_a125_pvFilt m125 : 16|12@1+ (0.005443676098,0) [0|0] "" Vector__XXX
 SG_ EPBL_a126_pvFilt m126 : 16|12@1+ (0.005443676098,0) [0|0] "" Vector__XXX
 SG_ EPBL_a127_pvFilt m127 : 16|12@1+ (0.005443676098,0) [0|0] "" Vector__XXX
 SG_ EPBL_a128_pvFilt m128 : 16|12@1+ (0.005443676098,0) [0|0] "" Vector__XXX
 SG_ EPBL_a129_VEH_occupancy m129 : 16|1@1+ (1,0) [0|0] "" Vector__XXX
 SG_ EPBL_a134_pvFilt m134 : 16|12@1+ (0.005443676098,0) [0|0] "" Vector__XXX
 SG_ EPBL_a135_pvFilt m135 : 16|12@1+ (0.005443676098,0) [0|0] "" Vector__XXX
 SG_ EPBL_a136_pvFilt m136 : 16|12@1+ (0.005443676098,0) [0|0] "" Vector__XXX
 SG_ EPBL_a137_pvFilt m137 : 16|12@1+ (0.005443676098,0) [0|0] "" Vector__XXX
 SG_ EPBL_a138_localState m138 : 16|3@1+ (1,0) [0|0] "" Vector__XXX
 SG_ EPBL_a139_localState m139 : 16|3@1+ (1,0) [0|0] "" Vector__XXX
 SG_ EPBL_a140_stateTime m140 : 16|32@1+ (1,0) [0|0] "" Vector__XXX
 SG_ EPBL_a141_fromState m141 : 16|5@1+ (1,0) [0|0] "" Vector__XXX
 SG_ EPBL_a170_pvFilt m170 : 16|12@1+ (0.005443676098,0) [0|0] "" Vector__XXX
 SG_ EPBL_a171_pvFilt m171 : 16|12@1+ (0.005443676098,0) [0|0] "" Vector__XXX
 SG_ EPBL_a173_esmState m173 : 16|5@1+ (1,0) [0|0] "" Vector__XXX
 SG_ EPBL_a174_esmState m174 : 16|5@1+ (1,0) [0|0] "" Vector__XXX
 SG_ EPBL_a175_esmState m175 : 16|5@1+ (1,0) [0|0] "" Vector__XXX
 SG_ EPBL_a176_esmState m176 : 16|5@1+ (1,0) [0|0] "" Vector__XXX
 SG_ EPBL_a177_esmState m177 : 16|5@1+ (1,0) [0|0] "" Vector__XXX
 SG_ EPBL_a178_localCaliperState m178 : 16|3@1+ (1,0) [0|0] "" Vector__XXX
 SG_ EPBL_a179_esmState m179 : 16|5@1+ (1,0) [0|0] "" Vector__XXX
 SG_ EPBL_a180_esmOpTrigger m180 : 16|6@1+ (1,0) [0|0] "" Vector__XXX
 SG_ EPBL_a181_grade m181 : 16|7@1- (1,0) [0|0] "" Vector__XXX
 SG_ EPBL_a182_epbSystemStatus m182 : 16|4@1+ (1,0) [0|0] "" Vector__XXX
 SG_ EPBL_a183_isRetransmit m183 : 16|1@1+ (1,0) [0|0] "" Vector__XXX
 SG_ EPBL_a184_esmOpTrigger m184 : 16|6@1+ (1,0) [0|0] "" Vector__XXX
 SG_ EPBL_a185_summonFaultReason m185 : 16|5@1+ (1,0) [0|0] "" Vector__XXX
 SG_ EPBL_a186_esmOpTrigger m186 : 16|6@1+ (1,0) [0|0] "" Vector__XXX
 SG_ EPBL_a187_esmOpTrigger m187 : 16|6@1+ (1,0) [0|0] "" Vector__XXX
 SG_ EPBL_a188_esmOpTrigger m188 : 16|6@1+ (1,0) [0|0] "" Vector__XXX
 SG_ EPBL_a189_esmOpTrigger m189 : 16|6@1+ (1,0) [0|0] "" Vector__XXX
 SG_ EPBL_a190_esmState m190 : 16|5@1+ (1,0) [0|0] "" Vector__XXX
 SG_ EPBL_a191_esmState m191 : 16|5@1+ (1,0) [0|0] "" Vector__XXX
 SG_ EPBL_a198_voltageAvgDelta m198 : 16|9@1+ (0.043549408784,0) [0|0] "" Vector__XXX
 SG_ EPBL_a202_localEpbConfig m202 : 16|4@1+ (1,0) [0|0] "" Vector__XXX
 SG_ EPBL_a203_gtwConfig m203 : 16|4@1+ (1,0) [0|0] "" Vector__XXX
 SG_ EPBL_a210_driverLeftForScore m210 : 16|1@1+ (1,0) [0|0] "" Vector__XXX
 SG_ EPBL_a216_noData m216 : 16|1@1+ (1,0) [0|0] "" Vector__XXX
 SG_ EPBL_a217_byte4 m217 : 16|8@1+ (1,0) [0|0] "" Vector__XXX
 SG_ EPBL_a225_esmOpTrigger m225 : 16|6@1+ (1,0) [0|0] "" Vector__XXX
 SG_ EPBL_a241_desiredState m241 : 16|1@1+ (1,0) [0|0] "" Vector__XXX
 SG_ EPBL_a242_hvcDesiredState m242 : 16|1@1+ (1,0) [0|0] "" Vector__XXX
 SG_ EPBL_a243_brakeMasterCylPress m243 : 16|1@1+ (1,0) [0|0] "" Vector__XXX
 SG_ EPBL_a244_permissiveMode m244 : 16|1@1+ (1,0) [0|0] "" Vector__XXX
 SG_ EPBL_a246_previousState m246 : 16|5@1+ (1,0) [0|0] "" Vector__XXX
 SG_ EPBL_a247_esmState m247 : 16|5@1+ (1,0) [0|0] "" Vector__XXX
 SG_ EPBL_a248_esmState m248 : 16|5@1+ (1,0) [0|0] "" Vector__XXX
 SG_ EPBL_a249_previousState m249 : 16|5@1+ (1,0) [0|0] "" Vector__XXX
 SG_ EPBL_a250_esmSpeedClass m250 : 16|3@1+ (1,0) [0|0] "" Vector__XXX
 SG_ EPBL_a251_currentVariance m251 : 16|12@1+ (0.01,0) [0|0] "" Vector__XXX
 SG_ EPBL_a253_esmState m253 : 16|5@1+ (1,0) [0|0] "" Vector__XXX
 SG_ EPBL_a256_esmState m256 : 16|5@1+ (1,0) [0|0] "" Vector__XXX
 SG_ EPBL_a262_inputVoltageTooLow m262 : 16|1@1+ (1,0) [0|0] "" Vector__XXX
 SG_ EPBL_a263_esmState m263 : 16|5@1+ (1,0) [0|0] "" Vector__XXX
 SG_ EPBL_a264_uiWinchModeRequestExit m264 : 16|1@1+ (1,0) [0|0] "" Vector__XXX
 SG_ EPBL_a272_expectedState m272 : 16|2@1+ (1,0) [0|0] "" Vector__XXX
 SG_ EPBL_a300_harnessId m300 : 16|8@1+ (1,0) [0|0] "" Vector__XXX
 SG_ EPBL_a301_setSpeed m301 : 16|16@1+ (0.05,0) [0|0] "" Vector__XXX
 SG_ EPBL_a302_pistonPosition m302 : 16|13@1- (9.768009768009769,0) [0|0] "" Vector__XXX
 SG_ EPBL_a303_currentVariance m303 : 16|12@1+ (0.01,0) [0|0] "" Vector__XXX
 SG_ EPBL_a350_ensPeriod m350 : 16|16@1+ (0.0001,0) [0|0] "" Vector__XXX
 SG_ EPBL_a352_pointsAboveThreshold m352 : 16|10@1+ (1,0) [0|0] "" Vector__XXX
 SG_ EPBL_a353_alertPath m353 : 16|2@1+ (1,0) [0|0] "" Vector__XXX
 SG_ EPBL_a355_brakeHwConfig m355 : 16|4@1+ (1,0) [0|0] "" Vector__XXX
 SG_ EPBL_a357_epbSystemStatus m357 : 16|4@1+ (1,0) [0|0] "" Vector__XXX
 SG_ EPBL_a358_epbSystemStatus m358 : 16|4@1+ (1,0) [0|0] "" Vector__XXX
 SG_ EPBL_a362_brakeMasterCylPress m362 : 16|12@1- (0.1,130) [0|0] "" Vector__XXX
 SG_ EPBL_a363_brakeMasterCylPress m363 : 16|12@1- (0.1,130) [0|0] "" Vector__XXX
 SG_ EPBL_a364_masterCylOffsetComp m364 : 16|12@1- (0.05,0) [0|0] "" Vector__XXX
 SG_ EPBL_a365_epbSystemStatus m365 : 16|4@1+ (1,0) [0|0] "" Vector__XXX
 SG_ EPBL_a366_epbSystemStatus m366 : 16|4@1+ (1,0) [0|0] "" Vector__XXX
 SG_ EPBL_a370_messageID m370 : 16|11@1+ (1,0) [0|0] "" Vector__XXX
 SG_ EPBL_alertState : 15|1@1+ (1,0) [0|0] "" Vector__XXX
 SG_ EPBL_alertID M : 0|9@1+ (1,0) [0|0] "" Vector__XXX

CM_ BO_ 1465 "ESP32-DualCAN Model3_CH. Not seen on this car in the logs.";
VAL_ 1465 DAS_sw074_roadClass 0 "UNKNOWN_INVALID_SNA" 1 "CLASS_1_MAJOR" 2 "CLASS_2" 3 "CLASS_3" 4 "CLASS_4" 5 "CLASS_5" 6 "CLASS_6_MINOR" ;
VAL_ 1465 DAS_sw050_aebEnable 0 "AEB_OFF" 1 "AEB_ON" 3 "SNA" ;
VAL_ 1465 DAS_sw006_trailerMode 0 "OFF" 1 "ON" ;
VAL_ 1465 DAS_sw086_roadClass 0 "UNKNOWN_INVALID_SNA" 1 "CLASS_1_MAJOR" 2 "CLASS_2" 3 "CLASS_3" 4 "CLASS_4" 5 "CLASS_5" 6 "CLASS_6_MINOR" ;
VAL_ 1465 DAS_sw078_radarTarg1_VxRel 0 "NO_TARGET" ;
VAL_ 1465 DAS_sw042_road_class 0 "SNA" 1 "SUPERCHARGER" 2 "URBANCHARGER" ;
VAL_ 1465 DAS_sw077_oocOffCourseDist_cm 255 "MAX_DOOR_HEIGHT_SNA" ;
VAL_ 1465 DAS_sw006_yawRate 4294934528 "SNA" ;
VAL_ 1465 DAS_sw080_cruise_lever_state 0 "STANDBY" 1 "DRIVE" 2 "SUPPORT" 3 "CHARGE" 4 "FEIM" 5 "CLEAR_FAULT" 6 "FAULT" 7 "WELD" 8 "TEST" 9 "SNA" 10 "DIAG" ;
VAL_ 1465 DAS_sw199_internalState 0 "NO_MODE_ACTIVE" 1 "PRE_DRIVE_CHECK" 2 "LOCAL_BRAKE_REQUEST" 3 "EXTERNAL_BRAKE_REQUEST" 4 "DIAGNOSTIC" 5 "TRANSITION_TO_IDLE" 6 "POST_DRIVE_CHECK" ;
VAL_ 1465 DAS_sw082_road_class 0 "SNA" 1 "SUPERCHARGER" 2 "URBANCHARGER" ;
VAL_ 1465 DAS_sw078_radarTarg1_dx 255 "SNA" ;
VAL_ 1465 DAS_sw025_torsionBarTorque 4094 "UNDEFINABLE_DATA" 4095 "SNA" ;
VAL_ 1465 DAS_sw071_airSuspension 0 "NONE" ;
VAL_ 1465 DAS_sw006_gear 0 "INVALID" 1 "P" 2 "R" 3 "N" 4 "D" 7 "SNA" ;
VAL_ 1465 DAS_sw069_roadClass 0 "UNKNOWN_INVALID_SNA" 1 "CLASS_1_MAJOR" 2 "CLASS_2" 3 "CLASS_3" 4 "CLASS_4" 5 "CLASS_5" 6 "CLASS_6_MINOR" ;
VAL_ 1465 DAS_sw006_steeringAngle 16383 "SNA" ;
VAL_ 1465 DAS_sw202_vehicleSpeed 8191 "SNA" ;
VAL_ 1465 DAS_sw195_vehicleSpeed 8191 "SNA" ;
VAL_ 1465 DAS_sw080_road_class 0 "SNA" 1 "SUPERCHARGER" 2 "URBANCHARGER" ;
VAL_ 1465 DAS_sw078_radarTarg5_VxRel 0 "NO_TARGET" ;
VAL_ 1465 DAS_sw071_roadClass 0 "UNKNOWN_INVALID_SNA" 1 "CLASS_1_MAJOR" 2 "CLASS_2" 3 "CLASS_3" 4 "CLASS_4" 5 "CLASS_5" 6 "CLASS_6_MINOR" ;
VAL_ 1465 DAS_sw025_offsetSide 0 "NO_OFFSET" 1 "OFFSET_RIGHT_OBJECT" 2 "OFFSET_LEFT_OBJECT" 3 "OFFSET_BOTH_OBJECTS" ;
VAL_ 1465 DAS_sw077_vehicleSpeed 8191 "SNA" ;
VAL_ 1465 DAS_sw181_rRepeatCamExtYawCal 511 "SNA" ;
VAL_ 1465 DAS_sw180_lRepeatCamExtYawCal 511 "SNA" ;
VAL_ 1465 DAS_sw179_rPillarCamExtYawCal 511 "SNA" ;
VAL_ 1465 DAS_sw178_lPillarCamExtYawCal 511 "SNA" ;
VAL_ 1465 DAS_sw177_fisheyeCamExtYawCal 511 "SNA" ;
VAL_ 1465 DAS_sw132_narrowCamExtYawCal 511 "SNA" ;
VAL_ 1465 DAS_sw131_mainCamExtYawCal 511 "SNA" ;
VAL_ 1465 DAS_sw005_gear 0 "INVALID" 1 "P" 2 "R" 3 "N" 4 "D" 7 "SNA" ;
VAL_ 1465 DAS_sw085_roadClass 0 "UNKNOWN_INVALID_SNA" 1 "CLASS_1_MAJOR" 2 "CLASS_2" 3 "CLASS_3" 4 "CLASS_4" 5 "CLASS_5" 6 "CLASS_6_MINOR" ;
VAL_ 1465 DAS_sw083_Targ5_dx 255 "SNA" ;
VAL_ 1465 DAS_sw078_radarTarg5_dx 255 "SNA" ;
VAL_ 1465 DAS_sw043_mesp_health_main_state 0 "STANDBY" 1 "DRIVE" 2 "SUPPORT" 3 "CHARGE" 4 "FEIM" 5 "CLEAR_FAULT" 6 "FAULT" 7 "WELD" 8 "TEST" 9 "SNA" 10 "DIAG" ;
VAL_ 1465 DAS_sw005_steeringAngle 16383 "SNA" ;
VAL_ 1465 DAS_sw066_mobileye_main_state 0 "STANDBY" 1 "DRIVE" 2 "SUPPORT" 3 "CHARGE" 4 "FEIM" 5 "CLEAR_FAULT" 6 "FAULT" 7 "WELD" 8 "TEST" 9 "SNA" 10 "DIAG" ;
VAL_ 1465 DAS_sw065_mobileye_main_state 0 "STANDBY" 1 "DRIVE" 2 "SUPPORT" 3 "CHARGE" 4 "FEIM" 5 "CLEAR_FAULT" 6 "FAULT" 7 "WELD" 8 "TEST" 9 "SNA" 10 "DIAG" ;
VAL_ 1465 DAS_sw004_accState 0 "ACC_CANCEL_GENERIC" 3 "ACC_HOLD" 4 "ACC_ON" 5 "APC_BACKWARD" 6 "APC_FORWARD" 7 "APC_COMPLETE" 8 "APC_ABORT" 9 "APC_PAUSE" 10 "APC_UNPARK_COMPLETE" 11 "APC_SELFPARK_START" 13 "ACC_CANCEL_GENERIC_SILENT" 15 "FAULT_SNA" ;
VAL_ 1465 DAS_sw203_roadClass 0 "UNKNOWN_INVALID_SNA" 1 "CLASS_1_MAJOR" 2 "CLASS_2" 3 "CLASS_3" 4 "CLASS_4" 5 "CLASS_5" 6 "CLASS_6_MINOR" ;
VAL_ 1465 DAS_sw069_eacStatus 0 "INHIBITED" 1 "AVAILABLE" 2 "ACTIVE" 3 "FAULT" 4 "LKA_ELK_AVAILABLE" 5 "LKA_ACTIVE" 6 "ELK_AVAILABLE" 7 "ELK_ACTIVE" ;
VAL_ 1465 DAS_sw220_vehicleSpeed 8191 "SNA" ;
VAL_ 1465 DAS_sw219_vehicleSpeed 8191 "SNA" ;
VAL_ 1465 DAS_sw047_roadClass 0 "UNKNOWN_INVALID_SNA" 1 "CLASS_1_MAJOR" 2 "CLASS_2" 3 "CLASS_3" 4 "CLASS_4" 5 "CLASS_5" 6 "CLASS_6_MINOR" ;
VAL_ 1465 DAS_sw025_road_class 0 "SNA" 1 "SUPERCHARGER" 2 "URBANCHARGER" ;
VAL_ 1465 DAS_sw227_vehicleSpeed 8191 "SNA" ;
VAL_ 1465 DAS_sw027_Unused_Bit_0 0 "0" 1 "1" 2 "2" 3 "3" 4 "4" 5 "5" 6 "6" 7 "7" 8 "8" 9 "9" 10 "10" 11 "11" 12 "12" 13 "13" 14 "14" 15 "15" 16 "16" 17 "17" 18 "18" 19 "19" 20 "20" 21 "21" 22 "22" 23 "23" 24 "24" 25 "25" 26 "26" 27 "27" 28 "28" 29 "29" 30 "30" 31 "31" ;
VAL_ 1465 DAS_sw220_roadClass 0 "UNKNOWN_INVALID_SNA" 1 "CLASS_1_MAJOR" 2 "CLASS_2" 3 "CLASS_3" 4 "CLASS_4" 5 "CLASS_5" 6 "CLASS_6_MINOR" ;
VAL_ 1465 DAS_sw219_roadClass 0 "UNKNOWN_INVALID_SNA" 1 "CLASS_1_MAJOR" 2 "CLASS_2" 3 "CLASS_3" 4 "CLASS_4" 5 "CLASS_5" 6 "CLASS_6_MINOR" ;
VAL_ 1465 DAS_sw064_status 0 "DISABLED" 1 "ENABLED" 2 "TEMPORARY_FAILURE" 3 "SNA" ;
VAL_ 1465 DAS_sw181_rRepeatCamExtPitchCal 511 "SNA" ;
VAL_ 1465 DAS_sw180_lRepeatCamExtPitchCal 511 "SNA" ;
VAL_ 1465 DAS_sw179_rPillarCamExtPitchCal 511 "SNA" ;
VAL_ 1465 DAS_sw178_lPillarCamExtPitchCal 511 "SNA" ;
VAL_ 1465 DAS_sw177_fisheyeCamExtPitchCal 511 "SNA" ;
VAL_ 1465 DAS_sw132_narrowCamExtPitchCal 511 "SNA" ;
VAL_ 1465 DAS_sw131_mainCamExtPitchCal 511 "SNA" ;
VAL_ 1465 DAS_sw078_camCipv_dx 255 "SNA" ;
VAL_ 1465 DAS_sw066_app_mobileye_status 0 "DISABLED" 1 "ENABLED" 2 "TEMPORARY_FAILURE" 3 "SNA" ;
VAL_ 1465 DAS_sw065_app_mobileye_status 0 "DISABLED" 1 "ENABLED" 2 "TEMPORARY_FAILURE" 3 "SNA" ;
VAL_ 1465 DAS_sw043_mobileye_status 0 "DISABLED" 1 "ENABLED" 2 "TEMPORARY_FAILURE" 3 "SNA" ;
VAL_ 1465 DAS_sw042_health_state 0 "STANDBY" 1 "DRIVE" 2 "SUPPORT" 3 "CHARGE" 4 "FEIM" 5 "CLEAR_FAULT" 6 "FAULT" 7 "WELD" 8 "TEST" 9 "SNA" 10 "DIAG" ;
VAL_ 1465 DAS_sw030_heaterState 0 "OFF_SNA" 1 "ON" ;
VAL_ 1465 DAS_alertState 0 "CLEARED" 1 "SET" ;
VAL_ 1465 DAS_alertID 0 "ALERT_DO_NOT_USE_ZERO" 1 "a001_DriverDoorOpen" 2 "a002_DoorOpen" 3 "a003_TrunkOpen" 4 "a004_FrunkOpen" 5 "a005_HeadlightsOnDoorOpen" 6 "a006_RemoteServiceAlert" 7 "a007_SoftPackConfigMismatch" 8 "a008_TouchScreenError" 9 "a009_SquashfsError" 10 "a010_MapsMissing" 11 "a011_IncorrectMap" 12 "a012_NotOnPrivateProperty" 13 "a013_TPMSHardWarning" 14 "a014_TPMSSoftWarning" 15 "a015_TPMSOverPressureWarning" 16 "a016_TPMSTemperatureWarning" 17 "a017_TPMSSystemFault" 18 "a018_SlipStartOn" 19 "a019_ParkBrakeFault" 20 "a020_SteeringReduced" 21 "a021_RearSeatbeltUnbuckled" 22 "a022_ApeFusesEtc" 23 "a023_CellInternetCheckFailed" 24 "a024_WifiInternetCheckFailed" 25 "a025_WifiOnlineCheckFailed" 26 "a026_ModemResetLoopDetected" 27 "a027_AutoSteerMIA" 28 "a028_FrontTrunkPopupClosed" 29 "a029_ModemMIA" 30 "a030_ModemVMCrash" 31 "a031_BrakeFluidLow" 32 "a032_CellModemRecoveryResets" 33 "a033_ApTrialExpired" 34 "a034_WakeupProblem" 35 "a035_AudioWatchdogKernelError" 36 "a036_AudioWatchdogHfpError" 37 "a037_AudioWatchdogXrunStormError" 38 "a038_AudioWatchdogA2bI2cLockupError" 39 "a039_AudioA2bNeedRediscovery" 40 "a040_HomelinkTransmit" 41 "a041_AudioDmesgXrun" 42 "a042_AudioDmesgRtThrottling" 43 "a043_InvalidMapDataOverride" 44 "a044_AudioDmesgDspException" 45 "a045_ECallNeedsService" 46 "a046_BackupCameraStreamError" 47 "a047_CellRoamingDisallowed" 48 "a048_AudioPremiumAmpCheckFailed" 49 "a049_BrakeShiftRequired" 50 "a050_BackupCameraIPUTimeout" 51 "a051_BackupCameraFrameTimeout" 52 "a052_KernelPanicReported" 53 "a053_QtCarExitError" 54 "a054_AudioBoostPowerBad" 55 "a055_ManualECallDisabled" 56 "a056_ManualECallButtonDisconnected" 57 "a057_CellAntennaDisconnected" 58 "a058_GPSAntennaDisconnected" 59 "a059_ECallSpeakerDisconnected" 60 "a060_ECallMicDisconnected" 61 "a061_SIMTestFailed" 62 "a062_ENSTestFailed" 63 "a063_CellularTestFailed" 64 "a064_ModemFirmwareTestFailed" 65 "a065_WiFiRecoveryReset" 66 "a066_GpuHangDetected" 67 "a067_WarnOnI915" 68 "a068_VideoUnexpectedExit" 69 "a069_VideoUDPTimeout" 70 "a070_VideoPipelineWarning" 71 "a071_VideoPipelineError" 72 "a072_ECallAnalogMicFailed" 73 "a073_ECallDigitalMicFailed" 74 "a074_EMMCHangDetected" 75 "a075_BackupCameraInitError" 76 "a076_NumFalseManualECalls" 77 "a077_AudioA2bMicChannelSwap" 78 "a078_DashcamUsbDriveUnmountable" 79 "a079_DashcamUsbDriveFull" 80 "a080_DashcamUsbDriveSlow" 81 "a081_CellModemSearchExpired" 82 "a082_NumModemRebootStuckInECall" 83 "a083_ECallProxyWatchdogTriggered" 84 "a084_SerializerError" 85 "a085_DeserializerError" 86 "a086_TouchEnumerationError" 87 "a087_BmpReset" 88 "a088_CellRemovableSimMissing" 89 "a089_RadioSoftResetError" 90 "a090_RadioPingFailError" 91 "a091_VehicleLinkStall" 92 "a092_updateStarted" 93 "a093_updateEnded" 94 "a094_ModemPowerOnFailure" 95 "a095_CidStorageRunningLow" 96 "a096_VideodPipelineIssueDetected" 97 "a097_AudiodRestarted" 98 "a098_DiskCheckFailure" 99 "a099_eMMCStatusError" 100 "a100_eMMCFTLError" 101 "a101_wifiStackProblem" 102 "a102_A2bDiscoveryFailed" 103 "a103_UsbHubNotEnumerating" 104 "a104_DashcamUsbDriveMissing" 105 "a105_firmwareReinstallRequested" 106 "a106_rebootBackstopTriggered" 107 "a107_DashcamUsbDriveTooBigForVfatFsck" 108 "a108_DashcamUsbDriveGettingFull" 109 "a109_DashcamUsbDriveTooSmall" 110 "a110_DashcamUsbDriveCorrupt" 111 "a111_DashcamUsbDriveWrongPort" 112 "a112_badUSBDevice" 113 "a113_DashcamHasOnboardSentryClips" ;
CM_ BO_ 1467 "ESP32-DualCAN Model3_VEH. Not seen on this car in the logs.";
VAL_ 1467 SDCR_matrixIndex 0 "AlertMatrix0" 1 "AlertMatrix1" 2 "AlertMatrix2" ;
CM_ BO_ 1469 "ESP32-DualCAN Model3_CH. Seen on this car: 8-byte frames; fit weak (bits covered 0%, mux 100%, ranges 100%).";
VAL_ 1469 IBST_alertState 0 "CLEARED" 1 "SET" ;
VAL_ 1469 IBST_alertID 0 "ALERT_DO_NOT_USE_ZERO" 1 "a001_DriverDoorOpen" 2 "a002_DoorOpen" 3 "a003_TrunkOpen" 4 "a004_FrunkOpen" 5 "a005_HeadlightsOnDoorOpen" 6 "a006_RemoteServiceAlert" 7 "a007_SoftPackConfigMismatch" 8 "a008_TouchScreenError" 9 "a009_SquashfsError" 10 "a010_MapsMissing" 11 "a011_IncorrectMap" 12 "a012_NotOnPrivateProperty" 13 "a013_TPMSHardWarning" 14 "a014_TPMSSoftWarning" 15 "a015_TPMSOverPressureWarning" 16 "a016_TPMSTemperatureWarning" 17 "a017_TPMSSystemFault" 18 "a018_SlipStartOn" 19 "a019_ParkBrakeFault" 20 "a020_SteeringReduced" 21 "a021_RearSeatbeltUnbuckled" 22 "a022_ApeFusesEtc" 23 "a023_CellInternetCheckFailed" 24 "a024_WifiInternetCheckFailed" 25 "a025_WifiOnlineCheckFailed" 26 "a026_ModemResetLoopDetected" 27 "a027_AutoSteerMIA" 28 "a028_FrontTrunkPopupClosed" 29 "a029_ModemMIA" 30 "a030_ModemVMCrash" 31 "a031_BrakeFluidLow" 32 "a032_CellModemRecoveryResets" 33 "a033_ApTrialExpired" 34 "a034_WakeupProblem" 35 "a035_AudioWatchdogKernelError" 36 "a036_AudioWatchdogHfpError" 37 "a037_AudioWatchdogXrunStormError" 38 "a038_AudioWatchdogA2bI2cLockupError" 39 "a039_AudioA2bNeedRediscovery" 40 "a040_HomelinkTransmit" 41 "a041_AudioDmesgXrun" 42 "a042_AudioDmesgRtThrottling" 43 "a043_InvalidMapDataOverride" 44 "a044_AudioDmesgDspException" 45 "a045_ECallNeedsService" 46 "a046_BackupCameraStreamError" 47 "a047_CellRoamingDisallowed" 48 "a048_AudioPremiumAmpCheckFailed" 49 "a049_BrakeShiftRequired" 50 "a050_BackupCameraIPUTimeout" 51 "a051_BackupCameraFrameTimeout" 52 "a052_KernelPanicReported" 53 "a053_QtCarExitError" 54 "a054_AudioBoostPowerBad" 55 "a055_ManualECallDisabled" 56 "a056_ManualECallButtonDisconnected" 57 "a057_CellAntennaDisconnected" 58 "a058_GPSAntennaDisconnected" 59 "a059_ECallSpeakerDisconnected" 60 "a060_ECallMicDisconnected" 61 "a061_SIMTestFailed" 62 "a062_ENSTestFailed" 63 "a063_CellularTestFailed" 64 "a064_ModemFirmwareTestFailed" 65 "a065_WiFiRecoveryReset" 66 "a066_GpuHangDetected" 67 "a067_WarnOnI915" 68 "a068_VideoUnexpectedExit" 69 "a069_VideoUDPTimeout" 70 "a070_VideoPipelineWarning" 71 "a071_VideoPipelineError" 72 "a072_ECallAnalogMicFailed" 73 "a073_ECallDigitalMicFailed" 74 "a074_EMMCHangDetected" 75 "a075_BackupCameraInitError" 76 "a076_NumFalseManualECalls" 77 "a077_AudioA2bMicChannelSwap" 78 "a078_DashcamUsbDriveUnmountable" 79 "a079_DashcamUsbDriveFull" 80 "a080_DashcamUsbDriveSlow" 81 "a081_CellModemSearchExpired" 82 "a082_NumModemRebootStuckInECall" 83 "a083_ECallProxyWatchdogTriggered" 84 "a084_SerializerError" 85 "a085_DeserializerError" 86 "a086_TouchEnumerationError" 87 "a087_BmpReset" 88 "a088_CellRemovableSimMissing" 89 "a089_RadioSoftResetError" 90 "a090_RadioPingFailError" 91 "a091_VehicleLinkStall" 92 "a092_updateStarted" 93 "a093_updateEnded" 94 "a094_ModemPowerOnFailure" 95 "a095_CidStorageRunningLow" 96 "a096_VideodPipelineIssueDetected" 97 "a097_AudiodRestarted" 98 "a098_DiskCheckFailure" 99 "a099_eMMCStatusError" 100 "a100_eMMCFTLError" 101 "a101_wifiStackProblem" 102 "a102_A2bDiscoveryFailed" 103 "a103_UsbHubNotEnumerating" 104 "a104_DashcamUsbDriveMissing" 105 "a105_firmwareReinstallRequested" 106 "a106_rebootBackstopTriggered" 107 "a107_DashcamUsbDriveTooBigForVfatFsck" 108 "a108_DashcamUsbDriveGettingFull" 109 "a109_DashcamUsbDriveTooSmall" 110 "a110_DashcamUsbDriveCorrupt" 111 "a111_DashcamUsbDriveWrongPort" 112 "a112_badUSBDevice" 113 "a113_DashcamHasOnboardSentryClips" ;
CM_ BO_ 1480 "ESP32-DualCAN Model3_VEH. Seen on this car: 8-byte frames; fit weak (bits covered 0%, mux 100%, ranges 100%).";
VAL_ 1480 EPBL_a198_version 254 "LOCAL_BUILD" 255 "SNA" ;
VAL_ 1480 EPBL_a198_ambientTemp 4294966273 "SNA" ;
VAL_ 1480 EPBL_a357_trailerDetected 0 "NOT_DETECTED" 1 "DETECTED" ;
VAL_ 1480 EPBL_a358_trailerDetected 0 "NOT_DETECTED" 1 "DETECTED" ;
VAL_ 1480 EPBL_a198_learnedEpbConfig 0 "UNKNOWN" 1 "MODEL3_BASE" 2 "MODEL3_PERFORMANCE" 3 "MODELS_BASE" 4 "MODELY_BASE" 5 "MODELY_PERFORMANCE" 6 "MODELX_BASE" 7 "MODEL3_PERFORMANCE_V2" 8 "MODELY_PERFORMANCE_V2" 9 "MODELS_CERAMIC" ;
VAL_ 1480 EPBL_a182_trailerDetected 0 "NOT_DETECTED" 1 "DETECTED" ;
VAL_ 1480 EPBL_a365_trailerDetected 0 "NOT_DETECTED" 1 "DETECTED" ;
VAL_ 1480 EPBL_a366_trailerDetected 0 "NOT_DETECTED" 1 "DETECTED" ;
VAL_ 1480 EPBL_a104_BDY_status 0 "DISABLED" 1 "ENABLED" 2 "TEMPORARY_FAILURE" 3 "SNA" ;
VAL_ 1480 EPBL_a174_csmFaultReason 0 "NONE" 1 "EPBM_DISABLED" 2 "EPBM_FAULTED" 3 "STATE_MISMATCH" 4 "TIMEOUT_CALIBRATE" 5 "APPLY_BLOCKED" 6 "RELEASE_BLOCKED" 7 "TIMEOUT_APPLY_COMPLETE" 8 "TIMEOUT_APPLY_INRUSH" 9 "TIMEOUT_WAIT_FOR_CLAMP" 10 "TIMEOUT_RELEASE_INRUSH" 11 "TIMEOUT_RELEASE_WAIT_FOR_ENDSTOP" 12 "TIMEOUT_RELEASE_COMPLETE" 13 "TIMEOUT_EPBM_CUTOFF" 14 "TIMEOUT_NO_RAMP" 15 "TIMEOUT_EPBM_START" 16 "MOTOR_IDLE_FAULT" 17 "MOTOR_ACTIVE_FAULT" 18 "MOTOR_NOT_READY" 19 "EPBM_MIA" 20 "NVM_MISMATCH" 21 "REMOTE_MIA" ;
VAL_ 1480 EPBL_a175_csmFaultReason 0 "NONE" 1 "EPBM_DISABLED" 2 "EPBM_FAULTED" 3 "STATE_MISMATCH" 4 "TIMEOUT_CALIBRATE" 5 "APPLY_BLOCKED" 6 "RELEASE_BLOCKED" 7 "TIMEOUT_APPLY_COMPLETE" 8 "TIMEOUT_APPLY_INRUSH" 9 "TIMEOUT_WAIT_FOR_CLAMP" 10 "TIMEOUT_RELEASE_INRUSH" 11 "TIMEOUT_RELEASE_WAIT_FOR_ENDSTOP" 12 "TIMEOUT_RELEASE_COMPLETE" 13 "TIMEOUT_EPBM_CUTOFF" 14 "TIMEOUT_NO_RAMP" 15 "TIMEOUT_EPBM_START" 16 "MOTOR_IDLE_FAULT" 17 "MOTOR_ACTIVE_FAULT" 18 "MOTOR_NOT_READY" 19 "EPBM_MIA" 20 "NVM_MISMATCH" 21 "REMOTE_MIA" ;
VAL_ 1480 EPBL_a176_csmFaultReason 0 "NONE" 1 "EPBM_DISABLED" 2 "EPBM_FAULTED" 3 "STATE_MISMATCH" 4 "TIMEOUT_CALIBRATE" 5 "APPLY_BLOCKED" 6 "RELEASE_BLOCKED" 7 "TIMEOUT_APPLY_COMPLETE" 8 "TIMEOUT_APPLY_INRUSH" 9 "TIMEOUT_WAIT_FOR_CLAMP" 10 "TIMEOUT_RELEASE_INRUSH" 11 "TIMEOUT_RELEASE_WAIT_FOR_ENDSTOP" 12 "TIMEOUT_RELEASE_COMPLETE" 13 "TIMEOUT_EPBM_CUTOFF" 14 "TIMEOUT_NO_RAMP" 15 "TIMEOUT_EPBM_START" 16 "MOTOR_IDLE_FAULT" 17 "MOTOR_ACTIVE_FAULT" 18 "MOTOR_NOT_READY" 19 "EPBM_MIA" 20 "NVM_MISMATCH" 21 "REMOTE_MIA" ;
VAL_ 1480 EPBL_a177_csmFaultReason 0 "NONE" 1 "EPBM_DISABLED" 2 "EPBM_FAULTED" 3 "STATE_MISMATCH" 4 "TIMEOUT_CALIBRATE" 5 "APPLY_BLOCKED" 6 "RELEASE_BLOCKED" 7 "TIMEOUT_APPLY_COMPLETE" 8 "TIMEOUT_APPLY_INRUSH" 9 "TIMEOUT_WAIT_FOR_CLAMP" 10 "TIMEOUT_RELEASE_INRUSH" 11 "TIMEOUT_RELEASE_WAIT_FOR_ENDSTOP" 12 "TIMEOUT_RELEASE_COMPLETE" 13 "TIMEOUT_EPBM_CUTOFF" 14 "TIMEOUT_NO_RAMP" 15 "TIMEOUT_EPBM_START" 16 "MOTOR_IDLE_FAULT" 17 "MOTOR_ACTIVE_FAULT" 18 "MOTOR_NOT_READY" 19 "EPBM_MIA" 20 "NVM_MISMATCH" 21 "REMOTE_MIA" ;
VAL_ 1480 EPBL_a179_csmFaultReason 0 "NONE" 1 "EPBM_DISABLED" 2 "EPBM_FAULTED" 3 "STATE_MISMATCH" 4 "TIMEOUT_CALIBRATE" 5 "APPLY_BLOCKED" 6 "RELEASE_BLOCKED" 7 "TIMEOUT_APPLY_COMPLETE" 8 "TIMEOUT_APPLY_INRUSH" 9 "TIMEOUT_WAIT_FOR_CLAMP" 10 "TIMEOUT_RELEASE_INRUSH" 11 "TIMEOUT_RELEASE_WAIT_FOR_ENDSTOP" 12 "TIMEOUT_RELEASE_COMPLETE" 13 "TIMEOUT_EPBM_CUTOFF" 14 "TIMEOUT_NO_RAMP" 15 "TIMEOUT_EPBM_START" 16 "MOTOR_IDLE_FAULT" 17 "MOTOR_ACTIVE_FAULT" 18 "MOTOR_NOT_READY" 19 "EPBM_MIA" 20 "NVM_MISMATCH" 21 "REMOTE_MIA" ;
VAL_ 1480 EPBL_a183_esmOperationTrigger 0 "PBUTTON_PRESSED_STOPPED" 1 "PBUTTON_PRESSED_OKTOPARK" 2 "PBUTTON_PRESSED_FAST" 3 "PBUTTON_PRESSED_UNKNOWN" 4 "PBUTTON_RELEASED" 5 "ACTIVE_PARK_REQUEST" 6 "DI_UNPARK" 7 "TOUCHSCREEN" 8 "WINCHMODE_EXIT" 9 "WINCHMODE_ENTER" 10 "WINCHMODE_UNAVAILABLE" 11 "SERVICE" 12 "DIAG_CLOSE" 13 "DIAG_OPEN" 14 "DIAG_EXIT" 15 "USER_CONFIRMED" 16 "USER_CANCEL" 17 "SPEED_STOPPED" 18 "SPEED_OKAYTOPARK" 19 "SPEED_FAST" 20 "TIMEOUT" 21 "SAVESTATE_ON_BOOT" 22 "REAPPLY" 23 "SUMMON_COMPLETE" 24 "FAULT" 25 "SUMMON_FAULT" 26 "DISQUALIFIED" 27 "EPBM_DISQUALIFIED" 28 "ACCELERATION" 29 "SYSTEM_APPLY" 30 "DRIVER_IS_LEAVING" 31 "AUTOPARK_END" ;
VAL_ 1480 EPBL_a190_csmFaultReason 0 "NONE" 1 "EPBM_DISABLED" 2 "EPBM_FAULTED" 3 "STATE_MISMATCH" 4 "TIMEOUT_CALIBRATE" 5 "APPLY_BLOCKED" 6 "RELEASE_BLOCKED" 7 "TIMEOUT_APPLY_COMPLETE" 8 "TIMEOUT_APPLY_INRUSH" 9 "TIMEOUT_WAIT_FOR_CLAMP" 10 "TIMEOUT_RELEASE_INRUSH" 11 "TIMEOUT_RELEASE_WAIT_FOR_ENDSTOP" 12 "TIMEOUT_RELEASE_COMPLETE" 13 "TIMEOUT_EPBM_CUTOFF" 14 "TIMEOUT_NO_RAMP" 15 "TIMEOUT_EPBM_START" 16 "MOTOR_IDLE_FAULT" 17 "MOTOR_ACTIVE_FAULT" 18 "MOTOR_NOT_READY" 19 "EPBM_MIA" 20 "NVM_MISMATCH" 21 "REMOTE_MIA" ;
VAL_ 1480 EPBL_a191_csmFaultReason 0 "NONE" 1 "EPBM_DISABLED" 2 "EPBM_FAULTED" 3 "STATE_MISMATCH" 4 "TIMEOUT_CALIBRATE" 5 "APPLY_BLOCKED" 6 "RELEASE_BLOCKED" 7 "TIMEOUT_APPLY_COMPLETE" 8 "TIMEOUT_APPLY_INRUSH" 9 "TIMEOUT_WAIT_FOR_CLAMP" 10 "TIMEOUT_RELEASE_INRUSH" 11 "TIMEOUT_RELEASE_WAIT_FOR_ENDSTOP" 12 "TIMEOUT_RELEASE_COMPLETE" 13 "TIMEOUT_EPBM_CUTOFF" 14 "TIMEOUT_NO_RAMP" 15 "TIMEOUT_EPBM_START" 16 "MOTOR_IDLE_FAULT" 17 "MOTOR_ACTIVE_FAULT" 18 "MOTOR_NOT_READY" 19 "EPBM_MIA" 20 "NVM_MISMATCH" 21 "REMOTE_MIA" ;
VAL_ 1480 EPBL_a247_csmFaultReason 0 "NONE" 1 "EPBM_DISABLED" 2 "EPBM_FAULTED" 3 "STATE_MISMATCH" 4 "TIMEOUT_CALIBRATE" 5 "APPLY_BLOCKED" 6 "RELEASE_BLOCKED" 7 "TIMEOUT_APPLY_COMPLETE" 8 "TIMEOUT_APPLY_INRUSH" 9 "TIMEOUT_WAIT_FOR_CLAMP" 10 "TIMEOUT_RELEASE_INRUSH" 11 "TIMEOUT_RELEASE_WAIT_FOR_ENDSTOP" 12 "TIMEOUT_RELEASE_COMPLETE" 13 "TIMEOUT_EPBM_CUTOFF" 14 "TIMEOUT_NO_RAMP" 15 "TIMEOUT_EPBM_START" 16 "MOTOR_IDLE_FAULT" 17 "MOTOR_ACTIVE_FAULT" 18 "MOTOR_NOT_READY" 19 "EPBM_MIA" 20 "NVM_MISMATCH" 21 "REMOTE_MIA" ;
VAL_ 1480 EPBL_a248_csmFaultReason 0 "NONE" 1 "EPBM_DISABLED" 2 "EPBM_FAULTED" 3 "STATE_MISMATCH" 4 "TIMEOUT_CALIBRATE" 5 "APPLY_BLOCKED" 6 "RELEASE_BLOCKED" 7 "TIMEOUT_APPLY_COMPLETE" 8 "TIMEOUT_APPLY_INRUSH" 9 "TIMEOUT_WAIT_FOR_CLAMP" 10 "TIMEOUT_RELEASE_INRUSH" 11 "TIMEOUT_RELEASE_WAIT_FOR_ENDSTOP" 12 "TIMEOUT_RELEASE_COMPLETE" 13 "TIMEOUT_EPBM_CUTOFF" 14 "TIMEOUT_NO_RAMP" 15 "TIMEOUT_EPBM_START" 16 "MOTOR_IDLE_FAULT" 17 "MOTOR_ACTIVE_FAULT" 18 "MOTOR_NOT_READY" 19 "EPBM_MIA" 20 "NVM_MISMATCH" 21 "REMOTE_MIA" ;
VAL_ 1480 EPBL_a117_VEH_status 0 "DISABLED" 1 "ENABLED" 2 "TEMPORARY_FAILURE" 3 "SNA" ;
VAL_ 1480 EPBL_a104_VEH_status 0 "DISABLED" 1 "ENABLED" 2 "TEMPORARY_FAILURE" 3 "SNA" ;
VAL_ 1480 EPBL_a253_summonState 0 "INIT" 1 "IDLE" 2 "ARMED" 3 "ACTIVE" 4 "COMPLETE" 5 "FAULT" 6 "UNAVAILABLE" ;
VAL_ 1480 EPBL_a114_CH_status 0 "DISABLED" 1 "ENABLED" 2 "TEMPORARY_FAILURE" 3 "SNA" ;
VAL_ 1480 EPBL_a113_VEH_status 0 "DISABLED" 1 "ENABLED" 2 "TEMPORARY_FAILURE" 3 "SNA" ;
VAL_ 1480 EPBL_a116_VEH_status 0 "DISABLED" 1 "ENABLED" 2 "TEMPORARY_FAILURE" 3 "SNA" ;
VAL_ 1480 EPBL_a357_ambientTemp 4294966273 "SNA" ;
VAL_ 1480 EPBL_a358_ambientTemp 4294966273 "SNA" ;
VAL_ 1480 EPBL_a365_ambientTemp 4294966273 "SNA" ;
VAL_ 1480 EPBL_a366_ambientTemp 4294966273 "SNA" ;
VAL_ 1480 EPBL_a109_CH_status 0 "DISABLED" 1 "ENABLED" 2 "TEMPORARY_FAILURE" 3 "SNA" ;
VAL_ 1480 EPBL_a256_vehiclePowerState 0 "OFF" 1 "CONDITIONING" 2 "ACCESSORY" 3 "DRIVE" ;
VAL_ 1480 EPBL_a114_BDY_status 0 "DISABLED" 1 "ENABLED" 2 "TEMPORARY_FAILURE" 3 "SNA" ;
VAL_ 1480 EPBL_a104_PARTY_status 0 "DISABLED" 1 "ENABLED" 2 "TEMPORARY_FAILURE" 3 "SNA" ;
VAL_ 1480 EPBL_a263_esmSpeedClass 0 "STOPPED" 1 "SYSTEM_APPLY_OK" 2 "USER_APPLY_OK" 3 "FAST" 4 "UNKNOWN" ;
VAL_ 1480 EPBL_a104_CH_status 0 "DISABLED" 1 "ENABLED" 2 "TEMPORARY_FAILURE" 3 "SNA" ;
VAL_ 1480 EPBL_a110_CH_airbagCutoffStatus 0 "RCM_PASSENGER_AIRBAG_ENABLED" 1 "RCM_PASSENGER_AIRBAG_DISABLED" 3 "SNA" ;
VAL_ 1480 EPBL_a111_CH_status 0 "DISABLED" 1 "ENABLED" 2 "TEMPORARY_FAILURE" 3 "SNA" ;
VAL_ 1480 EPBL_a120_PT_systemStatus 0 "UNKNOWN" 1 "RELEASED" 2 "PARKED" 3 "DYNAMIC" 4 "PARKING" 5 "RELEASING" 6 "FAULT" 7 "FAULT_SECURE" 8 "MISMATCH" ;
VAL_ 1480 EPBL_a243_brakeDiscWipingActive 0 "INACTIVE" 1 "ACTIVE" ;
VAL_ 1480 EPBL_a109_BDY_status 0 "DISABLED" 1 "ENABLED" 2 "TEMPORARY_FAILURE" 3 "SNA" ;
VAL_ 1480 EPBL_a111_PARTY_status 0 "DISABLED" 1 "ENABLED" 2 "TEMPORARY_FAILURE" 3 "SNA" ;
VAL_ 1480 EPBL_a112_CH_status 0 "DISABLED" 1 "ENABLED" 2 "TEMPORARY_FAILURE" 3 "SNA" ;
VAL_ 1480 EPBL_a243_vehiclePowerState 0 "OFF" 1 "CONDITIONING" 2 "ACCESSORY" 3 "DRIVE" ;
VAL_ 1480 EPBL_a112_PARTY_status 0 "DISABLED" 1 "ENABLED" 2 "TEMPORARY_FAILURE" 3 "SNA" ;
VAL_ 1480 EPBL_a118_VEH_systemStatus 0 "UNKNOWN" 1 "RELEASED" 2 "PARKED" 3 "DYNAMIC" 4 "PARKING" 5 "RELEASING" 6 "FAULT" 7 "FAULT_SECURE" 8 "MISMATCH" ;
VAL_ 1480 EPBL_a120_PARTY_status 0 "DISABLED" 1 "ENABLED" 2 "TEMPORARY_FAILURE" 3 "SNA" ;
VAL_ 1480 EPBL_a181_trailerDetected 0 "NOT_DETECTED" 1 "DETECTED" ;
VAL_ 1480 EPBL_a243_wiperSpeed 0 "SNA" 1 "OFF" 2 "1" 3 "2" 4 "3" 5 "4" 6 "5" 7 "LOW" 8 "HIGH" ;
VAL_ 1480 EPBL_a241_vehiclePowerState 0 "OFF" 1 "CONDITIONING" 2 "ACCESSORY" 3 "DRIVE" ;
VAL_ 1480 EPBL_a242_vehiclePowerState 0 "OFF" 1 "CONDITIONING" 2 "ACCESSORY" 3 "DRIVE" ;
VAL_ 1480 EPBL_a250_esmOperationTrigger 0 "PBUTTON_PRESSED_STOPPED" 1 "PBUTTON_PRESSED_OKTOPARK" 2 "PBUTTON_PRESSED_FAST" 3 "PBUTTON_PRESSED_UNKNOWN" 4 "PBUTTON_RELEASED" 5 "ACTIVE_PARK_REQUEST" 6 "DI_UNPARK" 7 "TOUCHSCREEN" 8 "WINCHMODE_EXIT" 9 "WINCHMODE_ENTER" 10 "WINCHMODE_UNAVAILABLE" 11 "SERVICE" 12 "DIAG_CLOSE" 13 "DIAG_OPEN" 14 "DIAG_EXIT" 15 "USER_CONFIRMED" 16 "USER_CANCEL" 17 "SPEED_STOPPED" 18 "SPEED_OKAYTOPARK" 19 "SPEED_FAST" 20 "TIMEOUT" 21 "SAVESTATE_ON_BOOT" 22 "REAPPLY" 23 "SUMMON_COMPLETE" 24 "FAULT" 25 "SUMMON_FAULT" 26 "DISQUALIFIED" 27 "EPBM_DISQUALIFIED" 28 "ACCELERATION" 29 "SYSTEM_APPLY" 30 "DRIVER_IS_LEAVING" 31 "AUTOPARK_END" ;
VAL_ 1480 EPBL_a107_PT_status 0 "DISABLED" 1 "ENABLED" 2 "TEMPORARY_FAILURE" 3 "SNA" ;
VAL_ 1480 EPBL_a243_tempAmbient 0 "SNA" ;
VAL_ 1480 EPBL_a086_VEH_systemStatus 0 "UNKNOWN" 1 "RELEASED" 2 "PARKED" 3 "DYNAMIC" 4 "PARKING" 5 "RELEASING" 6 "FAULT" 7 "FAULT_SECURE" 8 "MISMATCH" ;
VAL_ 1480 EPBL_a098_PARTY_status 0 "DISABLED" 1 "ENABLED" 2 "TEMPORARY_FAILURE" 3 "SNA" ;
VAL_ 1480 EPBL_a108_PARTY_status 0 "DISABLED" 1 "ENABLED" 2 "TEMPORARY_FAILURE" 3 "SNA" ;
VAL_ 1480 EPBL_a114_VEH_status 0 "DISABLED" 1 "ENABLED" 2 "TEMPORARY_FAILURE" 3 "SNA" ;
VAL_ 1480 EPBL_a243_vehicleSpeed 8191 "SNA" ;
VAL_ 1480 EPBL_a087_PARTY_status 0 "DISABLED" 1 "ENABLED" 2 "TEMPORARY_FAILURE" 3 "SNA" ;
VAL_ 1480 EPBL_a088_PARTY_status 0 "DISABLED" 1 "ENABLED" 2 "TEMPORARY_FAILURE" 3 "SNA" ;
VAL_ 1480 EPBL_a089_CH_status 0 "DISABLED" 1 "ENABLED" 2 "TEMPORARY_FAILURE" 3 "SNA" ;
VAL_ 1480 EPBL_a089_BDY_status 0 "DISABLED" 1 "ENABLED" 2 "TEMPORARY_FAILURE" 3 "SNA" ;
VAL_ 1480 EPBL_a103_PT_status 0 "DISABLED" 1 "ENABLED" 2 "TEMPORARY_FAILURE" 3 "SNA" ;
VAL_ 1480 EPBL_a108_VEH_status 0 "DISABLED" 1 "ENABLED" 2 "TEMPORARY_FAILURE" 3 "SNA" ;
VAL_ 1480 EPBL_a109_VEH_status 0 "DISABLED" 1 "ENABLED" 2 "TEMPORARY_FAILURE" 3 "SNA" ;
VAL_ 1480 EPBL_a242_hvState 0 "DOWN" 1 "COMING_UP" 2 "GOING_DOWN" 3 "UP_FOR_DRIVE" 4 "UP_FOR_CHARGE" 5 "UP_FOR_DC_CHARGE" 6 "UP" ;
VAL_ 1480 EPBL_a087_VEH_status 0 "DISABLED" 1 "ENABLED" 2 "TEMPORARY_FAILURE" 3 "SNA" ;
VAL_ 1480 EPBL_a088_VEH_status 0 "DISABLED" 1 "ENABLED" 2 "TEMPORARY_FAILURE" 3 "SNA" ;
VAL_ 1480 EPBL_a118_VEH_status 0 "DISABLED" 1 "ENABLED" 2 "TEMPORARY_FAILURE" 3 "SNA" ;
VAL_ 1480 EPBL_a120_PARTY_systemStatus 0 "UNKNOWN" 1 "RELEASED" 2 "PARKED" 3 "DYNAMIC" 4 "PARKING" 5 "RELEASING" 6 "FAULT" 7 "FAULT_SECURE" 8 "MISMATCH" ;
VAL_ 1480 EPBL_a086_VEH_status 0 "DISABLED" 1 "ENABLED" 2 "TEMPORARY_FAILURE" 3 "SNA" ;
VAL_ 1480 EPBL_a089_VEH_status 0 "DISABLED" 1 "ENABLED" 2 "TEMPORARY_FAILURE" 3 "SNA" ;
VAL_ 1480 EPBL_a091_VEH_state 0 "STANDBY" 1 "DRIVE" 2 "SUPPORT" 3 "CHARGE" 4 "FEIM" 5 "CLEAR_FAULT" 6 "FAULT" 7 "WELD" 8 "TEST" 9 "SNA" 10 "DIAG" ;
VAL_ 1480 EPBL_a098_VEH_status 0 "DISABLED" 1 "ENABLED" 2 "TEMPORARY_FAILURE" 3 "SNA" ;
VAL_ 1480 EPBL_a103_VEH_status 0 "DISABLED" 1 "ENABLED" 2 "TEMPORARY_FAILURE" 3 "SNA" ;
VAL_ 1480 EPBL_a104_LIPC_status 0 "DISABLED" 1 "ENABLED" 2 "TEMPORARY_FAILURE" 3 "SNA" ;
VAL_ 1480 EPBL_a107_VEH_status 0 "DISABLED" 1 "ENABLED" 2 "TEMPORARY_FAILURE" 3 "SNA" ;
VAL_ 1480 EPBL_a243_drivetrainType 0 "RWD" 1 "AWD" ;
VAL_ 1480 EPBL_a089_PARTY_status 0 "DISABLED" 1 "ENABLED" 2 "TEMPORARY_FAILURE" 3 "SNA" ;
VAL_ 1480 EPBL_a090_VEH_state 0 "STANDBY" 1 "DRIVE" 2 "SUPPORT" 3 "CHARGE" 4 "FEIM" 5 "CLEAR_FAULT" 6 "FAULT" 7 "WELD" 8 "TEST" 9 "SNA" 10 "DIAG" ;
VAL_ 1480 EPBL_a095_PT_status 0 "DISABLED" 1 "ENABLED" 2 "TEMPORARY_FAILURE" 3 "SNA" ;
VAL_ 1480 EPBL_a096_CH_status 0 "DISABLED" 1 "ENABLED" 2 "TEMPORARY_FAILURE" 3 "SNA" ;
VAL_ 1480 EPBL_a097_VEH_state 0 "STANDBY" 1 "DRIVE" 2 "SUPPORT" 3 "CHARGE" 4 "FEIM" 5 "CLEAR_FAULT" 6 "FAULT" 7 "WELD" 8 "TEST" 9 "SNA" 10 "DIAG" ;
VAL_ 1480 EPBL_a111_VEH_status 0 "DISABLED" 1 "ENABLED" 2 "TEMPORARY_FAILURE" 3 "SNA" ;
VAL_ 1480 EPBL_a112_VEH_status 0 "DISABLED" 1 "ENABLED" 2 "TEMPORARY_FAILURE" 3 "SNA" ;
VAL_ 1480 EPBL_a120_VEH_systemStatus 0 "UNKNOWN" 1 "RELEASED" 2 "PARKED" 3 "DYNAMIC" 4 "PARKING" 5 "RELEASING" 6 "FAULT" 7 "FAULT_SECURE" 8 "MISMATCH" ;
VAL_ 1480 EPBL_a243_brakeMasterCylPressQF 0 "NOT_INITIALIZED" 1 "NORMAL" 2 "FAULTED" 3 "FAULTED2" ;
VAL_ 1480 EPBL_a031_uds_bytes_0 0 "0" 1 "1" 2 "2" 3 "3" 4 "4" 5 "5" 6 "6" 7 "7" 8 "8" 9 "9" 10 "10" 11 "11" 12 "12" 13 "13" 14 "14" 15 "15" 16 "16" 17 "17" 18 "18" 19 "19" 20 "20" 21 "21" 22 "22" 23 "23" 24 "24" 25 "25" 26 "26" 27 "27" 28 "28" 29 "29" 30 "30" 31 "31" ;
VAL_ 1480 EPBL_a096_VEH_status 0 "DISABLED" 1 "ENABLED" 2 "TEMPORARY_FAILURE" 3 "SNA" ;
VAL_ 1480 EPBL_a101_VEH_state 0 "STANDBY" 1 "DRIVE" 2 "SUPPORT" 3 "CHARGE" 4 "FEIM" 5 "CLEAR_FAULT" 6 "FAULT" 7 "WELD" 8 "TEST" 9 "SNA" 10 "DIAG" ;
VAL_ 1480 EPBL_a109_PARTY_status 0 "DISABLED" 1 "ENABLED" 2 "TEMPORARY_FAILURE" 3 "SNA" ;
VAL_ 1480 EPBL_a114_PARTY_status 0 "DISABLED" 1 "ENABLED" 2 "TEMPORARY_FAILURE" 3 "SNA" ;
VAL_ 1480 EPBL_a185_summonFaultReason 0 "NONE" 1 "DI_MIA" 2 "DAS_MIA" 3 "ESP_MIA" 4 "EPBM_MIA" 5 "DI_FAULT" 6 "DI_APC_FAULT" 7 "DAS_FAULT" 8 "ESP_FAULT" 9 "VEH_CAN_FAULT" 10 "EAC_NOT_ALLOWED" 11 "EPBM_REQUEST" 12 "SPEED" 13 "EXTERNAL" 14 "PARK_MIA" 15 "PM_MIA" 16 "PM_REQUEST" 17 "OOC" 18 "MISMATCH" 19 "EPB_FAULT" 20 "DI_STATE_INVALID" 21 "PASSIVE_REQUEST" 22 "EPBREMOTE_MIA" 23 "REMOTE_SUMMON_FAULTED" 24 "LOCAL_UNIT_FAULTED" 25 "REMOTE_UNIT_FAULTED" 26 "START_IN_UNAVAILABLE" 27 "INVALID_REMOTE_STATE" 28 "REMOTE_DID_NOT_START" ;
VAL_ 1480 EPBL_a243_brakeMasterCylPress 1023 "SNA" ;
VAL_ 1480 EPBL_a250_esmSpeedClass 0 "STOPPED" 1 "SYSTEM_APPLY_OK" 2 "USER_APPLY_OK" 3 "FAST" 4 "UNKNOWN" ;
VAL_ 1480 EPBL_a301_setSpeed 4095 "SNA" ;
VAL_ 1480 EPBL_a362_brakeMasterCylPress 1023 "SNA" ;
VAL_ 1480 EPBL_a363_brakeMasterCylPress 1023 "SNA" ;
VAL_ 1480 EPBL_alertState 0 "CLEARED" 1 "SET" ;
VAL_ 1480 EPBL_alertID 0 "ALERT_DO_NOT_USE_ZERO" 1 "a001_DriverDoorOpen" 2 "a002_DoorOpen" 3 "a003_TrunkOpen" 4 "a004_FrunkOpen" 5 "a005_HeadlightsOnDoorOpen" 6 "a006_RemoteServiceAlert" 7 "a007_SoftPackConfigMismatch" 8 "a008_TouchScreenError" 9 "a009_SquashfsError" 10 "a010_MapsMissing" 11 "a011_IncorrectMap" 12 "a012_NotOnPrivateProperty" 13 "a013_TPMSHardWarning" 14 "a014_TPMSSoftWarning" 15 "a015_TPMSOverPressureWarning" 16 "a016_TPMSTemperatureWarning" 17 "a017_TPMSSystemFault" 18 "a018_SlipStartOn" 19 "a019_ParkBrakeFault" 20 "a020_SteeringReduced" 21 "a021_RearSeatbeltUnbuckled" 22 "a022_ApeFusesEtc" 23 "a023_CellInternetCheckFailed" 24 "a024_WifiInternetCheckFailed" 25 "a025_WifiOnlineCheckFailed" 26 "a026_ModemResetLoopDetected" 27 "a027_AutoSteerMIA" 28 "a028_FrontTrunkPopupClosed" 29 "a029_ModemMIA" 30 "a030_ModemVMCrash" 31 "a031_BrakeFluidLow" 32 "a032_CellModemRecoveryResets" 33 "a033_ApTrialExpired" 34 "a034_WakeupProblem" 35 "a035_AudioWatchdogKernelError" 36 "a036_AudioWatchdogHfpError" 37 "a037_AudioWatchdogXrunStormError" 38 "a038_AudioWatchdogA2bI2cLockupError" 39 "a039_AudioA2bNeedRediscovery" 40 "a040_HomelinkTransmit" 41 "a041_AudioDmesgXrun" 42 "a042_AudioDmesgRtThrottling" 43 "a043_InvalidMapDataOverride" 44 "a044_AudioDmesgDspException" 45 "a045_ECallNeedsService" 46 "a046_BackupCameraStreamError" 47 "a047_CellRoamingDisallowed" 48 "a048_AudioPremiumAmpCheckFailed" 49 "a049_BrakeShiftRequired" 50 "a050_BackupCameraIPUTimeout" 51 "a051_BackupCameraFrameTimeout" 52 "a052_KernelPanicReported" 53 "a053_QtCarExitError" 54 "a054_AudioBoostPowerBad" 55 "a055_ManualECallDisabled" 56 "a056_ManualECallButtonDisconnected" 57 "a057_CellAntennaDisconnected" 58 "a058_GPSAntennaDisconnected" 59 "a059_ECallSpeakerDisconnected" 60 "a060_ECallMicDisconnected" 61 "a061_SIMTestFailed" 62 "a062_ENSTestFailed" 63 "a063_CellularTestFailed" 64 "a064_ModemFirmwareTestFailed" 65 "a065_WiFiRecoveryReset" 66 "a066_GpuHangDetected" 67 "a067_WarnOnI915" 68 "a068_VideoUnexpectedExit" 69 "a069_VideoUDPTimeout" 70 "a070_VideoPipelineWarning" 71 "a071_VideoPipelineError" 72 "a072_ECallAnalogMicFailed" 73 "a073_ECallDigitalMicFailed" 74 "a074_EMMCHangDetected" 75 "a075_BackupCameraInitError" 76 "a076_NumFalseManualECalls" 77 "a077_AudioA2bMicChannelSwap" 78 "a078_DashcamUsbDriveUnmountable" 79 "a079_DashcamUsbDriveFull" 80 "a080_DashcamUsbDriveSlow" 81 "a081_CellModemSearchExpired" 82 "a082_NumModemRebootStuckInECall" 83 "a083_ECallProxyWatchdogTriggered" 84 "a084_SerializerError" 85 "a085_DeserializerError" 86 "a086_TouchEnumerationError" 87 "a087_BmpReset" 88 "a088_CellRemovableSimMissing" 89 "a089_RadioSoftResetError" 90 "a090_RadioPingFailError" 91 "a091_VehicleLinkStall" 92 "a092_updateStarted" 93 "a093_updateEnded" 94 "a094_ModemPowerOnFailure" 95 "a095_CidStorageRunningLow" 96 "a096_VideodPipelineIssueDetected" 97 "a097_AudiodRestarted" 98 "a098_DiskCheckFailure" 99 "a099_eMMCStatusError" 100 "a100_eMMCFTLError" 101 "a101_wifiStackProblem" 102 "a102_A2bDiscoveryFailed" 103 "a103_UsbHubNotEnumerating" 104 "a104_DashcamUsbDriveMissing" 105 "a105_firmwareReinstallRequested" 106 "a106_rebootBackstopTriggered" 107 "a107_DashcamUsbDriveTooBigForVfatFsck" 108 "a108_DashcamUsbDriveGettingFull" 109 "a109_DashcamUsbDriveTooSmall" 110 "a110_DashcamUsbDriveCorrupt" 111 "a111_DashcamUsbDriveWrongPort" 112 "a112_badUSBDevice" 113 "a113_DashcamHasOnboardSentryClips" ;
