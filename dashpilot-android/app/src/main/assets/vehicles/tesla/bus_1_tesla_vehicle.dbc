VERSION "2021.24.4"

NS_ :

BS_:

BU_: VEH CH Receiver X

BA_DEF_ BO_ "GenMsgSendType" ENUM "Cyclic";
BA_DEF_ BO_ "GenMsgCycleTime" INT 0 10000;

BO_ 1332 VCFRONT_alertLog: 8 Vector__XXX
 SG_ VCFRONT_a611_tempAmbientRaw m611 : 30|6@1+ (1,20) [0|0] "" Vector__XXX
 SG_ VCFRONT_a614_battInletSensor m614 : 30|1@1+ (1,0) [0|0] "" Vector__XXX
 SG_ VCFRONT_a047_Ovdvddd m47 : 29|1@1+ (1,0) [0|0] "" Vector__XXX
 SG_ VCFRONT_a098_VEH_motorStatus m98 : 29|1@1+ (1,0) [0|0] "" Vector__XXX
 SG_ VCFRONT_a104_CH_steeringControl m104 : 29|1@1+ (1,0) [0|0] "" Vector__XXX
 SG_ VCFRONT_a107_VEH_chargeInfo m107 : 29|1@1+ (1,0) [0|0] "" Vector__XXX
 SG_ VCFRONT_a108_CH_torque m108 : 29|1@1+ (1,0) [0|0] "" Vector__XXX
 SG_ VCFRONT_a109_CH_inertial1 m109 : 29|1@1+ (1,0) [0|0] "" Vector__XXX
 SG_ VCFRONT_a110_CH_carState m110 : 29|1@1+ (1,0) [0|0] "" Vector__XXX
 SG_ VCFRONT_a113_VEH_driverProfileRe m113 : 29|1@1+ (1,0) [0|0] "" Vector__XXX
 SG_ VCFRONT_a114_BDY_party3 m114 : 29|1@1+ (1,0) [0|0] "" Vector__XXX
 SG_ VCFRONT_a116_VEH_seatStatus2 m116 : 29|1@1+ (1,0) [0|0] "" Vector__XXX
 SG_ VCFRONT_a117_VEH_windowStatus m117 : 29|1@1+ (1,0) [0|0] "" Vector__XXX
 SG_ VCFRONT_a118_VEH_thermalCommand m118 : 29|1@1+ (1,0) [0|0] "" Vector__XXX
 SG_ VCFRONT_a120_VEH_aggregatedAxleS m120 : 29|1@1+ (1,0) [0|0] "" Vector__XXX
 SG_ VCFRONT_a142_isCoilShortXNVbb m142 : 29|1@1+ (1,0) [0|0] "" Vector__XXX
 SG_ VCFRONT_a153_brakePressed m153 : 29|1@1+ (1,0) [0|0] "" Vector__XXX
 SG_ VCFRONT_a161_selfTestFailCPU m161 : 29|1@1+ (1,0) [0|0] "" Vector__XXX
 SG_ VCFRONT_a162_lccExvFlow m162 : 29|7@1+ (1,0) [0|0] "" Vector__XXX
 SG_ VCFRONT_a171_PMS m171 : 29|1@1+ (1,0) [0|0] "" Vector__XXX
 SG_ VCFRONT_a178_notRunPsPdRange m178 : 29|1@1+ (1,0) [0|0] "" Vector__XXX
 SG_ VCFRONT_a180_pcsEFuseStable m180 : 29|1@1+ (1,0) [0|0] "" Vector__XXX
 SG_ VCFRONT_a182_packOverDischarged m182 : 29|1@1+ (1,0) [0|0] "" Vector__XXX
 SG_ VCFRONT_a183_packOverDischarged m183 : 29|1@1+ (1,0) [0|0] "" Vector__XXX
 SG_ VCFRONT_a192_HVBlockingMismatch m192 : 29|1@1+ (1,0) [0|0] "" Vector__XXX
 SG_ VCFRONT_a195_frunkOpen m195 : 29|1@1+ (1,0) [0|0] "" Vector__XXX
 SG_ VCFRONT_a275_bmbCommStatusTypeB m275 : 29|2@1+ (1,0) [0|0] "" Vector__XXX
 SG_ VCFRONT_a276_bmbCommStatusTypeB m276 : 29|2@1+ (1,0) [0|0] "" Vector__XXX
 SG_ VCFRONT_a284_isCoilShortXNVbb m284 : 29|1@1+ (1,0) [0|0] "" Vector__XXX
 SG_ VCFRONT_a285_isCoilShortXNVbb m285 : 29|1@1+ (1,0) [0|0] "" Vector__XXX
 SG_ VCFRONT_a286_isCoilShortXNVbb m286 : 29|1@1+ (1,0) [0|0] "" Vector__XXX
 SG_ VCFRONT_a287_isCoilShortXNVbb m287 : 29|1@1+ (1,0) [0|0] "" Vector__XXX
 SG_ VCFRONT_a288_isCoilShortXNVbb m288 : 29|1@1+ (1,0) [0|0] "" Vector__XXX
 SG_ VCFRONT_a289_isCoilShortXNVbb m289 : 29|1@1+ (1,0) [0|0] "" Vector__XXX
 SG_ VCFRONT_a365_chargeCableUnplugge m365 : 29|1@1+ (1,0) [0|0] "" Vector__XXX
 SG_ VCFRONT_a366_DIReportsCompleted m366 : 29|1@1+ (1,0) [0|0] "" Vector__XXX
 SG_ VCFRONT_a390_coolantMode m390 : 29|2@1+ (1,0) [0|0] "" Vector__XXX
 SG_ VCFRONT_a394_runTimeOffSetDetect m394 : 29|1@1+ (1,0) [0|0] "" Vector__XXX
 SG_ VCFRONT_a397_runTimeOffSetDetect m397 : 29|1@1+ (1,0) [0|0] "" Vector__XXX
 SG_ VCFRONT_a402_electricalDisconnec m402 : 29|1@1+ (1,0) [0|0] "" Vector__XXX
 SG_ VCFRONT_a415_IBSCurrent m415 : 29|9@1- (0.5,0) [0|0] "" Vector__XXX
 SG_ VCFRONT_a420_partyStaticSongSele m420 : 29|3@1+ (1,0) [0|0] "" Vector__XXX
 SG_ VCFRONT_a446_compStandbyShowroom m446 : 29|1@1+ (1,0) [0|0] "" Vector__XXX
 SG_ VCFRONT_a447_refrigeDischargeTem m447 : 29|1@1+ (1,0) [0|0] "" Vector__XXX
 SG_ VCFRONT_a462_CPA_State m462 : 29|1@1+ (1,0) [0|0] "" Vector__XXX
 SG_ VCFRONT_a476_serviceMode m476 : 29|1@1+ (1,0) [0|0] "" Vector__XXX
 SG_ VCFRONT_a480_vdsMax m480 : 29|1@1+ (1,0) [0|0] "" Vector__XXX
 SG_ VCFRONT_a525_frunkOpen m525 : 29|1@1+ (1,0) [0|0] "" Vector__XXX
 SG_ VCFRONT_a548_hvState m548 : 29|3@1+ (1,0) [0|0] "" Vector__XXX
 SG_ VCFRONT_a565_brakePressed m565 : 29|1@1+ (1,0) [0|0] "" Vector__XXX
 SG_ VCFRONT_a599_frunkOpen m599 : 29|1@1+ (1,0) [0|0] "" Vector__XXX
 SG_ VCFRONT_a614_battInletCoolantToo m614 : 29|1@1+ (1,0) [0|0] "" Vector__XXX
 SG_ VCFRONT_a663_hcmlValidatedGroups m663 : 29|5@1+ (3.225806451612903,0) [0|0] "" Vector__XXX
 SG_ VCFRONT_a664_hcmrValidatedGroups m664 : 29|5@1+ (3.225806451612903,0) [0|0] "" Vector__XXX
 SG_ VCFRONT_a047_Bodvccd m47 : 28|1@1+ (1,0) [0|0] "" Vector__XXX
 SG_ VCFRONT_a058_current m58 : 28|11@1+ (0.1,0) [0|0] "" Vector__XXX
 SG_ VCFRONT_a059_resistanceEstimate m59 : 28|12@1+ (0.00244,0) [0|0] "" Vector__XXX
 SG_ VCFRONT_a098_PARTY_motorStatus m98 : 28|1@1+ (1,0) [0|0] "" Vector__XXX
 SG_ VCFRONT_a104_PARTY_steeringContr m104 : 28|1@1+ (1,0) [0|0] "" Vector__XXX
 SG_ VCFRONT_a107_VEH_energyStatus m107 : 28|1@1+ (1,0) [0|0] "" Vector__XXX
 SG_ VCFRONT_a108_VEH_motorStatus m108 : 28|1@1+ (1,0) [0|0] "" Vector__XXX
 SG_ VCFRONT_a109_VEH_inertial2 m109 : 28|1@1+ (1,0) [0|0] "" Vector__XXX
 SG_ VCFRONT_a110_CH_carConfig m110 : 28|1@1+ (1,0) [0|0] "" Vector__XXX
 SG_ VCFRONT_a113_VEH_vehicleModes m113 : 28|1@1+ (1,0) [0|0] "" Vector__XXX
 SG_ VCFRONT_a114_BDY_offsets m114 : 28|1@1+ (1,0) [0|0] "" Vector__XXX
 SG_ VCFRONT_a116_VEH_logging1Hz m116 : 28|1@1+ (1,0) [0|0] "" Vector__XXX
 SG_ VCFRONT_a117_VEH_doorStatus2 m117 : 28|1@1+ (1,0) [0|0] "" Vector__XXX
 SG_ VCFRONT_a118_PARTY_vehicleTime m118 : 28|1@1+ (1,0) [0|0] "" Vector__XXX
 SG_ VCFRONT_a120_PARTY_vehicleEstima m120 : 28|1@1+ (1,0) [0|0] "" Vector__XXX
 SG_ VCFRONT_a142_isCoilShortXNGnd m142 : 28|1@1+ (1,0) [0|0] "" Vector__XXX
 SG_ VCFRONT_a153_driverPresent m153 : 28|1@1+ (1,0) [0|0] "" Vector__XXX
 SG_ VCFRONT_a160_highDischargeTempCu m160 : 28|1@1+ (1,0) [0|0] "" Vector__XXX
 SG_ VCFRONT_a161_currentSnsError m161 : 28|1@1+ (1,0) [0|0] "" Vector__XXX
 SG_ VCFRONT_a171_PM m171 : 28|1@1+ (1,0) [0|0] "" Vector__XXX
 SG_ VCFRONT_a178_isWinterPumpOut m178 : 28|1@1+ (1,0) [0|0] "" Vector__XXX
 SG_ VCFRONT_a180_notEnoughPowerForSu m180 : 28|1@1+ (1,0) [0|0] "" Vector__XXX
 SG_ VCFRONT_a182_frunkOpen m182 : 28|1@1+ (1,0) [0|0] "" Vector__XXX
 SG_ VCFRONT_a183_frunkOpen m183 : 28|1@1+ (1,0) [0|0] "" Vector__XXX
 SG_ VCFRONT_a190_timeouts m190 : 28|16@1+ (1,0) [0|0] "" Vector__XXX
 SG_ VCFRONT_a192_PCS_MIA m192 : 28|1@1+ (1,0) [0|0] "" Vector__XXX
 SG_ VCFRONT_a195_serviceMode m195 : 28|1@1+ (1,0) [0|0] "" Vector__XXX
 SG_ VCFRONT_a196_disconnectedBattery m196 : 28|12@1+ (0.004884004884004884,-10) [0|0] "" Vector__XXX
 SG_ VCFRONT_a248_IBSVoltage m248 : 28|12@1+ (0.005443676098,0) [0|0] "" Vector__XXX
 SG_ VCFRONT_a258_IBSTemp m258 : 28|16@1- (0.01,0) [0|0] "" Vector__XXX
 SG_ VCFRONT_a260_IBSAh m260 : 28|12@1- (0.1,0) [0|0] "" Vector__XXX
 SG_ VCFRONT_a284_isCoilShortXNGnd m284 : 28|1@1+ (1,0) [0|0] "" Vector__XXX
 SG_ VCFRONT_a285_isCoilShortXNGnd m285 : 28|1@1+ (1,0) [0|0] "" Vector__XXX
 SG_ VCFRONT_a286_isCoilShortXNGnd m286 : 28|1@1+ (1,0) [0|0] "" Vector__XXX
 SG_ VCFRONT_a287_isCoilShortXNGnd m287 : 28|1@1+ (1,0) [0|0] "" Vector__XXX
 SG_ VCFRONT_a288_isCoilShortXNGnd m288 : 28|1@1+ (1,0) [0|0] "" Vector__XXX
 SG_ VCFRONT_a289_isCoilShortXNGnd m289 : 28|1@1+ (1,0) [0|0] "" Vector__XXX
 SG_ VCFRONT_a334_avgCurrent m334 : 28|12@1+ (0.1,0) [0|0] "" Vector__XXX
 SG_ VCFRONT_a335_avgCurrent m335 : 28|12@1+ (0.1,0) [0|0] "" Vector__XXX
 SG_ VCFRONT_a336_avgCurrent m336 : 28|12@1+ (0.1,0) [0|0] "" Vector__XXX
 SG_ VCFRONT_a337_avgCurrent m337 : 28|12@1+ (0.1,0) [0|0] "" Vector__XXX
 SG_ VCFRONT_a338_avgCurrent m338 : 28|12@1+ (0.1,0) [0|0] "" Vector__XXX
 SG_ VCFRONT_a339_avgCurrent m339 : 28|12@1+ (0.1,0) [0|0] "" Vector__XXX
 SG_ VCFRONT_a340_avgCurrent m340 : 28|12@1+ (0.1,0) [0|0] "" Vector__XXX
 SG_ VCFRONT_a341_avgCurrent m341 : 28|12@1+ (0.1,0) [0|0] "" Vector__XXX
 SG_ VCFRONT_a342_avgCurrent m342 : 28|12@1+ (0.1,0) [0|0] "" Vector__XXX
 SG_ VCFRONT_a343_avgCurrent m343 : 28|12@1+ (0.1,0) [0|0] "" Vector__XXX
 SG_ VCFRONT_a344_avgCurrent m344 : 28|12@1+ (0.1,0) [0|0] "" Vector__XXX
 SG_ VCFRONT_a345_avgCurrent m345 : 28|12@1+ (0.1,0) [0|0] "" Vector__XXX
 SG_ VCFRONT_a346_avgCurrent m346 : 28|12@1+ (0.1,0) [0|0] "" Vector__XXX
 SG_ VCFRONT_a347_avgCurrent m347 : 28|12@1+ (0.1,0) [0|0] "" Vector__XXX
 SG_ VCFRONT_a348_avgCurrent m348 : 28|12@1+ (0.1,0) [0|0] "" Vector__XXX
 SG_ VCFRONT_a349_avgCurrent m349 : 28|12@1+ (0.1,0) [0|0] "" Vector__XXX
 SG_ VCFRONT_a359_IBSAh m359 : 28|12@1- (0.1,0) [0|0] "" Vector__XXX
 SG_ VCFRONT_a365_coolantConditioning m365 : 28|1@1+ (1,0) [0|0] "" Vector__XXX
 SG_ VCFRONT_a366_chargeCableUnplugge m366 : 28|1@1+ (1,0) [0|0] "" Vector__XXX
 SG_ VCFRONT_a370_IBSAh m370 : 28|12@1- (0.1,0) [0|0] "" Vector__XXX
 SG_ VCFRONT_a379_IBSTemp m379 : 28|10@1+ (0.1,-10) [0|0] "" Vector__XXX
 SG_ VCFRONT_a402_failureToPrechargeR m402 : 28|1@1+ (1,0) [0|0] "" Vector__XXX
 SG_ VCFRONT_a407_avgIntervalCurrent m407 : 28|5@1+ (1,-31) [0|0] "" Vector__XXX
 SG_ VCFRONT_a446_compStandbyMultiple m446 : 28|1@1+ (1,0) [0|0] "" Vector__XXX
 SG_ VCFRONT_a447_refrigDischargePres m447 : 28|1@1+ (1,0) [0|0] "" Vector__XXX
 SG_ VCFRONT_a462_MOSFETOTLevel1 m462 : 28|1@1+ (1,0) [0|0] "" Vector__XXX
 SG_ VCFRONT_a474_ssl100Bank7Status m474 : 28|2@1+ (1,0) [0|0] "" Vector__XXX
 SG_ VCFRONT_a475_ssl100Bank7Status m475 : 28|2@1+ (1,0) [0|0] "" Vector__XXX
 SG_ VCFRONT_a476_factoryMode m476 : 28|1@1+ (1,0) [0|0] "" Vector__XXX
 SG_ VCFRONT_a478_bmsState m478 : 28|4@1+ (1,0) [0|0] "" Vector__XXX
 SG_ VCFRONT_a479_vehiclePowerState m479 : 28|2@1+ (1,0) [0|0] "" Vector__XXX
 SG_ VCFRONT_a480_hardShort m480 : 28|1@1+ (1,0) [0|0] "" Vector__XXX
 SG_ VCFRONT_a482_calibrationCycles m482 : 28|2@1+ (1,0) [0|0] "" Vector__XXX
 SG_ VCFRONT_a485_calibrationCycles m485 : 28|2@1+ (1,0) [0|0] "" Vector__XXX
 SG_ VCFRONT_a525_factoryGated m525 : 28|1@1+ (1,0) [0|0] "" Vector__XXX
 SG_ VCFRONT_a565_driverPresent m565 : 28|1@1+ (1,0) [0|0] "" Vector__XXX
 SG_ VCFRONT_a587_LVBMS_packCurrent m587 : 28|12@1+ (0.2,-600) [0|0] "" Vector__XXX
 SG_ VCFRONT_a595_LVBMS_packVoltage m595 : 28|10@1+ (0.1,-1) [0|0] "" Vector__XXX
 SG_ VCFRONT_a599_factoryGated m599 : 28|1@1+ (1,0) [0|0] "" Vector__XXX
 SG_ VCFRONT_a600_LVBMS_packCurrent m600 : 28|12@1+ (0.2,-600) [0|0] "" Vector__XXX
 SG_ VCFRONT_a614_ptPumpDryRun m614 : 28|1@1+ (1,0) [0|0] "" Vector__XXX
 SG_ VCFRONT_a626_avgIntervalCurrent m626 : 28|5@1+ (1,-31) [0|0] "" Vector__XXX
 SG_ VCFRONT_a697_calibratedHorizonta m697 : 28|10@1+ (1,0) [0|0] "" Vector__XXX
 SG_ VCFRONT_a698_calibratedHorizonta m698 : 28|10@1+ (1,0) [0|0] "" Vector__XXX
 SG_ VCFRONT_a009_PdMax m9 : 27|5@1+ (1,0) [0|0] "" Vector__XXX
 SG_ VCFRONT_a021_Task1000msMissed m21 : 27|1@1+ (1,0) [0|0] "" Vector__XXX
 SG_ VCFRONT_a047_Bodvdda m47 : 27|1@1+ (1,0) [0|0] "" Vector__XXX
 SG_ VCFRONT_a098_PT_temperature m98 : 27|1@1+ (1,0) [0|0] "" Vector__XXX
 SG_ VCFRONT_a104_PARTY_status m104 : 27|1@1+ (1,0) [0|0] "" Vector__XXX
 SG_ VCFRONT_a107_VEH_packConfig m107 : 27|1@1+ (1,0) [0|0] "" Vector__XXX
 SG_ VCFRONT_a108_PARTY_motorStatus m108 : 27|1@1+ (1,0) [0|0] "" Vector__XXX
 SG_ VCFRONT_a109_VEH_inertial1 m109 : 27|1@1+ (1,0) [0|0] "" Vector__XXX
 SG_ VCFRONT_a110_CH_airbagCutoffStat m110 : 27|1@1+ (1,0) [0|0] "" Vector__XXX
 SG_ VCFRONT_a111_CH_status m111 : 27|1@1+ (1,0) [0|0] "" Vector__XXX
 SG_ VCFRONT_a113_VEH_powertrainContr m113 : 27|1@1+ (1,0) [0|0] "" Vector__XXX
 SG_ VCFRONT_a114_PARTY_offsets m114 : 27|1@1+ (1,0) [0|0] "" Vector__XXX
 SG_ VCFRONT_a116_VEH_switchStatus m116 : 27|1@1+ (1,0) [0|0] "" Vector__XXX
 SG_ VCFRONT_a117_VEH_doorStatus m117 : 27|1@1+ (1,0) [0|0] "" Vector__XXX
 SG_ VCFRONT_a118_PARTY_outputPowerSt m118 : 27|1@1+ (1,0) [0|0] "" Vector__XXX
 SG_ VCFRONT_a120_PT_systemStatus m120 : 27|1@1+ (1,0) [0|0] "" Vector__XXX
 SG_ VCFRONT_a142_isCoilShortXPVbb m142 : 27|1@1+ (1,0) [0|0] "" Vector__XXX
 SG_ VCFRONT_a153_anyClosureIsOpen m153 : 27|1@1+ (1,0) [0|0] "" Vector__XXX
 SG_ VCFRONT_a154_lastSilentWakeIBSCu m154 : 27|10@1+ (0.001953125,-1.59375) [0|0] "" Vector__XXX
 SG_ VCFRONT_a159_angleTarget m159 : 27|10@1+ (0.25,-10) [0|0] "" Vector__XXX
 SG_ VCFRONT_a160_highDischargePressu m160 : 27|1@1+ (1,0) [0|0] "" Vector__XXX
 SG_ VCFRONT_a161_tempSnsFaultCPU m161 : 27|1@1+ (1,0) [0|0] "" Vector__XXX
 SG_ VCFRONT_a171_DIS m171 : 27|1@1+ (1,0) [0|0] "" Vector__XXX
 SG_ VCFRONT_a178_isSummerPumpOut m178 : 27|1@1+ (1,0) [0|0] "" Vector__XXX
 SG_ VCFRONT_a182_transportMode m182 : 27|1@1+ (1,0) [0|0] "" Vector__XXX
 SG_ VCFRONT_a183_transportMode m183 : 27|1@1+ (1,0) [0|0] "" Vector__XXX
 SG_ VCFRONT_a192_BMS_MIA m192 : 27|1@1+ (1,0) [0|0] "" Vector__XXX
 SG_ VCFRONT_a216_vcrightDynamicImmin m216 : 27|1@1+ (1,0) [0|0] "" Vector__XXX
 SG_ VCFRONT_a284_isCoilShortXPVbb m284 : 27|1@1+ (1,0) [0|0] "" Vector__XXX
 SG_ VCFRONT_a285_isCoilShortXPVbb m285 : 27|1@1+ (1,0) [0|0] "" Vector__XXX
 SG_ VCFRONT_a286_isCoilShortXPVbb m286 : 27|1@1+ (1,0) [0|0] "" Vector__XXX
 SG_ VCFRONT_a287_isCoilShortXPVbb m287 : 27|1@1+ (1,0) [0|0] "" Vector__XXX
 SG_ VCFRONT_a288_isCoilShortXPVbb m288 : 27|1@1+ (1,0) [0|0] "" Vector__XXX
 SG_ VCFRONT_a289_isCoilShortXPVbb m289 : 27|1@1+ (1,0) [0|0] "" Vector__XXX
 SG_ VCFRONT_a310_maxTemp m310 : 27|11@1+ (0.125,-40) [0|0] "" Vector__XXX
 SG_ VCFRONT_a311_maxTemp m311 : 27|11@1+ (0.125,-40) [0|0] "" Vector__XXX
 SG_ VCFRONT_a312_maxTemp m312 : 27|11@1+ (0.125,-40) [0|0] "" Vector__XXX
 SG_ VCFRONT_a313_maxTemp m313 : 27|11@1+ (0.125,-40) [0|0] "" Vector__XXX
 SG_ VCFRONT_a314_maxTemp m314 : 27|11@1+ (0.125,-40) [0|0] "" Vector__XXX
 SG_ VCFRONT_a315_maxTemp m315 : 27|11@1+ (0.125,-40) [0|0] "" Vector__XXX
 SG_ VCFRONT_a316_maxTemp m316 : 27|11@1+ (0.125,-40) [0|0] "" Vector__XXX
 SG_ VCFRONT_a317_maxTemp m317 : 27|11@1+ (0.125,-40) [0|0] "" Vector__XXX
 SG_ VCFRONT_a318_maxTemp m318 : 27|11@1+ (0.125,-40) [0|0] "" Vector__XXX
 SG_ VCFRONT_a319_maxTemp m319 : 27|11@1+ (0.125,-40) [0|0] "" Vector__XXX
 SG_ VCFRONT_a320_maxTemp m320 : 27|11@1+ (0.125,-40) [0|0] "" Vector__XXX
 SG_ VCFRONT_a321_maxTemp m321 : 27|11@1+ (0.125,-40) [0|0] "" Vector__XXX
 SG_ VCFRONT_a322_maxTemp m322 : 27|11@1+ (0.125,-40) [0|0] "" Vector__XXX
 SG_ VCFRONT_a323_maxTemp m323 : 27|11@1+ (0.125,-40) [0|0] "" Vector__XXX
 SG_ VCFRONT_a324_maxTemp m324 : 27|11@1+ (0.125,-40) [0|0] "" Vector__XXX
 SG_ VCFRONT_a325_maxTemp m325 : 27|11@1+ (0.125,-40) [0|0] "" Vector__XXX
 SG_ VCFRONT_a365_hvacConditioning m365 : 27|1@1+ (1,0) [0|0] "" Vector__XXX
 SG_ VCFRONT_a366_coolantConditioning m366 : 27|1@1+ (1,0) [0|0] "" Vector__XXX
 SG_ VCFRONT_a390_blendType m390 : 27|2@1+ (1,0) [0|0] "" Vector__XXX
 SG_ VCFRONT_a446_compStandbyCoastDow m446 : 27|1@1+ (1,0) [0|0] "" Vector__XXX
 SG_ VCFRONT_a447_powertrainThermalFa m447 : 27|1@1+ (1,0) [0|0] "" Vector__XXX
 SG_ VCFRONT_a461_socByAhSaturated m461 : 27|10@1+ (0.1,0) [0|0] "" Vector__XXX
 SG_ VCFRONT_a462_ChrgOCLevel2 m462 : 27|1@1+ (1,0) [0|0] "" Vector__XXX
 SG_ VCFRONT_a476_FRM12_timedOut m476 : 27|1@1+ (1,0) [0|0] "" Vector__XXX
 SG_ VCFRONT_a480_vsUndervoltage m480 : 27|1@1+ (1,0) [0|0] "" Vector__XXX
 SG_ VCFRONT_a507_headlampFailedToFin m507 : 27|1@1+ (1,0) [0|0] "" Vector__XXX
 SG_ VCFRONT_a524_headlampFailedToFin m524 : 27|1@1+ (1,0) [0|0] "" Vector__XXX
 SG_ VCFRONT_a525_serviceMode m525 : 27|1@1+ (1,0) [0|0] "" Vector__XXX
 SG_ VCFRONT_a565_anyClosureIsOpen m565 : 27|1@1+ (1,0) [0|0] "" Vector__XXX
 SG_ VCFRONT_a583_switch2State m583 : 27|3@1+ (1,0) [0|0] "" Vector__XXX
 SG_ VCFRONT_a599_serviceMode m599 : 27|1@1+ (1,0) [0|0] "" Vector__XXX
 SG_ VCFRONT_a614_battPumpDryRun m614 : 27|1@1+ (1,0) [0|0] "" Vector__XXX
 SG_ VCFRONT_a661_headlampOvercurrent m661 : 27|1@1+ (1,0) [0|0] "" Vector__XXX
 SG_ VCFRONT_a662_headlampOvercurrent m662 : 27|1@1+ (1,0) [0|0] "" Vector__XXX
 SG_ VCFRONT_a009_abortedRetryLimited m9 : 26|1@1+ (1,0) [0|0] "" Vector__XXX
 SG_ VCFRONT_a021_Task1000msStarved m21 : 26|1@1+ (1,0) [0|0] "" Vector__XXX
 SG_ VCFRONT_a047_Bodvddd m47 : 26|1@1+ (1,0) [0|0] "" Vector__XXX
 SG_ VCFRONT_a098_PT_thermalControl m98 : 26|1@1+ (1,0) [0|0] "" Vector__XXX
 SG_ VCFRONT_a104_CH_status m104 : 26|1@1+ (1,0) [0|0] "" Vector__XXX
 SG_ VCFRONT_a107_VEH_socStatus m107 : 26|1@1+ (1,0) [0|0] "" Vector__XXX
 SG_ VCFRONT_a108_PT_thermalControl m108 : 26|1@1+ (1,0) [0|0] "" Vector__XXX
 SG_ VCFRONT_a109_BDY_status m109 : 26|1@1+ (1,0) [0|0] "" Vector__XXX
 SG_ VCFRONT_a110_VEH_canLogAvailabil m110 : 26|1@1+ (1,0) [0|0] "" Vector__XXX
 SG_ VCFRONT_a111_PARTY_status m111 : 26|1@1+ (1,0) [0|0] "" Vector__XXX
 SG_ VCFRONT_a112_CH_status m112 : 26|1@1+ (1,0) [0|0] "" Vector__XXX
 SG_ VCFRONT_a113_VEH_trackModeSettin m113 : 26|1@1+ (1,0) [0|0] "" Vector__XXX
 SG_ VCFRONT_a114_PARTY_brakeTorque m114 : 26|1@1+ (1,0) [0|0] "" Vector__XXX
 SG_ VCFRONT_a116_VEH_restraintStatus m116 : 26|1@1+ (1,0) [0|0] "" Vector__XXX
 SG_ VCFRONT_a117_BDY_falconSwitchSta m117 : 26|1@1+ (1,0) [0|0] "" Vector__XXX
 SG_ VCFRONT_a118_PARTY_LVPowerState m118 : 26|1@1+ (1,0) [0|0] "" Vector__XXX
 SG_ VCFRONT_a120_PT_speed m120 : 26|1@1+ (1,0) [0|0] "" Vector__XXX
 SG_ VCFRONT_a142_isCoilShortXPGnd m142 : 26|1@1+ (1,0) [0|0] "" Vector__XXX
 SG_ VCFRONT_a146_RPMTarget m146 : 26|10@1+ (10,0) [0|0] "" Vector__XXX
 SG_ VCFRONT_a147_RPMTarget m147 : 26|10@1+ (10,0) [0|0] "" Vector__XXX
 SG_ VCFRONT_a148_RPMTarget m148 : 26|10@1+ (10,0) [0|0] "" Vector__XXX
 SG_ VCFRONT_a150_RPMTarget m150 : 26|10@1+ (10,0) [0|0] "" Vector__XXX
 SG_ VCFRONT_a151_RPMTarget m151 : 26|10@1+ (10,0) [0|0] "" Vector__XXX
 SG_ VCFRONT_a152_RPMTarget m152 : 26|10@1+ (10,0) [0|0] "" Vector__XXX
 SG_ VCFRONT_a153_inTransportMode m153 : 26|1@1+ (1,0) [0|0] "" Vector__XXX
 SG_ VCFRONT_a160_faultValveEvapSol m160 : 26|1@1+ (1,0) [0|0] "" Vector__XXX
 SG_ VCFRONT_a161_tempSnsFaultIPM2 m161 : 26|1@1+ (1,0) [0|0] "" Vector__XXX
 SG_ VCFRONT_a171_DI m171 : 26|1@1+ (1,0) [0|0] "" Vector__XXX
 SG_ VCFRONT_a178_notRunAmbientOutOfB m178 : 26|1@1+ (1,0) [0|0] "" Vector__XXX
 SG_ VCFRONT_a182_serviceMode m182 : 26|1@1+ (1,0) [0|0] "" Vector__XXX
 SG_ VCFRONT_a183_serviceMode m183 : 26|1@1+ (1,0) [0|0] "" Vector__XXX
 SG_ VCFRONT_a192_replaceLVBattery m192 : 26|1@1+ (1,0) [0|0] "" Vector__XXX
 SG_ VCFRONT_a216_vcrightStaticImmine m216 : 26|1@1+ (1,0) [0|0] "" Vector__XXX
 SG_ VCFRONT_a228_RPMTarget m228 : 26|10@1+ (10,0) [0|0] "" Vector__XXX
 SG_ VCFRONT_a229_RPMTarget m229 : 26|10@1+ (10,0) [0|0] "" Vector__XXX
 SG_ VCFRONT_a230_RPMTarget m230 : 26|10@1+ (10,0) [0|0] "" Vector__XXX
 SG_ VCFRONT_a249_tempCoolantPTInlet m249 : 26|11@1+ (0.125,-40) [0|0] "" Vector__XXX
 SG_ VCFRONT_a254_RPMTarget m254 : 26|10@1+ (10,0) [0|0] "" Vector__XXX
 SG_ VCFRONT_a255_RPMTarget m255 : 26|10@1+ (10,0) [0|0] "" Vector__XXX
 SG_ VCFRONT_a284_isCoilShortXPGnd m284 : 26|1@1+ (1,0) [0|0] "" Vector__XXX
 SG_ VCFRONT_a285_isCoilShortXPGnd m285 : 26|1@1+ (1,0) [0|0] "" Vector__XXX
 SG_ VCFRONT_a286_isCoilShortXPGnd m286 : 26|1@1+ (1,0) [0|0] "" Vector__XXX
 SG_ VCFRONT_a287_isCoilShortXPGnd m287 : 26|1@1+ (1,0) [0|0] "" Vector__XXX
 SG_ VCFRONT_a288_isCoilShortXPGnd m288 : 26|1@1+ (1,0) [0|0] "" Vector__XXX
 SG_ VCFRONT_a289_isCoilShortXPGnd m289 : 26|1@1+ (1,0) [0|0] "" Vector__XXX
 SG_ VCFRONT_a352_maxCurrent m352 : 26|8@1+ (0.1,0) [0|0] "" Vector__XXX
 SG_ VCFRONT_a365_sentryModeActive m365 : 26|1@1+ (1,0) [0|0] "" Vector__XXX
 SG_ VCFRONT_a366_hvacConditioning m366 : 26|1@1+ (1,0) [0|0] "" Vector__XXX
 SG_ VCFRONT_a373_tempSuperheatTarget m373 : 26|10@1+ (0.1,0) [0|0] "" Vector__XXX
 SG_ VCFRONT_a416_brickVoltageMax m416 : 26|10@1+ (0.005,0) [0|0] "" Vector__XXX
 SG_ VCFRONT_a417_brickVoltageMax m417 : 26|10@1+ (0.005,0) [0|0] "" Vector__XXX
 SG_ VCFRONT_a418_brickVoltageMax m418 : 26|10@1+ (0.005,0) [0|0] "" Vector__XXX
 SG_ VCFRONT_a419_brickVoltageMax m419 : 26|10@1+ (0.005,0) [0|0] "" Vector__XXX
 SG_ VCFRONT_a420_partyStopReason m420 : 26|3@1+ (1,0) [0|0] "" Vector__XXX
 SG_ VCFRONT_a423_brickVoltageMax m423 : 26|10@1+ (0.005,0) [0|0] "" Vector__XXX
 SG_ VCFRONT_a424_brickVoltageMax m424 : 26|10@1+ (0.005,0) [0|0] "" Vector__XXX
 SG_ VCFRONT_a446_compStandbyRefrigNo m446 : 26|1@1+ (1,0) [0|0] "" Vector__XXX
 SG_ VCFRONT_a447_refrigerantSystemCo m447 : 26|1@1+ (1,0) [0|0] "" Vector__XXX
 SG_ VCFRONT_a462_ChrgOCLevel1 m462 : 26|1@1+ (1,0) [0|0] "" Vector__XXX
 SG_ VCFRONT_a472_worstCaseRequiredRa m472 : 26|10@1+ (1,0) [0|0] "" Vector__XXX
 SG_ VCFRONT_a473_worstCaseRequiredRa m473 : 26|10@1+ (1,0) [0|0] "" Vector__XXX
 SG_ VCFRONT_a474_ssl100Bank6Status m474 : 26|2@1+ (1,0) [0|0] "" Vector__XXX
 SG_ VCFRONT_a475_ssl100Bank6Status m475 : 26|2@1+ (1,0) [0|0] "" Vector__XXX
 SG_ VCFRONT_a476_FRM11_timedOut m476 : 26|1@1+ (1,0) [0|0] "" Vector__XXX
 SG_ VCFRONT_a480_disableOutputFault m480 : 26|1@1+ (1,0) [0|0] "" Vector__XXX
 SG_ VCFRONT_a481_VDSDiff m481 : 26|8@1+ (1,0) [0|0] "" Vector__XXX
 SG_ VCFRONT_a487_previouslyReportedP m487 : 26|10@1+ (1,0) [0|0] "" Vector__XXX
 SG_ VCFRONT_a491_previouslyReportedP m491 : 26|10@1+ (1,0) [0|0] "" Vector__XXX
 SG_ VCFRONT_a495_externalPowerSupply m495 : 26|1@1+ (1,0) [0|0] "" Vector__XXX
 SG_ VCFRONT_a503_brickVoltageMax m503 : 26|10@1+ (0.005,0) [0|0] "" Vector__XXX
 SG_ VCFRONT_a527_cell2Voltage m527 : 26|10@1+ (0.01,0) [0|0] "" Vector__XXX
 SG_ VCFRONT_a555_cell2Voltage m555 : 26|10@1+ (0.01,0) [0|0] "" Vector__XXX
 SG_ VCFRONT_a558_aimedHorizontalPosi m558 : 26|10@1+ (1,0) [0|0] "" Vector__XXX
 SG_ VCFRONT_a561_ambientTemperature m561 : 26|6@1+ (4,0) [0|0] "" Vector__XXX
 SG_ VCFRONT_a562_ambientTemperature m562 : 26|6@1+ (4,0) [0|0] "" Vector__XXX
 SG_ VCFRONT_a564_aimedHorizontalPosi m564 : 26|10@1+ (1,0) [0|0] "" Vector__XXX
 SG_ VCFRONT_a565_inTransportMode m565 : 26|1@1+ (1,0) [0|0] "" Vector__XXX
 SG_ VCFRONT_a605_sleepBypassVoltage m605 : 26|10@1+ (0.1,0) [0|0] "" Vector__XXX
 SG_ VCFRONT_a614_radFanFault m614 : 26|1@1+ (1,0) [0|0] "" Vector__XXX
 SG_ VCFRONT_a634_ajar2OpeningDeltaV m634 : 26|10@1- (0.01,0) [0|0] "" Vector__XXX
 SG_ VCFRONT_a644_pumpPrimeDuration m644 : 26|10@1+ (9.775171065493646,0) [0|0] "" Vector__XXX
 SG_ VCFRONT_a661_headlampUndercurren m661 : 26|1@1+ (1,0) [0|0] "" Vector__XXX
 SG_ VCFRONT_a662_headlampUndercurren m662 : 26|1@1+ (1,0) [0|0] "" Vector__XXX
 SG_ VCFRONT_a669_hpMode m669 : 26|5@1+ (1,0) [0|0] "" Vector__XXX
 SG_ VCFRONT_a670_mosfetFeedbackVolta m670 : 26|10@1+ (0.05,0) [0|0] "" Vector__XXX
 SG_ VCFRONT_a009_abortedFaultTimeout m9 : 25|1@1+ (1,0) [0|0] "" Vector__XXX
 SG_ VCFRONT_a021_Task1000msLate m21 : 25|1@1+ (1,0) [0|0] "" Vector__XXX
 SG_ VCFRONT_a038_busMaster m38 : 25|4@1+ (1,0) [0|0] "" Vector__XXX
 SG_ VCFRONT_a047_Xres m47 : 25|1@1+ (1,0) [0|0] "" Vector__XXX
 SG_ VCFRONT_a089_VEH_party3 m89 : 25|1@1+ (1,0) [0|0] "" Vector__XXX
 SG_ VCFRONT_a098_PARTY_torque m98 : 25|1@1+ (1,0) [0|0] "" Vector__XXX
 SG_ VCFRONT_a104_PARTY_gpsAccuracies m104 : 25|1@1+ (1,0) [0|0] "" Vector__XXX
 SG_ VCFRONT_a107_PT_socStatus m107 : 25|1@1+ (1,0) [0|0] "" Vector__XXX
 SG_ VCFRONT_a108_PT_temperature m108 : 25|1@1+ (1,0) [0|0] "" Vector__XXX
 SG_ VCFRONT_a109_BDY_inertial2 m109 : 25|1@1+ (1,0) [0|0] "" Vector__XXX
 SG_ VCFRONT_a110_VEH_gearControl m110 : 25|1@1+ (1,0) [0|0] "" Vector__XXX
 SG_ VCFRONT_a111_VEH_seatStatus m111 : 25|1@1+ (1,0) [0|0] "" Vector__XXX
 SG_ VCFRONT_a112_PARTY_status m112 : 25|1@1+ (1,0) [0|0] "" Vector__XXX
 SG_ VCFRONT_a113_VEH_chassisControl m113 : 25|1@1+ (1,0) [0|0] "" Vector__XXX
 SG_ VCFRONT_a114_VEH_wheelRotation m114 : 25|1@1+ (1,0) [0|0] "" Vector__XXX
 SG_ VCFRONT_a116_VEH_seatHeatStatus m116 : 25|1@1+ (1,0) [0|0] "" Vector__XXX
 SG_ VCFRONT_a117_VEH_seatStatus m117 : 25|1@1+ (1,0) [0|0] "" Vector__XXX
 SG_ VCFRONT_a118_VEH_systemStatus m118 : 25|1@1+ (1,0) [0|0] "" Vector__XXX
 SG_ VCFRONT_a120_PARTY_status m120 : 25|1@1+ (1,0) [0|0] "" Vector__XXX
 SG_ VCFRONT_a142_isCoilOpenY m142 : 25|1@1+ (1,0) [0|0] "" Vector__XXX
 SG_ VCFRONT_a153_trunkOpen m153 : 25|1@1+ (1,0) [0|0] "" Vector__XXX
 SG_ VCFRONT_a160_faultValveEXV m160 : 25|1@1+ (1,0) [0|0] "" Vector__XXX
 SG_ VCFRONT_a161_tempSnsFaultIPM1 m161 : 25|1@1+ (1,0) [0|0] "" Vector__XXX
 SG_ VCFRONT_a171_PCSCPU2 m171 : 25|1@1+ (1,0) [0|0] "" Vector__XXX
 SG_ VCFRONT_a178_notRunInverterHot m178 : 25|1@1+ (1,0) [0|0] "" Vector__XXX
 SG_ VCFRONT_a182_factoryMode m182 : 25|1@1+ (1,0) [0|0] "" Vector__XXX
 SG_ VCFRONT_a183_factoryMode m183 : 25|1@1+ (1,0) [0|0] "" Vector__XXX
 SG_ VCFRONT_a187_partyBusRetryCount m187 : 25|9@1+ (1,0) [0|0] "" Vector__XXX
 SG_ VCFRONT_a191_IBSVoltage m191 : 25|8@1+ (0.08741903380905883,0) [0|0] "" Vector__XXX
 SG_ VCFRONT_a192_hvcEFuseStable m192 : 25|1@1+ (1,0) [0|0] "" Vector__XXX
 SG_ VCFRONT_a216_vcrightFastBlowDebo m216 : 25|1@1+ (1,0) [0|0] "" Vector__XXX
 SG_ VCFRONT_a284_isCoilOpenY m284 : 25|1@1+ (1,0) [0|0] "" Vector__XXX
 SG_ VCFRONT_a285_isCoilOpenY m285 : 25|1@1+ (1,0) [0|0] "" Vector__XXX
 SG_ VCFRONT_a286_isCoilOpenY m286 : 25|1@1+ (1,0) [0|0] "" Vector__XXX
 SG_ VCFRONT_a287_isCoilOpenY m287 : 25|1@1+ (1,0) [0|0] "" Vector__XXX
 SG_ VCFRONT_a288_isCoilOpenY m288 : 25|1@1+ (1,0) [0|0] "" Vector__XXX
 SG_ VCFRONT_a289_isCoilOpenY m289 : 25|1@1+ (1,0) [0|0] "" Vector__XXX
 SG_ VCFRONT_a365_heatPumpFlowRequest m365 : 25|1@1+ (1,0) [0|0] "" Vector__XXX
 SG_ VCFRONT_a366_sentryModeActive m366 : 25|1@1+ (1,0) [0|0] "" Vector__XXX
 SG_ VCFRONT_a427_endingSoc m427 : 25|9@1+ (0.2,0) [0|0] "" Vector__XXX
 SG_ VCFRONT_a446_compStandbySelfNotR m446 : 25|1@1+ (1,0) [0|0] "" Vector__XXX
 SG_ VCFRONT_a447_lccSolenoidCompromi m447 : 25|1@1+ (1,0) [0|0] "" Vector__XXX
 SG_ VCFRONT_a462_HardwareOCLevel2 m462 : 25|1@1+ (1,0) [0|0] "" Vector__XXX
 SG_ VCFRONT_a476_FRM10_timedOut m476 : 25|1@1+ (1,0) [0|0] "" Vector__XXX
 SG_ VCFRONT_a477_cell2Voltage m477 : 25|9@1+ (0.01,0) [0|0] "" Vector__XXX
 SG_ VCFRONT_a480_unexpectedLock m480 : 25|1@1+ (1,0) [0|0] "" Vector__XXX
 SG_ VCFRONT_a481_outputOn m481 : 25|1@1+ (1,0) [0|0] "" Vector__XXX
 SG_ VCFRONT_a495_frunkOpen m495 : 25|1@1+ (1,0) [0|0] "" Vector__XXX
 SG_ VCFRONT_a499_DIFlowReq m499 : 25|1@1+ (1,0) [0|0] "" Vector__XXX
 SG_ VCFRONT_a529_disconnectedBattery m529 : 25|1@1+ (1,0) [0|0] "" Vector__XXX
 SG_ VCFRONT_a541_ChargeCurrentLimit m541 : 25|10@1+ (0.05,0) [0|0] "" Vector__XXX
 SG_ VCFRONT_a565_trunkOpen m565 : 25|1@1+ (1,0) [0|0] "" Vector__XXX
 SG_ VCFRONT_a614_ranFanRpm m614 : 25|1@1+ (1,0) [0|0] "" Vector__XXX
 SG_ VCFRONT_a627_cell2Voltage m627 : 25|9@1+ (0.01,0) [0|0] "" Vector__XXX
 SG_ VCFRONT_a635_requestSleepFailed m635 : 25|1@1+ (1,0) [0|0] "" Vector__XXX
 SG_ VCFRONT_a644_fluidLowEstimate m644 : 25|1@1+ (1,0) [0|0] "" Vector__XXX
 SG_ VCFRONT_a006_mailboxID m6 : 24|8@1+ (1,0) [0|0] "" Vector__XXX
 SG_ VCFRONT_a009_abortedCOP1BattHeat m9 : 24|1@1+ (1,0) [0|0] "" Vector__XXX
 SG_ VCFRONT_a021_Task100msMissed m21 : 24|1@1+ (1,0) [0|0] "" Vector__XXX
 SG_ VCFRONT_a022_TaskInitError0 m22 : 24|8@1+ (1,0) [0|0] "" Vector__XXX
 SG_ VCFRONT_a031_uds_bytes_1 m31 : 24|8@1+ (1,0) [0|0] "" Vector__XXX
 SG_ VCFRONT_a033_syndrome m33 : 24|8@1+ (1,0) [0|0] "" Vector__XXX
 SG_ VCFRONT_a038_nonSecure m38 : 24|1@1+ (1,0) [0|0] "" Vector__XXX
 SG_ VCFRONT_a039_faultAddress m39 : 24|32@1+ (1,0) [0|0] "" Vector__XXX
 SG_ VCFRONT_a040_programCounter m40 : 24|32@1+ (1,0) [0|0] "" Vector__XXX
 SG_ VCFRONT_a041_CPULoad1msTask m41 : 24|8@1+ (1,0) [0|0] "" Vector__XXX
 SG_ VCFRONT_a042_Usage10msTask m42 : 24|8@1+ (1,0) [0|0] "" Vector__XXX
 SG_ VCFRONT_a047_Mcwdt3 m47 : 24|1@1+ (1,0) [0|0] "" Vector__XXX
 SG_ VCFRONT_a063_switchType m63 : 24|8@1+ (1,0) [0|0] "" Vector__XXX
 SG_ VCFRONT_a086_VEH_vehNm m86 : 24|1@1+ (1,0) [0|0] "" Vector__XXX
 SG_ VCFRONT_a087_VEH_motorStatus m87 : 24|1@1+ (1,0) [0|0] "" Vector__XXX
 SG_ VCFRONT_a088_VEH_motorStatus m88 : 24|1@1+ (1,0) [0|0] "" Vector__XXX
 SG_ VCFRONT_a089_VEH_party1 m89 : 24|1@1+ (1,0) [0|0] "" Vector__XXX
 SG_ VCFRONT_a098_PARTY_thermalContro m98 : 24|1@1+ (1,0) [0|0] "" Vector__XXX
 SG_ VCFRONT_a104_PARTY_bodyControls m104 : 24|1@1+ (1,0) [0|0] "" Vector__XXX
 SG_ VCFRONT_a107_PT_thermalStatus m107 : 24|1@1+ (1,0) [0|0] "" Vector__XXX
 SG_ VCFRONT_a108_PARTY_thermalContro m108 : 24|1@1+ (1,0) [0|0] "" Vector__XXX
 SG_ VCFRONT_a109_BDY_inertial1 m109 : 24|1@1+ (1,0) [0|0] "" Vector__XXX
 SG_ VCFRONT_a110_VEH_bmpDebug m110 : 24|1@1+ (1,0) [0|0] "" Vector__XXX
 SG_ VCFRONT_a111_VEH_LVPowerState m111 : 24|1@1+ (1,0) [0|0] "" Vector__XXX
 SG_ VCFRONT_a112_VEH_LVPowerState m112 : 24|1@1+ (1,0) [0|0] "" Vector__XXX
 SG_ VCFRONT_a113_VEH_ventCntlReq m113 : 24|1@1+ (1,0) [0|0] "" Vector__XXX
 SG_ VCFRONT_a114_CH_wheelRotation m114 : 24|1@1+ (1,0) [0|0] "" Vector__XXX
 SG_ VCFRONT_a116_VEH_doorStatus m116 : 24|1@1+ (1,0) [0|0] "" Vector__XXX
 SG_ VCFRONT_a117_VEH_lightStatus m117 : 24|1@1+ (1,0) [0|0] "" Vector__XXX
 SG_ VCFRONT_a118_VEH_12VBatteryStatu m118 : 24|1@1+ (1,0) [0|0] "" Vector__XXX
 SG_ VCFRONT_a120_VEH_speed m120 : 24|1@1+ (1,0) [0|0] "" Vector__XXX
 SG_ VCFRONT_a142_isCoilOpenX m142 : 24|1@1+ (1,0) [0|0] "" Vector__XXX
 SG_ VCFRONT_a153_rearPassengerDoorOp m153 : 24|1@1+ (1,0) [0|0] "" Vector__XXX
 SG_ VCFRONT_a155_minHVComingUpIBSVol m155 : 24|11@1+ (0.005,5) [0|0] "" Vector__XXX
 SG_ VCFRONT_a160_faultSnsAmbientTemp m160 : 24|1@1+ (1,0) [0|0] "" Vector__XXX
 SG_ VCFRONT_a161_LVOverVoltage m161 : 24|1@1+ (1,0) [0|0] "" Vector__XXX
 SG_ VCFRONT_a163_failureConfidence m163 : 24|7@1+ (1,0) [0|0] "" Vector__XXX
 SG_ VCFRONT_a171_PCS m171 : 24|1@1+ (1,0) [0|0] "" Vector__XXX
 SG_ VCFRONT_a178_abortCompLimited m178 : 24|1@1+ (1,0) [0|0] "" Vector__XXX
 SG_ VCFRONT_a180_bmsState m180 : 24|4@1+ (1,0) [0|0] "" Vector__XXX
 SG_ VCFRONT_a182_prechargeLVLoadRedu m182 : 24|1@1+ (1,0) [0|0] "" Vector__XXX
 SG_ VCFRONT_a183_prechargeLVLoadRedu m183 : 24|1@1+ (1,0) [0|0] "" Vector__XXX
 SG_ VCFRONT_a184_ptInlet m184 : 24|6@1+ (2,0) [0|0] "" Vector__XXX
 SG_ VCFRONT_a188_IBSCurrent m188 : 24|12@1- (0.02,0) [0|0] "" Vector__XXX
 SG_ VCFRONT_a191_vehicleLoadShedPost m191 : 24|1@1+ (1,0) [0|0] "" Vector__XXX
 SG_ VCFRONT_a192_contactorEFuseStabl m192 : 24|1@1+ (1,0) [0|0] "" Vector__XXX
 SG_ VCFRONT_a196_batterySMState m196 : 24|4@1+ (1,0) [0|0] "" Vector__XXX
 SG_ VCFRONT_a216_vcrightFastBlowImmi m216 : 24|1@1+ (1,0) [0|0] "" Vector__XXX
 SG_ VCFRONT_a242_IBSCurrent m242 : 24|12@1- (0.1,0) [0|0] "" Vector__XXX
 SG_ VCFRONT_a269_IBSCurrent m269 : 24|12@1- (0.1,0) [0|0] "" Vector__XXX
 SG_ VCFRONT_a275_breakLocationB m275 : 24|5@1+ (1,0) [0|0] "" Vector__XXX
 SG_ VCFRONT_a276_breakLocationB m276 : 24|5@1+ (1,0) [0|0] "" Vector__XXX
 SG_ VCFRONT_a283_thmlFanDemand m283 : 24|7@1+ (1,0) [0|0] "" Vector__XXX
 SG_ VCFRONT_a284_isCoilOpenX m284 : 24|1@1+ (1,0) [0|0] "" Vector__XXX
 SG_ VCFRONT_a285_isCoilOpenX m285 : 24|1@1+ (1,0) [0|0] "" Vector__XXX
 SG_ VCFRONT_a286_isCoilOpenX m286 : 24|1@1+ (1,0) [0|0] "" Vector__XXX
 SG_ VCFRONT_a287_isCoilOpenX m287 : 24|1@1+ (1,0) [0|0] "" Vector__XXX
 SG_ VCFRONT_a288_isCoilOpenX m288 : 24|1@1+ (1,0) [0|0] "" Vector__XXX
 SG_ VCFRONT_a289_isCoilOpenX m289 : 24|1@1+ (1,0) [0|0] "" Vector__XXX
 SG_ VCFRONT_a296_timeInDown2 m296 : 24|32@1+ (1,0) [0|0] "" Vector__XXX
 SG_ VCFRONT_a297_bmbDeviceFaultTempM m297 : 24|8@1+ (1,0) [0|0] "" Vector__XXX
 SG_ VCFRONT_a304_temperature m304 : 24|8@1+ (0.5,-40) [0|0] "" Vector__XXX
 SG_ VCFRONT_a305_temperature m305 : 24|8@1+ (0.5,-40) [0|0] "" Vector__XXX
 SG_ VCFRONT_a306_temperature m306 : 24|8@1+ (0.5,-40) [0|0] "" Vector__XXX
 SG_ VCFRONT_a307_temperature m307 : 24|8@1+ (0.5,-40) [0|0] "" Vector__XXX
 SG_ VCFRONT_a308_temperature m308 : 24|8@1+ (0.5,-40) [0|0] "" Vector__XXX
 SG_ VCFRONT_a353_batteryVoltage m353 : 24|7@1+ (0.15,0) [0|0] "" Vector__XXX
 SG_ VCFRONT_a354_batteryVoltage m354 : 24|7@1+ (0.15,0) [0|0] "" Vector__XXX
 SG_ VCFRONT_a365_notInConditioning m365 : 24|1@1+ (1,0) [0|0] "" Vector__XXX
 SG_ VCFRONT_a366_heatPumpFlowRequest m366 : 24|1@1+ (1,0) [0|0] "" Vector__XXX
 SG_ VCFRONT_a368_bmsSoc m368 : 24|8@1+ (0.5,0) [0|0] "" Vector__XXX
 SG_ VCFRONT_a369_bmsSoc m369 : 24|8@1+ (0.5,0) [0|0] "" Vector__XXX
 SG_ VCFRONT_a372_bmbDeviceFaultBrick m372 : 24|16@1+ (1,0) [0|0] "" Vector__XXX
 SG_ VCFRONT_a378_wiperLINError m378 : 24|1@1+ (1,0) [0|0] "" Vector__XXX
 SG_ VCFRONT_a380_commLostError m380 : 24|3@1+ (1,0) [0|0] "" Vector__XXX
 SG_ VCFRONT_a381_commLostError m381 : 24|3@1+ (1,0) [0|0] "" Vector__XXX
 SG_ VCFRONT_a382_commLostError m382 : 24|3@1+ (1,0) [0|0] "" Vector__XXX
 SG_ VCFRONT_a383_commLostError m383 : 24|3@1+ (1,0) [0|0] "" Vector__XXX
 SG_ VCFRONT_a384_commLostError m384 : 24|3@1+ (1,0) [0|0] "" Vector__XXX
 SG_ VCFRONT_a385_commLostError m385 : 24|3@1+ (1,0) [0|0] "" Vector__XXX
 SG_ VCFRONT_a386_commLostError m386 : 24|3@1+ (1,0) [0|0] "" Vector__XXX
 SG_ VCFRONT_a390_dominantLoad m390 : 24|3@1+ (1,0) [0|0] "" Vector__XXX
 SG_ VCFRONT_a392_bmbDeviceFaultBrick m392 : 24|16@1+ (1,0) [0|0] "" Vector__XXX
 SG_ VCFRONT_a401_IBSCurrent m401 : 24|12@1- (0.1,0) [0|0] "" Vector__XXX
 SG_ VCFRONT_a402_batterySMState m402 : 24|4@1+ (1,0) [0|0] "" Vector__XXX
 SG_ VCFRONT_a405_intervalVoltage1 m405 : 24|8@1+ (0.02,9) [0|0] "" Vector__XXX
 SG_ VCFRONT_a406_pulseVoltage2 m406 : 24|8@1+ (0.02,9) [0|0] "" Vector__XXX
 SG_ VCFRONT_a407_dcr12VThreshold m407 : 24|4@1+ (1,0) [0|0] "" Vector__XXX
 SG_ VCFRONT_a410_IBSCurrent m410 : 24|12@1- (0.1,0) [0|0] "" Vector__XXX
 SG_ VCFRONT_a411_IBSCurrent m411 : 24|12@1- (0.1,0) [0|0] "" Vector__XXX
 SG_ VCFRONT_a412_pulseVoltage1Shifte m412 : 24|8@1+ (0.02,9) [0|0] "" Vector__XXX
 SG_ VCFRONT_a414_LVBatteryTemp m414 : 24|7@1+ (1,-40) [0|0] "" Vector__XXX
 SG_ VCFRONT_a428_minBrickCac m428 : 24|13@1+ (0.1,0) [0|0] "" Vector__XXX
 SG_ VCFRONT_a444_channel m444 : 24|8@1+ (1,0) [0|0] "" Vector__XXX
 SG_ VCFRONT_a445_expectedMSB m445 : 24|8@1+ (1,0) [0|0] "" Vector__XXX
 SG_ VCFRONT_a446_compStandbyCommunic m446 : 24|1@1+ (1,0) [0|0] "" Vector__XXX
 SG_ VCFRONT_a447_hvBatteryDischargin m447 : 24|1@1+ (1,0) [0|0] "" Vector__XXX
 SG_ VCFRONT_a462_DischrgOCLevel1 m462 : 24|1@1+ (1,0) [0|0] "" Vector__XXX
 SG_ VCFRONT_a464_flowIndexFiltered m464 : 24|8@1+ (1,0) [0|0] "" Vector__XXX
 SG_ VCFRONT_a465_flowIndexFiltered m465 : 24|8@1+ (1,0) [0|0] "" Vector__XXX
 SG_ VCFRONT_a466_flowIndexFiltered m466 : 24|8@1+ (1,0) [0|0] "" Vector__XXX
 SG_ VCFRONT_a469_pressureDischarge m469 : 24|8@1+ (0.2,0) [0|0] "" Vector__XXX
 SG_ VCFRONT_a470_pressureDischarge m470 : 24|8@1+ (0.2,0) [0|0] "" Vector__XXX
 SG_ VCFRONT_a474_ssl100Bank5Status m474 : 24|2@1+ (1,0) [0|0] "" Vector__XXX
 SG_ VCFRONT_a475_ssl100Bank5Status m475 : 24|2@1+ (1,0) [0|0] "" Vector__XXX
 SG_ VCFRONT_a476_FRM9_timedOut m476 : 24|1@1+ (1,0) [0|0] "" Vector__XXX
 SG_ VCFRONT_a478_batterySMState m478 : 24|4@1+ (1,0) [0|0] "" Vector__XXX
 SG_ VCFRONT_a479_frunkLatchStatus m479 : 24|4@1+ (1,0) [0|0] "" Vector__XXX
 SG_ VCFRONT_a480_overcurrent m480 : 24|1@1+ (1,0) [0|0] "" Vector__XXX
 SG_ VCFRONT_a481_timeout m481 : 24|1@1+ (1,0) [0|0] "" Vector__XXX
 SG_ VCFRONT_a483_headlampTemperature m483 : 24|8@1+ (0.5,-40) [0|0] "" Vector__XXX
 SG_ VCFRONT_a484_rearRideHeight m484 : 24|8@1- (1,0) [0|0] "" Vector__XXX
 SG_ VCFRONT_a488_headlampTemperature m488 : 24|8@1+ (0.5,-40) [0|0] "" Vector__XXX
 SG_ VCFRONT_a492_minBrickSoc m492 : 24|8@1+ (0.5,0) [0|0] "" Vector__XXX
 SG_ VCFRONT_a493_minBrickSocByOcvMax m493 : 24|8@1+ (0.5,0) [0|0] "" Vector__XXX
 SG_ VCFRONT_a495_serviceMode m495 : 24|1@1+ (1,0) [0|0] "" Vector__XXX
 SG_ VCFRONT_a496_bmsState m496 : 24|4@1+ (1,0) [0|0] "" Vector__XXX
 SG_ VCFRONT_a497_SOC m497 : 24|7@1+ (1,0) [0|0] "" Vector__XXX
 SG_ VCFRONT_a498_brickImpedanceNorma m498 : 24|7@1+ (0.01,0.5) [0|0] "" Vector__XXX
 SG_ VCFRONT_a499_BMSFlowReq m499 : 24|1@1+ (1,0) [0|0] "" Vector__XXX
 SG_ VCFRONT_a500_mismatchedState m500 : 24|3@1+ (1,0) [0|0] "" Vector__XXX
 SG_ VCFRONT_a502_minBrickVDelta m502 : 24|15@1- (0.0005,0) [0|0] "" Vector__XXX
 SG_ VCFRONT_a507_headlampHealth m507 : 24|3@1+ (1,0) [0|0] "" Vector__XXX
 SG_ VCFRONT_a510_packVoltage m510 : 24|8@1+ (0.1,0) [0|0] "" Vector__XXX
 SG_ VCFRONT_a512_packVoltageInterval m512 : 24|8@1+ (0.1,0) [0|0] "" Vector__XXX
 SG_ VCFRONT_a516_HVSoc m516 : 24|10@1+ (0.1,0) [0|0] "" Vector__XXX
 SG_ VCFRONT_a517_HVSoc m517 : 24|10@1+ (0.1,0) [0|0] "" Vector__XXX
 SG_ VCFRONT_a518_IBSVoltage m518 : 24|9@1+ (0.05,0) [0|0] "" Vector__XXX
 SG_ VCFRONT_a522_HVSoc m522 : 24|10@1+ (0.1,0) [0|0] "" Vector__XXX
 SG_ VCFRONT_a523_control2Byte1 m523 : 24|8@1+ (1,0) [0|0] "" Vector__XXX
 SG_ VCFRONT_a524_headlampHealth m524 : 24|3@1+ (1,0) [0|0] "" Vector__XXX
 SG_ VCFRONT_a525_initialLVBatteryTyp m525 : 24|3@1+ (1,0) [0|0] "" Vector__XXX
 SG_ VCFRONT_a529_rerunDisconnectedBa m529 : 24|1@1+ (1,0) [0|0] "" Vector__XXX
 SG_ VCFRONT_a534_initialFlow m534 : 24|8@1+ (0.5,0) [0|0] "" Vector__XXX
 SG_ VCFRONT_a535_initialFlow m535 : 24|8@1+ (0.5,0) [0|0] "" Vector__XXX
 SG_ VCFRONT_a536_initialFlow m536 : 24|8@1+ (0.5,0) [0|0] "" Vector__XXX
 SG_ VCFRONT_a537_initialFlow m537 : 24|8@1+ (0.5,0) [0|0] "" Vector__XXX
 SG_ VCFRONT_a538_initialFlow m538 : 24|8@1+ (0.5,0) [0|0] "" Vector__XXX
 SG_ VCFRONT_a539_initialFlow m539 : 24|8@1+ (0.5,0) [0|0] "" Vector__XXX
 SG_ VCFRONT_a542_liquidPressure m542 : 24|6@1+ (0.5,0) [0|0] "" Vector__XXX
 SG_ VCFRONT_a545_frunkOpen m545 : 24|1@1+ (1,0) [0|0] "" Vector__XXX
 SG_ VCFRONT_a548_backstopBucketCount m548 : 24|5@1+ (0.035,0) [0|0] "" Vector__XXX
 SG_ VCFRONT_a552_epas3sSelfTestResul m552 : 24|4@1+ (1,0) [0|0] "" Vector__XXX
 SG_ VCFRONT_a556_disconnectedBattery m556 : 24|12@1+ (0.004884004884004884,-10) [0|0] "" Vector__XXX
 SG_ VCFRONT_a559_PackCurrent m559 : 24|12@1+ (0.2,-600) [0|0] "" Vector__XXX
 SG_ VCFRONT_a565_rearPassengerDoorOp m565 : 24|1@1+ (1,0) [0|0] "" Vector__XXX
 SG_ VCFRONT_a582_PCSCurrent m582 : 24|8@1+ (0.5,-127) [0|0] "" Vector__XXX
 SG_ VCFRONT_a583_switch1State m583 : 24|3@1+ (1,0) [0|0] "" Vector__XXX
 SG_ VCFRONT_a584_switch1Voltage m584 : 24|9@1+ (10,0) [0|0] "" Vector__XXX
 SG_ VCFRONT_a587_batterySMState m587 : 24|4@1+ (1,0) [0|0] "" Vector__XXX
 SG_ VCFRONT_a588_vcleftATerm m588 : 24|16@1+ (50,0) [0|0] "" Vector__XXX
 SG_ VCFRONT_a590_vcrightATerm m590 : 24|16@1+ (50,0) [0|0] "" Vector__XXX
 SG_ VCFRONT_a592_vcleftCutoffATerm m592 : 24|16@1+ (50,0) [0|0] "" Vector__XXX
 SG_ VCFRONT_a594_minOffsetFusionSess m594 : 24|8@1- (0.001,0) [0|0] "" Vector__XXX
 SG_ VCFRONT_a595_batterySMState m595 : 24|4@1+ (1,0) [0|0] "" Vector__XXX
 SG_ VCFRONT_a596_vcrightCutoffATerm m596 : 24|16@1+ (50,0) [0|0] "" Vector__XXX
 SG_ VCFRONT_a599_initialLVBatteryTyp m599 : 24|3@1+ (1,0) [0|0] "" Vector__XXX
 SG_ VCFRONT_a600_batterySMState m600 : 24|4@1+ (1,0) [0|0] "" Vector__XXX
 SG_ VCFRONT_a611_tempCoolantRadOutle m611 : 24|6@1+ (1,20) [0|0] "" Vector__XXX
 SG_ VCFRONT_a614_ptPumpFault m614 : 24|1@1+ (1,0) [0|0] "" Vector__XXX
 SG_ VCFRONT_a618_evapInTemp m618 : 24|6@1+ (1,0) [0|0] "" Vector__XXX
 SG_ VCFRONT_a626_elevatedDcrThreshol m626 : 24|4@1+ (0.5,12) [0|0] "" Vector__XXX
 SG_ VCFRONT_a628_lastNominalTemp m628 : 24|8@1+ (0.5,-20) [0|0] "" Vector__XXX
 SG_ VCFRONT_a635_readyToSleepFailed m635 : 24|1@1+ (1,0) [0|0] "" Vector__XXX
 SG_ VCFRONT_a644_washpumpCycleSucces m644 : 24|1@1+ (1,0) [0|0] "" Vector__XXX
 SG_ VCFRONT_a645_averageUnprimedFlui m645 : 24|8@1- (0.0984251968503937,5.807086614173229) [0|0] "" Vector__XXX
 SG_ VCFRONT_a646_timeDeltaBetweenCom m646 : 24|14@1+ (1,0) [0|0] "" Vector__XXX
 SG_ VCFRONT_a663_hcmlGroupsHighWater m663 : 24|5@1+ (3.225806451612903,0) [0|0] "" Vector__XXX
 SG_ VCFRONT_a664_hcmrGroupsHighWater m664 : 24|5@1+ (3.225806451612903,0) [0|0] "" Vector__XXX
 SG_ VCFRONT_a665_isClearingFaults m665 : 24|1@1+ (1,0) [0|0] "" Vector__XXX
 SG_ VCFRONT_a666_isClearingFaults m666 : 24|1@1+ (1,0) [0|0] "" Vector__XXX
 SG_ VCFRONT_a667_country m667 : 24|16@1+ (1,0) [0|0] "" Vector__XXX
 SG_ VCFRONT_a668_country m668 : 24|16@1+ (1,0) [0|0] "" Vector__XXX
 SG_ VCFRONT_a009_abortedLowPs m9 : 23|1@1+ (1,0) [0|0] "" Vector__XXX
 SG_ VCFRONT_a021_Task100msStarved m21 : 23|1@1+ (1,0) [0|0] "" Vector__XXX
 SG_ VCFRONT_a032_pwrDone m32 : 23|1@1+ (1,0) [0|0] "" Vector__XXX
 SG_ VCFRONT_a038_privilegedExecute m38 : 23|1@1+ (1,0) [0|0] "" Vector__XXX
 SG_ VCFRONT_a047_Mcwdt2 m47 : 23|1@1+ (1,0) [0|0] "" Vector__XXX
 SG_ VCFRONT_a086_VEH_thermalStatus m86 : 23|1@1+ (1,0) [0|0] "" Vector__XXX
 SG_ VCFRONT_a087_PARTY_thermalContro m87 : 23|1@1+ (1,0) [0|0] "" Vector__XXX
 SG_ VCFRONT_a088_PARTY_thermalContro m88 : 23|1@1+ (1,0) [0|0] "" Vector__XXX
 SG_ VCFRONT_a089_CH_party3 m89 : 23|1@1+ (1,0) [0|0] "" Vector__XXX
 SG_ VCFRONT_a098_PARTY_temperature m98 : 23|1@1+ (1,0) [0|0] "" Vector__XXX
 SG_ VCFRONT_a104_PARTY_control m104 : 23|1@1+ (1,0) [0|0] "" Vector__XXX
 SG_ VCFRONT_a107_PT_status m107 : 23|1@1+ (1,0) [0|0] "" Vector__XXX
 SG_ VCFRONT_a108_PARTY_temperature m108 : 23|1@1+ (1,0) [0|0] "" Vector__XXX
 SG_ VCFRONT_a109_BDY_imuOffsets m109 : 23|1@1+ (1,0) [0|0] "" Vector__XXX
 SG_ VCFRONT_a110_VEH_vin m110 : 23|1@1+ (1,0) [0|0] "" Vector__XXX
 SG_ VCFRONT_a111_RIPC_switchStatus m111 : 23|1@1+ (1,0) [0|0] "" Vector__XXX
 SG_ VCFRONT_a112_LIPC_switchStatus m112 : 23|1@1+ (1,0) [0|0] "" Vector__XXX
 SG_ VCFRONT_a113_VEH_solarData m113 : 23|1@1+ (1,0) [0|0] "" Vector__XXX
 SG_ VCFRONT_a114_PARTY_wheelRotation m114 : 23|1@1+ (1,0) [0|0] "" Vector__XXX
 SG_ VCFRONT_a115_CH_TPMSDisplay m115 : 23|1@1+ (1,0) [0|0] "" Vector__XXX
 SG_ VCFRONT_a116_VEH_thsStatus m116 : 23|1@1+ (1,0) [0|0] "" Vector__XXX
 SG_ VCFRONT_a117_VEH_restraintStatus m117 : 23|1@1+ (1,0) [0|0] "" Vector__XXX
 SG_ VCFRONT_a118_VEH_vehicleStatus m118 : 23|1@1+ (1,0) [0|0] "" Vector__XXX
 SG_ VCFRONT_a120_PARTY_speed m120 : 23|1@1+ (1,0) [0|0] "" Vector__XXX
 SG_ VCFRONT_a142_chargePumpUndervolt m142 : 23|1@1+ (1,0) [0|0] "" Vector__XXX
 SG_ VCFRONT_a153_rearDriverDoorOpen m153 : 23|1@1+ (1,0) [0|0] "" Vector__XXX
 SG_ VCFRONT_a160_faultSnsSuctTemp m160 : 23|1@1+ (1,0) [0|0] "" Vector__XXX
 SG_ VCFRONT_a161_LVUnderVoltage m161 : 23|1@1+ (1,0) [0|0] "" Vector__XXX
 SG_ VCFRONT_a171_CP m171 : 23|1@1+ (1,0) [0|0] "" Vector__XXX
 SG_ VCFRONT_a178_abortCompOvershoot m178 : 23|1@1+ (1,0) [0|0] "" Vector__XXX
 SG_ VCFRONT_a182_dcrMilliOhmsAboveTh m182 : 23|1@1+ (1,0) [0|0] "" Vector__XXX
 SG_ VCFRONT_a183_dcrMilliOhmsAboveTh m183 : 23|1@1+ (1,0) [0|0] "" Vector__XXX
 SG_ VCFRONT_a191_vehicleLoadShedHvFa m191 : 23|1@1+ (1,0) [0|0] "" Vector__XXX
 SG_ VCFRONT_a192_vcrightEFuseStable m192 : 23|1@1+ (1,0) [0|0] "" Vector__XXX
 SG_ VCFRONT_a216_vcleftDynamicImmine m216 : 23|1@1+ (1,0) [0|0] "" Vector__XXX
 SG_ VCFRONT_a284_chargePumpUndervolt m284 : 23|1@1+ (1,0) [0|0] "" Vector__XXX
 SG_ VCFRONT_a285_chargePumpUndervolt m285 : 23|1@1+ (1,0) [0|0] "" Vector__XXX
 SG_ VCFRONT_a286_chargePumpUndervolt m286 : 23|1@1+ (1,0) [0|0] "" Vector__XXX
 SG_ VCFRONT_a287_chargePumpUndervolt m287 : 23|1@1+ (1,0) [0|0] "" Vector__XXX
 SG_ VCFRONT_a288_chargePumpUndervolt m288 : 23|1@1+ (1,0) [0|0] "" Vector__XXX
 SG_ VCFRONT_a289_chargePumpUndervolt m289 : 23|1@1+ (1,0) [0|0] "" Vector__XXX
 SG_ VCFRONT_a365_timeout m365 : 23|1@1+ (1,0) [0|0] "" Vector__XXX
 SG_ VCFRONT_a366_notInConditioning m366 : 23|1@1+ (1,0) [0|0] "" Vector__XXX
 SG_ VCFRONT_a378_wiperOvervoltage m378 : 23|1@1+ (1,0) [0|0] "" Vector__XXX
 SG_ VCFRONT_a446_compStandbyHVNotRea m446 : 23|1@1+ (1,0) [0|0] "" Vector__XXX
 SG_ VCFRONT_a447_hvBattActiveDischgC m447 : 23|1@1+ (1,0) [0|0] "" Vector__XXX
 SG_ VCFRONT_a462_PackOVLevel2 m462 : 23|1@1+ (1,0) [0|0] "" Vector__XXX
 SG_ VCFRONT_a476_FRM8_timedOut m476 : 23|1@1+ (1,0) [0|0] "" Vector__XXX
 SG_ VCFRONT_a480_deviceError m480 : 23|1@1+ (1,0) [0|0] "" Vector__XXX
 SG_ VCFRONT_a495_externalInteraction m495 : 23|1@1+ (1,0) [0|0] "" Vector__XXX
 SG_ VCFRONT_a496_NotEnoughPowerForSu m496 : 23|1@1+ (1,0) [0|0] "" Vector__XXX
 SG_ VCFRONT_a507_isAcceptablePowerSt m507 : 23|1@1+ (1,0) [0|0] "" Vector__XXX
 SG_ VCFRONT_a514_cell2Voltage m514 : 23|7@1+ (0.08,0) [0|0] "" Vector__XXX
 SG_ VCFRONT_a515_cell2Voltage m515 : 23|7@1+ (0.08,0) [0|0] "" Vector__XXX
 SG_ VCFRONT_a524_isAcceptablePowerSt m524 : 23|1@1+ (1,0) [0|0] "" Vector__XXX
 SG_ VCFRONT_a545_factoryGated m545 : 23|1@1+ (1,0) [0|0] "" Vector__XXX
 SG_ VCFRONT_a565_rearDriverDoorOpen m565 : 23|1@1+ (1,0) [0|0] "" Vector__XXX
 SG_ VCFRONT_a606_chillerLoadBeforeEn m606 : 23|7@1+ (50.38582677165354,0) [0|0] "" Vector__XXX
 SG_ VCFRONT_a614_ptPumpRpm m614 : 23|1@1+ (1,0) [0|0] "" Vector__XXX
 SG_ VCFRONT_a635_ethBusAwake m635 : 23|1@1+ (1,0) [0|0] "" Vector__XXX
 SG_ VCFRONT_a644_validWashCycle m644 : 23|1@1+ (1,0) [0|0] "" Vector__XXX
 SG_ VCFRONT_a665_isWaitingToClear m665 : 23|1@1+ (1,0) [0|0] "" Vector__XXX
 SG_ VCFRONT_a666_isWaitingToClear m666 : 23|1@1+ (1,0) [0|0] "" Vector__XXX
 SG_ VCFRONT_a669_hvState m669 : 23|3@1+ (1,0) [0|0] "" Vector__XXX
 SG_ VCFRONT_a009_abortedDeviceFault m9 : 22|1@1+ (1,0) [0|0] "" Vector__XXX
 SG_ VCFRONT_a021_Task100msLate m21 : 22|1@1+ (1,0) [0|0] "" Vector__XXX
 SG_ VCFRONT_a032_sleepdeep m32 : 22|1@1+ (1,0) [0|0] "" Vector__XXX
 SG_ VCFRONT_a038_privilegedWrite m38 : 22|1@1+ (1,0) [0|0] "" Vector__XXX
 SG_ VCFRONT_a047_Mcwdt1 m47 : 22|1@1+ (1,0) [0|0] "" Vector__XXX
 SG_ VCFRONT_a086_VEH_systemStatus m86 : 22|1@1+ (1,0) [0|0] "" Vector__XXX
 SG_ VCFRONT_a087_PARTY_temperature m87 : 22|1@1+ (1,0) [0|0] "" Vector__XXX
 SG_ VCFRONT_a088_PARTY_temperature m88 : 22|1@1+ (1,0) [0|0] "" Vector__XXX
 SG_ VCFRONT_a089_CH_party1 m89 : 22|1@1+ (1,0) [0|0] "" Vector__XXX
 SG_ VCFRONT_a098_PARTY_status m98 : 22|1@1+ (1,0) [0|0] "" Vector__XXX
 SG_ VCFRONT_a104_CH_control m104 : 22|1@1+ (1,0) [0|0] "" Vector__XXX
 SG_ VCFRONT_a107_PT_ptNm m107 : 22|1@1+ (1,0) [0|0] "" Vector__XXX
 SG_ VCFRONT_a108_PARTY_status m108 : 22|1@1+ (1,0) [0|0] "" Vector__XXX
 SG_ VCFRONT_a109_PARTY_inertial1 m109 : 22|1@1+ (1,0) [0|0] "" Vector__XXX
 SG_ VCFRONT_a110_VEH_mismatchFault m110 : 22|1@1+ (1,0) [0|0] "" Vector__XXX
 SG_ VCFRONT_a111_RIPC_remoteADC m111 : 22|1@1+ (1,0) [0|0] "" Vector__XXX
 SG_ VCFRONT_a112_LIPC_remoteADC m112 : 22|1@1+ (1,0) [0|0] "" Vector__XXX
 SG_ VCFRONT_a113_VEH_corianderVehicl m113 : 22|1@1+ (1,0) [0|0] "" Vector__XXX
 SG_ VCFRONT_a114_VEH_status m114 : 22|1@1+ (1,0) [0|0] "" Vector__XXX
 SG_ VCFRONT_a115_UI_corianderVehicle m115 : 22|1@1+ (1,0) [0|0] "" Vector__XXX
 SG_ VCFRONT_a116_VEH_seatStatus m116 : 22|1@1+ (1,0) [0|0] "" Vector__XXX
 SG_ VCFRONT_a117_VEH_LVPowerState m117 : 22|1@1+ (1,0) [0|0] "" Vector__XXX
 SG_ VCFRONT_a118_VEH_coolant m118 : 22|1@1+ (1,0) [0|0] "" Vector__XXX
 SG_ VCFRONT_a120_PARTY_locStatus m120 : 22|1@1+ (1,0) [0|0] "" Vector__XXX
 SG_ VCFRONT_a142_undervoltage m142 : 22|1@1+ (1,0) [0|0] "" Vector__XXX
 SG_ VCFRONT_a153_frontPassengerDoorO m153 : 22|1@1+ (1,0) [0|0] "" Vector__XXX
 SG_ VCFRONT_a160_faultSnsSuctPress m160 : 22|1@1+ (1,0) [0|0] "" Vector__XXX
 SG_ VCFRONT_a161_underTemperature m161 : 22|1@1+ (1,0) [0|0] "" Vector__XXX
 SG_ VCFRONT_a162_chillerExvFlow m162 : 22|7@1+ (1,0) [0|0] "" Vector__XXX
 SG_ VCFRONT_a171_GTW m171 : 22|1@1+ (1,0) [0|0] "" Vector__XXX
 SG_ VCFRONT_a178_abortCompTurnedOff m178 : 22|1@1+ (1,0) [0|0] "" Vector__XXX
 SG_ VCFRONT_a182_resistanceEstimatio m182 : 22|1@1+ (1,0) [0|0] "" Vector__XXX
 SG_ VCFRONT_a183_resistanceEstimatio m183 : 22|1@1+ (1,0) [0|0] "" Vector__XXX
 SG_ VCFRONT_a190_bus m190 : 22|6@1+ (1,0) [0|0] "" Vector__XXX
 SG_ VCFRONT_a191_vehicleLoadShedActi m191 : 22|1@1+ (1,0) [0|0] "" Vector__XXX
 SG_ VCFRONT_a192_pcsEFuseStable m192 : 22|1@1+ (1,0) [0|0] "" Vector__XXX
 SG_ VCFRONT_a216_vcleftStaticImminen m216 : 22|1@1+ (1,0) [0|0] "" Vector__XXX
 SG_ VCFRONT_a271_instantPrechargeDCR m271 : 22|1@1+ (1,0) [0|0] "" Vector__XXX
 SG_ VCFRONT_a274_instantPrechargeDCR m274 : 22|1@1+ (1,0) [0|0] "" Vector__XXX
 SG_ VCFRONT_a284_undervoltage m284 : 22|1@1+ (1,0) [0|0] "" Vector__XXX
 SG_ VCFRONT_a285_undervoltage m285 : 22|1@1+ (1,0) [0|0] "" Vector__XXX
 SG_ VCFRONT_a286_undervoltage m286 : 22|1@1+ (1,0) [0|0] "" Vector__XXX
 SG_ VCFRONT_a287_undervoltage m287 : 22|1@1+ (1,0) [0|0] "" Vector__XXX
 SG_ VCFRONT_a288_undervoltage m288 : 22|1@1+ (1,0) [0|0] "" Vector__XXX
 SG_ VCFRONT_a289_undervoltage m289 : 22|1@1+ (1,0) [0|0] "" Vector__XXX
 SG_ VCFRONT_a366_timeout m366 : 22|1@1+ (1,0) [0|0] "" Vector__XXX
 SG_ VCFRONT_a371_instantPrechargeDCR m371 : 22|1@1+ (1,0) [0|0] "" Vector__XXX
 SG_ VCFRONT_a378_wiperUndervoltage m378 : 22|1@1+ (1,0) [0|0] "" Vector__XXX
 SG_ VCFRONT_a390_lowSideHX m390 : 22|2@1+ (1,0) [0|0] "" Vector__XXX
 SG_ VCFRONT_a415_LVBatteryTemp m415 : 22|7@1+ (1,-40) [0|0] "" Vector__XXX
 SG_ VCFRONT_a446_compStandbyLowDisch m446 : 22|1@1+ (1,0) [0|0] "" Vector__XXX
 SG_ VCFRONT_a447_coolantSystemCompro m447 : 22|1@1+ (1,0) [0|0] "" Vector__XXX
 SG_ VCFRONT_a462_PackOVLevel1 m462 : 22|1@1+ (1,0) [0|0] "" Vector__XXX
 SG_ VCFRONT_a474_ssl100Bank4Status m474 : 22|2@1+ (1,0) [0|0] "" Vector__XXX
 SG_ VCFRONT_a475_ssl100Bank4Status m475 : 22|2@1+ (1,0) [0|0] "" Vector__XXX
 SG_ VCFRONT_a476_FRM7_timedOut m476 : 22|1@1+ (1,0) [0|0] "" Vector__XXX
 SG_ VCFRONT_a480_diagnosticBit m480 : 22|1@1+ (1,0) [0|0] "" Vector__XXX
 SG_ VCFRONT_a489_SOV m489 : 22|1@1+ (1,0) [0|0] "" Vector__XXX
 SG_ VCFRONT_a495_HVOff m495 : 22|1@1+ (1,0) [0|0] "" Vector__XXX
 SG_ VCFRONT_a496_PCS_MIA m496 : 22|1@1+ (1,0) [0|0] "" Vector__XXX
 SG_ VCFRONT_a507_isAcceptableGear m507 : 22|1@1+ (1,0) [0|0] "" Vector__XXX
 SG_ VCFRONT_a524_isAcceptableGear m524 : 22|1@1+ (1,0) [0|0] "" Vector__XXX
 SG_ VCFRONT_a545_serviceMode m545 : 22|1@1+ (1,0) [0|0] "" Vector__XXX
 SG_ VCFRONT_a560_highSHCatchAll m560 : 22|1@1+ (1,0) [0|0] "" Vector__XXX
 SG_ VCFRONT_a565_frontPassengerDoorO m565 : 22|1@1+ (1,0) [0|0] "" Vector__XXX
 SG_ VCFRONT_a583_referenceSwitc_0000 m583 : 22|2@1+ (1,0) [0|0] "" Vector__XXX
 SG_ VCFRONT_a584_frunkSwitchGro_0001 m584 : 22|2@1+ (1,0) [0|0] "" Vector__XXX
 SG_ VCFRONT_a606_ductTempOvershoot m606 : 22|1@1+ (1,0) [0|0] "" Vector__XXX
 SG_ VCFRONT_a614_battPumpFault m614 : 22|1@1+ (1,0) [0|0] "" Vector__XXX
 SG_ VCFRONT_a635_partyBusAwake m635 : 22|1@1+ (1,0) [0|0] "" Vector__XXX
 SG_ VCFRONT_a004_EPAS3PNotInSpecOrMI m4 : 21|1@1+ (1,0) [0|0] "" Vector__XXX
 SG_ VCFRONT_a008_EPAS3PNotInSpecOrMI m8 : 21|1@1+ (1,0) [0|0] "" Vector__XXX
 SG_ VCFRONT_a009_completed m9 : 21|1@1+ (1,0) [0|0] "" Vector__XXX
 SG_ VCFRONT_a012_ExternalReset m12 : 21|1@1+ (1,0) [0|0] "" Vector__XXX
 SG_ VCFRONT_a021_Task10msMissed m21 : 21|1@1+ (1,0) [0|0] "" Vector__XXX
 SG_ VCFRONT_a032_sleeping m32 : 21|1@1+ (1,0) [0|0] "" Vector__XXX
 SG_ VCFRONT_a038_privilegedRead m38 : 21|1@1+ (1,0) [0|0] "" Vector__XXX
 SG_ VCFRONT_a047_Mcwdt0 m47 : 21|1@1+ (1,0) [0|0] "" Vector__XXX
 SG_ VCFRONT_a086_VEH_lightStatus m86 : 21|1@1+ (1,0) [0|0] "" Vector__XXX
 SG_ VCFRONT_a087_PARTY_status m87 : 21|1@1+ (1,0) [0|0] "" Vector__XXX
 SG_ VCFRONT_a088_PARTY_status m88 : 21|1@1+ (1,0) [0|0] "" Vector__XXX
 SG_ VCFRONT_a089_CH_status m89 : 21|1@1+ (1,0) [0|0] "" Vector__XXX
 SG_ VCFRONT_a098_VEH_torque m98 : 21|1@1+ (1,0) [0|0] "" Vector__XXX
 SG_ VCFRONT_a103_VEH_evseStatus m103 : 21|1@1+ (1,0) [0|0] "" Vector__XXX
 SG_ VCFRONT_a104_VEH_thermalStatus m104 : 21|1@1+ (1,0) [0|0] "" Vector__XXX
 SG_ VCFRONT_a107_VEH_powerAvailable m107 : 21|1@1+ (1,0) [0|0] "" Vector__XXX
 SG_ VCFRONT_a108_PARTY_torque m108 : 21|1@1+ (1,0) [0|0] "" Vector__XXX
 SG_ VCFRONT_a109_VEH_imuOffsets m109 : 21|1@1+ (1,0) [0|0] "" Vector__XXX
 SG_ VCFRONT_a110_VEH_vehNm m110 : 21|1@1+ (1,0) [0|0] "" Vector__XXX
 SG_ VCFRONT_a111_RIPC_railStatus m111 : 21|1@1+ (1,0) [0|0] "" Vector__XXX
 SG_ VCFRONT_a112_LIPC_railStatus m112 : 21|1@1+ (1,0) [0|0] "" Vector__XXX
 SG_ VCFRONT_a113_VEH_peripheralPower m113 : 21|1@1+ (1,0) [0|0] "" Vector__XXX
 SG_ VCFRONT_a114_VEH_party3 m114 : 21|1@1+ (1,0) [0|0] "" Vector__XXX
 SG_ VCFRONT_a115_REM_authentication m115 : 21|1@1+ (1,0) [0|0] "" Vector__XXX
 SG_ VCFRONT_a116_VEH_lightStatus m116 : 21|1@1+ (1,0) [0|0] "" Vector__XXX
 SG_ VCFRONT_a117_VEH_hvacBlowerFdb m117 : 21|1@1+ (1,0) [0|0] "" Vector__XXX
 SG_ VCFRONT_a118_VEH_LVPowerState m118 : 21|1@1+ (1,0) [0|0] "" Vector__XXX
 SG_ VCFRONT_a119_PARTY_steerAngle m119 : 21|1@1+ (1,0) [0|0] "" Vector__XXX
 SG_ VCFRONT_a120_VEH_torque m120 : 21|1@1+ (1,0) [0|0] "" Vector__XXX
 SG_ VCFRONT_a142_driverThermShutdown m142 : 21|1@1+ (1,0) [0|0] "" Vector__XXX
 SG_ VCFRONT_a153_frontDriverDoorOpen m153 : 21|1@1+ (1,0) [0|0] "" Vector__XXX
 SG_ VCFRONT_a160_faultSnsDischTemp m160 : 21|1@1+ (1,0) [0|0] "" Vector__XXX
 SG_ VCFRONT_a161_shortCircuit m161 : 21|1@1+ (1,0) [0|0] "" Vector__XXX
 SG_ VCFRONT_a171_HVP m171 : 21|1@1+ (1,0) [0|0] "" Vector__XXX
 SG_ VCFRONT_a178_abortCompNeverOn m178 : 21|1@1+ (1,0) [0|0] "" Vector__XXX
 SG_ VCFRONT_a182_postPORExcessiveAh m182 : 21|1@1+ (1,0) [0|0] "" Vector__XXX
 SG_ VCFRONT_a183_postPORExcessiveAh m183 : 21|1@1+ (1,0) [0|0] "" Vector__XXX
 SG_ VCFRONT_a191_reverseBatteryEFuse m191 : 21|1@1+ (1,0) [0|0] "" Vector__XXX
 SG_ VCFRONT_a192_notEnoughPowerForSu m192 : 21|1@1+ (1,0) [0|0] "" Vector__XXX
 SG_ VCFRONT_a216_vcleftFastBlowDebou m216 : 21|1@1+ (1,0) [0|0] "" Vector__XXX
 SG_ VCFRONT_a221_overTemperature m221 : 21|1@1+ (1,0) [0|0] "" Vector__XXX
 SG_ VCFRONT_a222_overTemperature m222 : 21|1@1+ (1,0) [0|0] "" Vector__XXX
 SG_ VCFRONT_a271_prechargeLVLoadRedu m271 : 21|1@1+ (1,0) [0|0] "" Vector__XXX
 SG_ VCFRONT_a274_prechargeLVLoadRedu m274 : 21|1@1+ (1,0) [0|0] "" Vector__XXX
 SG_ VCFRONT_a275_bmbCommStatusTypeA m275 : 21|2@1+ (1,0) [0|0] "" Vector__XXX
 SG_ VCFRONT_a276_bmbCommStatusTypeA m276 : 21|2@1+ (1,0) [0|0] "" Vector__XXX
 SG_ VCFRONT_a284_driverThermShutdown m284 : 21|1@1+ (1,0) [0|0] "" Vector__XXX
 SG_ VCFRONT_a285_driverThermShutdown m285 : 21|1@1+ (1,0) [0|0] "" Vector__XXX
 SG_ VCFRONT_a286_driverThermShutdown m286 : 21|1@1+ (1,0) [0|0] "" Vector__XXX
 SG_ VCFRONT_a287_driverThermShutdown m287 : 21|1@1+ (1,0) [0|0] "" Vector__XXX
 SG_ VCFRONT_a288_driverThermShutdown m288 : 21|1@1+ (1,0) [0|0] "" Vector__XXX
 SG_ VCFRONT_a289_driverThermShutdown m289 : 21|1@1+ (1,0) [0|0] "" Vector__XXX
 SG_ VCFRONT_a290_overTemperature m290 : 21|1@1+ (1,0) [0|0] "" Vector__XXX
 SG_ VCFRONT_a291_overTemperature m291 : 21|1@1+ (1,0) [0|0] "" Vector__XXX
 SG_ VCFRONT_a292_overTemperature m292 : 21|1@1+ (1,0) [0|0] "" Vector__XXX
 SG_ VCFRONT_a293_overTemperature m293 : 21|1@1+ (1,0) [0|0] "" Vector__XXX
 SG_ VCFRONT_a294_overTemperature m294 : 21|1@1+ (1,0) [0|0] "" Vector__XXX
 SG_ VCFRONT_a295_overTemperature m295 : 21|1@1+ (1,0) [0|0] "" Vector__XXX
 SG_ VCFRONT_a371_prechargeLVLoadRedu m371 : 21|1@1+ (1,0) [0|0] "" Vector__XXX
 SG_ VCFRONT_a380_driverOpenLoad m380 : 21|1@1+ (1,0) [0|0] "" Vector__XXX
 SG_ VCFRONT_a381_driverOpenLoad m381 : 21|1@1+ (1,0) [0|0] "" Vector__XXX
 SG_ VCFRONT_a382_driverOpenLoad m382 : 21|1@1+ (1,0) [0|0] "" Vector__XXX
 SG_ VCFRONT_a383_driverOpenLoad m383 : 21|1@1+ (1,0) [0|0] "" Vector__XXX
 SG_ VCFRONT_a384_driverOpenLoad m384 : 21|1@1+ (1,0) [0|0] "" Vector__XXX
 SG_ VCFRONT_a385_driverOpenLoad m385 : 21|1@1+ (1,0) [0|0] "" Vector__XXX
 SG_ VCFRONT_a386_driverOpenLoad m386 : 21|1@1+ (1,0) [0|0] "" Vector__XXX
 SG_ VCFRONT_a391_switch1VoltageAvera m391 : 21|10@1+ (5,0) [0|0] "" Vector__XXX
 SG_ VCFRONT_a446_compStandbyLowAmbie m446 : 21|1@1+ (1,0) [0|0] "" Vector__XXX
 SG_ VCFRONT_a447_scavengeLoopComprom m447 : 21|1@1+ (1,0) [0|0] "" Vector__XXX
 SG_ VCFRONT_a462_ModuleOTLevel1 m462 : 21|1@1+ (1,0) [0|0] "" Vector__XXX
 SG_ VCFRONT_a463_switch1VoltageAvera m463 : 21|10@1+ (5,0) [0|0] "" Vector__XXX
 SG_ VCFRONT_a476_FRM6_timedOut m476 : 21|1@1+ (1,0) [0|0] "" Vector__XXX
 SG_ VCFRONT_a478_vehiclePowerState m478 : 21|2@1+ (1,0) [0|0] "" Vector__XXX
 SG_ VCFRONT_a479_transportMode m479 : 21|1@1+ (1,0) [0|0] "" Vector__XXX
 SG_ VCFRONT_a480_autoOn m480 : 21|1@1+ (1,0) [0|0] "" Vector__XXX
 SG_ VCFRONT_a489_CCREXV m489 : 21|1@1+ (1,0) [0|0] "" Vector__XXX
 SG_ VCFRONT_a495_DCDCOff m495 : 21|1@1+ (1,0) [0|0] "" Vector__XXX
 SG_ VCFRONT_a496_frunkOpen m496 : 21|1@1+ (1,0) [0|0] "" Vector__XXX
 SG_ VCFRONT_a507_pitchEstimateValid m507 : 21|1@1+ (1,0) [0|0] "" Vector__XXX
 SG_ VCFRONT_a524_pitchEstimateValid m524 : 21|1@1+ (1,0) [0|0] "" Vector__XXX
 SG_ VCFRONT_a548_DI_gear m548 : 21|3@1+ (1,0) [0|0] "" Vector__XXX
 SG_ VCFRONT_a560_highSHCabinHeating m560 : 21|1@1+ (1,0) [0|0] "" Vector__XXX
 SG_ VCFRONT_a561_packTemperature m561 : 21|5@1+ (4,0) [0|0] "" Vector__XXX
 SG_ VCFRONT_a562_packTemperature m562 : 21|5@1+ (4,0) [0|0] "" Vector__XXX
 SG_ VCFRONT_a565_frontDriverDoorOpen m565 : 21|1@1+ (1,0) [0|0] "" Vector__XXX
 SG_ VCFRONT_a587_vehiclePowerState m587 : 21|2@1+ (1,0) [0|0] "" Vector__XXX
 SG_ VCFRONT_a606_chillerExitCoolantT m606 : 21|1@1+ (1,0) [0|0] "" Vector__XXX
 SG_ VCFRONT_a614_battPumpRpm m614 : 21|1@1+ (1,0) [0|0] "" Vector__XXX
 SG_ VCFRONT_a635_hvsBusAwake m635 : 21|1@1+ (1,0) [0|0] "" Vector__XXX
 SG_ VCFRONT_a669_vehiclePowerState m669 : 21|2@1+ (1,0) [0|0] "" Vector__XXX
 SG_ VCFRONT_a004_DASBendAngleMsgMIA m4 : 20|1@1+ (1,0) [0|0] "" Vector__XXX
 SG_ VCFRONT_a005_faults0 m5 : 20|12@1+ (1,0) [0|0] "" Vector__XXX
 SG_ VCFRONT_a006_fault m6 : 20|4@1+ (1,0) [0|0] "" Vector__XXX
 SG_ VCFRONT_a008_DASBendAngleMsgMIA m8 : 20|1@1+ (1,0) [0|0] "" Vector__XXX
 SG_ VCFRONT_a012_DebugReset m12 : 20|1@1+ (1,0) [0|0] "" Vector__XXX
 SG_ VCFRONT_a021_Task10msStarved m21 : 20|1@1+ (1,0) [0|0] "" Vector__XXX
 SG_ VCFRONT_a038_userExecute m38 : 20|1@1+ (1,0) [0|0] "" Vector__XXX
 SG_ VCFRONT_a047_SysReset m47 : 20|1@1+ (1,0) [0|0] "" Vector__XXX
 SG_ VCFRONT_a086_VEH_LVPowerState m86 : 20|1@1+ (1,0) [0|0] "" Vector__XXX
 SG_ VCFRONT_a087_PARTY_torque m87 : 20|1@1+ (1,0) [0|0] "" Vector__XXX
 SG_ VCFRONT_a088_PARTY_torque m88 : 20|1@1+ (1,0) [0|0] "" Vector__XXX
 SG_ VCFRONT_a089_BDY_status m89 : 20|1@1+ (1,0) [0|0] "" Vector__XXX
 SG_ VCFRONT_a098_VEH_temperature m98 : 20|1@1+ (1,0) [0|0] "" Vector__XXX
 SG_ VCFRONT_a100_OBD m100 : 20|1@1+ (1,0) [0|0] "" Vector__XXX
 SG_ VCFRONT_a101_BDY_locState m101 : 20|1@1+ (1,0) [0|0] "" Vector__XXX
 SG_ VCFRONT_a103_PT_status m103 : 20|1@1+ (1,0) [0|0] "" Vector__XXX
 SG_ VCFRONT_a104_BDY_bodyControls3 m104 : 20|1@1+ (1,0) [0|0] "" Vector__XXX
 SG_ VCFRONT_a106_CH_alertMatrix m106 : 20|1@1+ (1,0) [0|0] "" Vector__XXX
 SG_ VCFRONT_a107_VEH_bmbMinMax m107 : 20|1@1+ (1,0) [0|0] "" Vector__XXX
 SG_ VCFRONT_a108_VEH_status m108 : 20|1@1+ (1,0) [0|0] "" Vector__XXX
 SG_ VCFRONT_a109_VEH_status m109 : 20|1@1+ (1,0) [0|0] "" Vector__XXX
 SG_ VCFRONT_a110_VEH_updateStatus m110 : 20|1@1+ (1,0) [0|0] "" Vector__XXX
 SG_ VCFRONT_a111_RIPC_epbPrivateStat m111 : 20|1@1+ (1,0) [0|0] "" Vector__XXX
 SG_ VCFRONT_a112_LIPC_epbPrivateStat m112 : 20|1@1+ (1,0) [0|0] "" Vector__XXX
 SG_ VCFRONT_a113_VEH_vehicleControl2 m113 : 20|1@1+ (1,0) [0|0] "" Vector__XXX
 SG_ VCFRONT_a114_PARTY_party3 m114 : 20|1@1+ (1,0) [0|0] "" Vector__XXX
 SG_ VCFRONT_a115_VEH_requests2 m115 : 20|1@1+ (1,0) [0|0] "" Vector__XXX
 SG_ VCFRONT_a116_VEH_LVPowerState m116 : 20|1@1+ (1,0) [0|0] "" Vector__XXX
 SG_ VCFRONT_a117_VEH_vehNm m117 : 20|1@1+ (1,0) [0|0] "" Vector__XXX
 SG_ VCFRONT_a118_VEH_okToUseHighPwr m118 : 20|1@1+ (1,0) [0|0] "" Vector__XXX
 SG_ VCFRONT_a119_CH_steerAngle m119 : 20|1@1+ (1,0) [0|0] "" Vector__XXX
 SG_ VCFRONT_a120_PARTY_torque m120 : 20|1@1+ (1,0) [0|0] "" Vector__XXX
 SG_ VCFRONT_a122_vccUnderVoltage m122 : 20|1@1+ (1,0) [0|0] "" Vector__XXX
 SG_ VCFRONT_a124_vccUnderVoltage m124 : 20|1@1+ (1,0) [0|0] "" Vector__XXX
 SG_ VCFRONT_a126_vccUnderVoltage m126 : 20|1@1+ (1,0) [0|0] "" Vector__XXX
 SG_ VCFRONT_a142_driverThermWarn m142 : 20|1@1+ (1,0) [0|0] "" Vector__XXX
 SG_ VCFRONT_a143_thOverTemperature m143 : 20|1@1+ (1,0) [0|0] "" Vector__XXX
 SG_ VCFRONT_a144_thOverTemperature m144 : 20|1@1+ (1,0) [0|0] "" Vector__XXX
 SG_ VCFRONT_a145_thOverTemperature m145 : 20|1@1+ (1,0) [0|0] "" Vector__XXX
 SG_ VCFRONT_a153_steeringWheelButton m153 : 20|1@1+ (1,0) [0|0] "" Vector__XXX
 SG_ VCFRONT_a160_faultSnsDischPress m160 : 20|1@1+ (1,0) [0|0] "" Vector__XXX
 SG_ VCFRONT_a161_overTemperature m161 : 20|1@1+ (1,0) [0|0] "" Vector__XXX
 SG_ VCFRONT_a171_BMS m171 : 20|1@1+ (1,0) [0|0] "" Vector__XXX
 SG_ VCFRONT_a182_shortedCell m182 : 20|1@1+ (1,0) [0|0] "" Vector__XXX
 SG_ VCFRONT_a183_shortedCell m183 : 20|1@1+ (1,0) [0|0] "" Vector__XXX
 SG_ VCFRONT_a196_vehiclePowerState m196 : 20|2@1+ (1,0) [0|0] "" Vector__XXX
 SG_ VCFRONT_a216_vcleftFastBlowImmin m216 : 20|1@1+ (1,0) [0|0] "" Vector__XXX
 SG_ VCFRONT_a221_overCurrent m221 : 20|1@1+ (1,0) [0|0] "" Vector__XXX
 SG_ VCFRONT_a222_overCurrent m222 : 20|1@1+ (1,0) [0|0] "" Vector__XXX
 SG_ VCFRONT_a237_watchdogTimeout m237 : 20|1@1+ (1,0) [0|0] "" Vector__XXX
 SG_ VCFRONT_a238_watchdogTimeout m238 : 20|1@1+ (1,0) [0|0] "" Vector__XXX
 SG_ VCFRONT_a239_watchdogTimeout m239 : 20|1@1+ (1,0) [0|0] "" Vector__XXX
 SG_ VCFRONT_a240_cabinHeatASCompromi m240 : 20|1@1+ (1,0) [0|0] "" Vector__XXX
 SG_ VCFRONT_a250_calibratedVerticalP m250 : 20|10@1+ (1,0) [0|0] "" Vector__XXX
 SG_ VCFRONT_a259_minVoltageReached m259 : 20|12@1+ (0.005443676098,0) [0|0] "" Vector__XXX
 SG_ VCFRONT_a271_dcrMilliOhmsAboveTh m271 : 20|1@1+ (1,0) [0|0] "" Vector__XXX
 SG_ VCFRONT_a274_dcrMilliOhmsAboveTh m274 : 20|1@1+ (1,0) [0|0] "" Vector__XXX
 SG_ VCFRONT_a284_driverThermWarn m284 : 20|1@1+ (1,0) [0|0] "" Vector__XXX
 SG_ VCFRONT_a285_driverThermWarn m285 : 20|1@1+ (1,0) [0|0] "" Vector__XXX
 SG_ VCFRONT_a286_driverThermWarn m286 : 20|1@1+ (1,0) [0|0] "" Vector__XXX
 SG_ VCFRONT_a287_driverThermWarn m287 : 20|1@1+ (1,0) [0|0] "" Vector__XXX
 SG_ VCFRONT_a288_driverThermWarn m288 : 20|1@1+ (1,0) [0|0] "" Vector__XXX
 SG_ VCFRONT_a289_driverThermWarn m289 : 20|1@1+ (1,0) [0|0] "" Vector__XXX
 SG_ VCFRONT_a290_overCurrent m290 : 20|1@1+ (1,0) [0|0] "" Vector__XXX
 SG_ VCFRONT_a291_overCurrent m291 : 20|1@1+ (1,0) [0|0] "" Vector__XXX
 SG_ VCFRONT_a292_overCurrent m292 : 20|1@1+ (1,0) [0|0] "" Vector__XXX
 SG_ VCFRONT_a293_overCurrent m293 : 20|1@1+ (1,0) [0|0] "" Vector__XXX
 SG_ VCFRONT_a294_overCurrent m294 : 20|1@1+ (1,0) [0|0] "" Vector__XXX
 SG_ VCFRONT_a295_overCurrent m295 : 20|1@1+ (1,0) [0|0] "" Vector__XXX
 SG_ VCFRONT_a356_refCommissionStatus m356 : 20|1@1+ (1,0) [0|0] "" Vector__XXX
 SG_ VCFRONT_a364_newHeaterType m364 : 20|3@1+ (1,0) [0|0] "" Vector__XXX
 SG_ VCFRONT_a365_exitingState m365 : 20|3@1+ (1,0) [0|0] "" Vector__XXX
 SG_ VCFRONT_a368_exitingState m368 : 20|3@1+ (1,0) [0|0] "" Vector__XXX
 SG_ VCFRONT_a371_dcrMilliOhmsAboveTh m371 : 20|1@1+ (1,0) [0|0] "" Vector__XXX
 SG_ VCFRONT_a378_wiperOvertemperatur m378 : 20|2@1+ (1,0) [0|0] "" Vector__XXX
 SG_ VCFRONT_a380_driverStagnantFeedb m380 : 20|1@1+ (1,0) [0|0] "" Vector__XXX
 SG_ VCFRONT_a381_driverStagnantFeedb m381 : 20|1@1+ (1,0) [0|0] "" Vector__XXX
 SG_ VCFRONT_a382_driverStagnantFeedb m382 : 20|1@1+ (1,0) [0|0] "" Vector__XXX
 SG_ VCFRONT_a383_driverStagnantFeedb m383 : 20|1@1+ (1,0) [0|0] "" Vector__XXX
 SG_ VCFRONT_a384_driverStagnantFeedb m384 : 20|1@1+ (1,0) [0|0] "" Vector__XXX
 SG_ VCFRONT_a385_driverStagnantFeedb m385 : 20|1@1+ (1,0) [0|0] "" Vector__XXX
 SG_ VCFRONT_a386_driverStagnantFeedb m386 : 20|1@1+ (1,0) [0|0] "" Vector__XXX
 SG_ VCFRONT_a390_highSideHX m390 : 20|2@1+ (1,0) [0|0] "" Vector__XXX
 SG_ VCFRONT_a391_switch2Disconnected m391 : 20|1@1+ (1,0) [0|0] "" Vector__XXX
 SG_ VCFRONT_a429_depthOfDischarge m429 : 20|10@1+ (0.1,-0.1) [0|0] "" Vector__XXX
 SG_ VCFRONT_a443_maxDieTemp m443 : 20|10@1+ (0.2,-20) [0|0] "" Vector__XXX
 SG_ VCFRONT_a446_compFaultPsLow m446 : 20|1@1+ (1,0) [0|0] "" Vector__XXX
 SG_ VCFRONT_a447_ambientSourcingComp m447 : 20|1@1+ (1,0) [0|0] "" Vector__XXX
 SG_ VCFRONT_a462_CellUVLevel2 m462 : 20|1@1+ (1,0) [0|0] "" Vector__XXX
 SG_ VCFRONT_a463_switch2Disconnected m463 : 20|1@1+ (1,0) [0|0] "" Vector__XXX
 SG_ VCFRONT_a474_ssl100Bank3Status m474 : 20|2@1+ (1,0) [0|0] "" Vector__XXX
 SG_ VCFRONT_a475_ssl100Bank3Status m475 : 20|2@1+ (1,0) [0|0] "" Vector__XXX
 SG_ VCFRONT_a476_FRM5_timedOut m476 : 20|1@1+ (1,0) [0|0] "" Vector__XXX
 SG_ VCFRONT_a478_battFaultCellOverVo m478 : 20|1@1+ (1,0) [0|0] "" Vector__XXX
 SG_ VCFRONT_a479_serviceMode m479 : 20|1@1+ (1,0) [0|0] "" Vector__XXX
 SG_ VCFRONT_a480_spiError m480 : 20|1@1+ (1,0) [0|0] "" Vector__XXX
 SG_ VCFRONT_a489_CCLEXV m489 : 20|1@1+ (1,0) [0|0] "" Vector__XXX
 SG_ VCFRONT_a495_reverseBatteryEFuse m495 : 20|1@1+ (1,0) [0|0] "" Vector__XXX
 SG_ VCFRONT_a496_serviceMode m496 : 20|1@1+ (1,0) [0|0] "" Vector__XXX
 SG_ VCFRONT_a507_useVirtualPitchSens m507 : 20|1@1+ (1,0) [0|0] "" Vector__XXX
 SG_ VCFRONT_a524_useVirtualPitchSens m524 : 20|1@1+ (1,0) [0|0] "" Vector__XXX
 SG_ VCFRONT_a528_frunkOpen m528 : 20|1@1+ (1,0) [0|0] "" Vector__XXX
 SG_ VCFRONT_a548_LVBatteryCannotSupp m548 : 20|1@1+ (1,0) [0|0] "" Vector__XXX
 SG_ VCFRONT_a552_epas3pSelfTestResul m552 : 20|4@1+ (1,0) [0|0] "" Vector__XXX
 SG_ VCFRONT_a556_vehiclePowerState m556 : 20|2@1+ (1,0) [0|0] "" Vector__XXX
 SG_ VCFRONT_a560_highSHCabinCooling m560 : 20|1@1+ (1,0) [0|0] "" Vector__XXX
 SG_ VCFRONT_a565_steeringWheelButton m565 : 20|1@1+ (1,0) [0|0] "" Vector__XXX
 SG_ VCFRONT_a583_shadowSwitchGr_0000 m583 : 20|2@1+ (1,0) [0|0] "" Vector__XXX
 SG_ VCFRONT_a584_frunkSwitchGroupReq m584 : 20|2@1+ (1,0) [0|0] "" Vector__XXX
 SG_ VCFRONT_a587_LVBMS_packCurrent_v m587 : 20|1@1+ (1,0) [0|0] "" Vector__XXX
 SG_ VCFRONT_a595_vehiclePowerState m595 : 20|2@1+ (1,0) [0|0] "" Vector__XXX
 SG_ VCFRONT_a600_vehiclePowerState m600 : 20|2@1+ (1,0) [0|0] "" Vector__XXX
 SG_ VCFRONT_a606_coolantTempTooHigh m606 : 20|1@1+ (1,0) [0|0] "" Vector__XXX
 SG_ VCFRONT_a610_dataBufferBits m610 : 20|10@1+ (1,0) [0|0] "" Vector__XXX
 SG_ VCFRONT_a612_vehicleSpeed m612 : 20|12@1+ (0.08,-40) [0|0] "" Vector__XXX
 SG_ VCFRONT_a614_octovalveFaulted m614 : 20|1@1+ (1,0) [0|0] "" Vector__XXX
 SG_ VCFRONT_a619_switchTransitionTim m619 : 20|12@1+ (1,0) [0|0] "" Vector__XXX
 SG_ VCFRONT_a623_vehicleSpeed m623 : 20|12@1+ (0.08,-40) [0|0] "" Vector__XXX
 SG_ VCFRONT_a635_chBusAwake m635 : 20|1@1+ (1,0) [0|0] "" Vector__XXX
 SG_ VCFRONT_a644_washPumpHealthState m644 : 20|3@1+ (1,0) [0|0] "" Vector__XXX
 SG_ VCFRONT_a665_retryCount m665 : 20|3@1+ (1,0) [0|0] "" Vector__XXX
 SG_ VCFRONT_a666_retryCount m666 : 20|3@1+ (1,0) [0|0] "" Vector__XXX
 SG_ VCFRONT_a669_defrostEnabled m669 : 20|1@1+ (1,0) [0|0] "" Vector__XXX
 SG_ VCFRONT_a004_DASMatrixColumnMsgM m4 : 19|1@1+ (1,0) [0|0] "" Vector__XXX
 SG_ VCFRONT_a008_DASMatrixColumnMsgM m8 : 19|1@1+ (1,0) [0|0] "" Vector__XXX
 SG_ VCFRONT_a012_CheckstopReset m12 : 19|1@1+ (1,0) [0|0] "" Vector__XXX
 SG_ VCFRONT_a021_Task10msLate m21 : 19|1@1+ (1,0) [0|0] "" Vector__XXX
 SG_ VCFRONT_a032_corePowerMode m32 : 19|2@1+ (1,0) [0|0] "" Vector__XXX
 SG_ VCFRONT_a038_userWrite m38 : 19|1@1+ (1,0) [0|0] "" Vector__XXX
 SG_ VCFRONT_a047_TcDbgreset m47 : 19|1@1+ (1,0) [0|0] "" Vector__XXX
 SG_ VCFRONT_a082_RIPC_remoteMux m82 : 19|1@1+ (1,0) [0|0] "" Vector__XXX
 SG_ VCFRONT_a083_LIPC_HSDFaults m83 : 19|1@1+ (1,0) [0|0] "" Vector__XXX
 SG_ VCFRONT_a086_VEH_12VBatteryStatu m86 : 19|1@1+ (1,0) [0|0] "" Vector__XXX
 SG_ VCFRONT_a087_VEH_status m87 : 19|1@1+ (1,0) [0|0] "" Vector__XXX
 SG_ VCFRONT_a088_VEH_status m88 : 19|1@1+ (1,0) [0|0] "" Vector__XXX
 SG_ VCFRONT_a089_BDY_party1 m89 : 19|1@1+ (1,0) [0|0] "" Vector__XXX
 SG_ VCFRONT_a090_CH_eacMonitor m90 : 19|1@1+ (1,0) [0|0] "" Vector__XXX
 SG_ VCFRONT_a092_VEH_vehNm m92 : 19|1@1+ (1,0) [0|0] "" Vector__XXX
 SG_ VCFRONT_a093_VEH_vehNm m93 : 19|1@1+ (1,0) [0|0] "" Vector__XXX
 SG_ VCFRONT_a098_VEH_thermalControl m98 : 19|1@1+ (1,0) [0|0] "" Vector__XXX
 SG_ VCFRONT_a100_CH m100 : 19|1@1+ (1,0) [0|0] "" Vector__XXX
 SG_ VCFRONT_a101_VEH_locState m101 : 19|1@1+ (1,0) [0|0] "" Vector__XXX
 SG_ VCFRONT_a102_VEH_rods m102 : 19|1@1+ (1,0) [0|0] "" Vector__XXX
 SG_ VCFRONT_a103_PT_ptNm m103 : 19|1@1+ (1,0) [0|0] "" Vector__XXX
 SG_ VCFRONT_a104_VEH_bodyControls3 m104 : 19|1@1+ (1,0) [0|0] "" Vector__XXX
 SG_ VCFRONT_a106_CH_dcdcRailStatus m106 : 19|1@1+ (1,0) [0|0] "" Vector__XXX
 SG_ VCFRONT_a107_VEH_thermalStatus m107 : 19|1@1+ (1,0) [0|0] "" Vector__XXX
 SG_ VCFRONT_a108_VEH_torque m108 : 19|1@1+ (1,0) [0|0] "" Vector__XXX
 SG_ VCFRONT_a109_PARTY_collision m109 : 19|1@1+ (1,0) [0|0] "" Vector__XXX
 SG_ VCFRONT_a110_VEH_time m110 : 19|1@1+ (1,0) [0|0] "" Vector__XXX
 SG_ VCFRONT_a111_RIPC_LVPowerState m111 : 19|1@1+ (1,0) [0|0] "" Vector__XXX
 SG_ VCFRONT_a112_LIPC_LVPowerState m112 : 19|1@1+ (1,0) [0|0] "" Vector__XXX
 SG_ VCFRONT_a113_VEH_vehicleControl m113 : 19|1@1+ (1,0) [0|0] "" Vector__XXX
 SG_ VCFRONT_a114_CH_wheelSpeeds m114 : 19|1@1+ (1,0) [0|0] "" Vector__XXX
 SG_ VCFRONT_a115_VEH_requests m115 : 19|1@1+ (1,0) [0|0] "" Vector__XXX
 SG_ VCFRONT_a116_VEH_hvacStatus m116 : 19|1@1+ (1,0) [0|0] "" Vector__XXX
 SG_ VCFRONT_a117_PARTY_epbmStatus m117 : 19|1@1+ (1,0) [0|0] "" Vector__XXX
 SG_ VCFRONT_a118_VEH_status m118 : 19|1@1+ (1,0) [0|0] "" Vector__XXX
 SG_ VCFRONT_a119_PARTY_rightStalk m119 : 19|1@1+ (1,0) [0|0] "" Vector__XXX
 SG_ VCFRONT_a120_PARTY_systemStatus m120 : 19|1@1+ (1,0) [0|0] "" Vector__XXX
 SG_ VCFRONT_a122_lossOfSpeedLock m122 : 19|1@1+ (1,0) [0|0] "" Vector__XXX
 SG_ VCFRONT_a124_lossOfSpeedLock m124 : 19|1@1+ (1,0) [0|0] "" Vector__XXX
 SG_ VCFRONT_a126_lossOfSpeedLock m126 : 19|1@1+ (1,0) [0|0] "" Vector__XXX
 SG_ VCFRONT_a136_snsRateChangeDown m136 : 19|1@1+ (1,0) [0|0] "" Vector__XXX
 SG_ VCFRONT_a137_snsRateChangeDown m137 : 19|1@1+ (1,0) [0|0] "" Vector__XXX
 SG_ VCFRONT_a138_snsRateChangeDown m138 : 19|1@1+ (1,0) [0|0] "" Vector__XXX
 SG_ VCFRONT_a139_snsRateChangeDown m139 : 19|1@1+ (1,0) [0|0] "" Vector__XXX
 SG_ VCFRONT_a140_snsRateChangeDown m140 : 19|1@1+ (1,0) [0|0] "" Vector__XXX
 SG_ VCFRONT_a141_snsRateChangeDown m141 : 19|1@1+ (1,0) [0|0] "" Vector__XXX
 SG_ VCFRONT_a143_vglUnderVoltage m143 : 19|1@1+ (1,0) [0|0] "" Vector__XXX
 SG_ VCFRONT_a144_vglUnderVoltage m144 : 19|1@1+ (1,0) [0|0] "" Vector__XXX
 SG_ VCFRONT_a145_vglUnderVoltage m145 : 19|1@1+ (1,0) [0|0] "" Vector__XXX
 SG_ VCFRONT_a153_inDriveState m153 : 19|1@1+ (1,0) [0|0] "" Vector__XXX
 SG_ VCFRONT_a160_lowSuctionPressure m160 : 19|1@1+ (1,0) [0|0] "" Vector__XXX
 SG_ VCFRONT_a161_overCurrent m161 : 19|1@1+ (1,0) [0|0] "" Vector__XXX
 SG_ VCFRONT_a171_VCBATT m171 : 19|1@1+ (1,0) [0|0] "" Vector__XXX
 SG_ VCFRONT_a175_snsRateChangeDown m175 : 19|1@1+ (1,0) [0|0] "" Vector__XXX
 SG_ VCFRONT_a178_compressorState m178 : 19|2@1+ (1,0) [0|0] "" Vector__XXX
 SG_ VCFRONT_a182_LVFloorReached m182 : 19|1@1+ (1,0) [0|0] "" Vector__XXX
 SG_ VCFRONT_a183_LVFloorReached m183 : 19|1@1+ (1,0) [0|0] "" Vector__XXX
 SG_ VCFRONT_a196_frunkOpen m196 : 19|1@1+ (1,0) [0|0] "" Vector__XXX
 SG_ VCFRONT_a221_underCurrent m221 : 19|1@1+ (1,0) [0|0] "" Vector__XXX
 SG_ VCFRONT_a222_underCurrent m222 : 19|1@1+ (1,0) [0|0] "" Vector__XXX
 SG_ VCFRONT_a237_pwmOutputFault m237 : 19|1@1+ (1,0) [0|0] "" Vector__XXX
 SG_ VCFRONT_a238_pwmOutputFault m238 : 19|1@1+ (1,0) [0|0] "" Vector__XXX
 SG_ VCFRONT_a239_pwmOutputFault m239 : 19|1@1+ (1,0) [0|0] "" Vector__XXX
 SG_ VCFRONT_a240_lowPsCutoutAS m240 : 19|1@1+ (1,0) [0|0] "" Vector__XXX
 SG_ VCFRONT_a250_isAimedHCMR m250 : 19|1@1+ (1,0) [0|0] "" Vector__XXX
 SG_ VCFRONT_a271_resistanceEstimatio m271 : 19|1@1+ (1,0) [0|0] "" Vector__XXX
 SG_ VCFRONT_a274_resistanceEstimatio m274 : 19|1@1+ (1,0) [0|0] "" Vector__XXX
 SG_ VCFRONT_a279_snsRateChangeDown m279 : 19|1@1+ (1,0) [0|0] "" Vector__XXX
 SG_ VCFRONT_a280_snsRateChangeDown m280 : 19|1@1+ (1,0) [0|0] "" Vector__XXX
 SG_ VCFRONT_a290_underCurrent m290 : 19|1@1+ (1,0) [0|0] "" Vector__XXX
 SG_ VCFRONT_a291_underCurrent m291 : 19|1@1+ (1,0) [0|0] "" Vector__XXX
 SG_ VCFRONT_a292_underCurrent m292 : 19|1@1+ (1,0) [0|0] "" Vector__XXX
 SG_ VCFRONT_a293_underCurrent m293 : 19|1@1+ (1,0) [0|0] "" Vector__XXX
 SG_ VCFRONT_a294_underCurrent m294 : 19|1@1+ (1,0) [0|0] "" Vector__XXX
 SG_ VCFRONT_a295_underCurrent m295 : 19|1@1+ (1,0) [0|0] "" Vector__XXX
 SG_ VCFRONT_a299_writeFailed m299 : 19|1@1+ (1,0) [0|0] "" Vector__XXX
 SG_ VCFRONT_a355_factoryGated m355 : 19|1@1+ (1,0) [0|0] "" Vector__XXX
 SG_ VCFRONT_a356_factoryGated m356 : 19|1@1+ (1,0) [0|0] "" Vector__XXX
 SG_ VCFRONT_a366_exitingState m366 : 19|3@1+ (1,0) [0|0] "" Vector__XXX
 SG_ VCFRONT_a371_resistanceEstimatio m371 : 19|1@1+ (1,0) [0|0] "" Vector__XXX
 SG_ VCFRONT_a378_wiperFault m378 : 19|1@1+ (1,0) [0|0] "" Vector__XXX
 SG_ VCFRONT_a387_minVoltageReached m387 : 19|12@1+ (0.005443676098,0) [0|0] "" Vector__XXX
 SG_ VCFRONT_a388_minVoltageReached m388 : 19|12@1+ (0.005443676098,0) [0|0] "" Vector__XXX
 SG_ VCFRONT_a389_vehicleSpeed m389 : 19|12@1+ (0.08,-40) [0|0] "" Vector__XXX
 SG_ VCFRONT_a391_switch2Shorted m391 : 19|1@1+ (1,0) [0|0] "" Vector__XXX
 SG_ VCFRONT_a394_offsetError m394 : 19|10@1- (0.05,0) [0|0] "" Vector__XXX
 SG_ VCFRONT_a397_offsetError m397 : 19|10@1- (0.2,0) [0|0] "" Vector__XXX
 SG_ VCFRONT_a421_leftHeadlampCurrent m421 : 19|10@1+ (0.027,0) [0|0] "" Vector__XXX
 SG_ VCFRONT_a446_compFaultPdHigh m446 : 19|1@1+ (1,0) [0|0] "" Vector__XXX
 SG_ VCFRONT_a447_coolantValveComprom m447 : 19|1@1+ (1,0) [0|0] "" Vector__XXX
 SG_ VCFRONT_a462_CellUVLevel1 m462 : 19|1@1+ (1,0) [0|0] "" Vector__XXX
 SG_ VCFRONT_a463_switch2Shorted m463 : 19|1@1+ (1,0) [0|0] "" Vector__XXX
 SG_ VCFRONT_a476_FRM4_timedOut m476 : 19|1@1+ (1,0) [0|0] "" Vector__XXX
 SG_ VCFRONT_a478_battFaultCellUnderV m478 : 19|1@1+ (1,0) [0|0] "" Vector__XXX
 SG_ VCFRONT_a479_factoryMode m479 : 19|1@1+ (1,0) [0|0] "" Vector__XXX
 SG_ VCFRONT_a480_reset m480 : 19|1@1+ (1,0) [0|0] "" Vector__XXX
 SG_ VCFRONT_a483_currentMovementStat m483 : 19|4@1+ (1,0) [0|0] "" Vector__XXX
 SG_ VCFRONT_a488_currentMovementStat m488 : 19|4@1+ (1,0) [0|0] "" Vector__XXX
 SG_ VCFRONT_a489_LCCEXV m489 : 19|1@1+ (1,0) [0|0] "" Vector__XXX
 SG_ VCFRONT_a495_LVBMSMIA m495 : 19|1@1+ (1,0) [0|0] "" Vector__XXX
 SG_ VCFRONT_a507_useRideHeightSensor m507 : 19|1@1+ (1,0) [0|0] "" Vector__XXX
 SG_ VCFRONT_a524_useRideHeightSensor m524 : 19|1@1+ (1,0) [0|0] "" Vector__XXX
 SG_ VCFRONT_a525_newLVBatteryType m525 : 19|3@1+ (1,0) [0|0] "" Vector__XXX
 SG_ VCFRONT_a528_serviceMode m528 : 19|1@1+ (1,0) [0|0] "" Vector__XXX
 SG_ VCFRONT_a545_newLVBatteryType m545 : 19|3@1+ (1,0) [0|0] "" Vector__XXX
 SG_ VCFRONT_a548_HVBlockingMismatch m548 : 19|1@1+ (1,0) [0|0] "" Vector__XXX
 SG_ VCFRONT_a556_frunkOpen m556 : 19|1@1+ (1,0) [0|0] "" Vector__XXX
 SG_ VCFRONT_a560_highSHCabinReheatHD m560 : 19|1@1+ (1,0) [0|0] "" Vector__XXX
 SG_ VCFRONT_a565_inDriveState m565 : 19|1@1+ (1,0) [0|0] "" Vector__XXX
 SG_ VCFRONT_a587_frunkOpen m587 : 19|1@1+ (1,0) [0|0] "" Vector__XXX
 SG_ VCFRONT_a595_frunkOpen m595 : 19|1@1+ (1,0) [0|0] "" Vector__XXX
 SG_ VCFRONT_a599_newLVBatteryType m599 : 19|3@1+ (1,0) [0|0] "" Vector__XXX
 SG_ VCFRONT_a600_frunkOpen m600 : 19|1@1+ (1,0) [0|0] "" Vector__XXX
 SG_ VCFRONT_a606_PdPsTsSHNotNominal m606 : 19|1@1+ (1,0) [0|0] "" Vector__XXX
 SG_ VCFRONT_a612_inDriverlessMode m612 : 19|1@1+ (1,0) [0|0] "" Vector__XXX
 SG_ VCFRONT_a614_octovalveNotAtTarge m614 : 19|1@1+ (1,0) [0|0] "" Vector__XXX
 SG_ VCFRONT_a623_inDriverlessMode m623 : 19|1@1+ (1,0) [0|0] "" Vector__XXX
 SG_ VCFRONT_a628_thermistorFailureRe m628 : 19|3@1+ (1,0) [0|0] "" Vector__XXX
 SG_ VCFRONT_a635_frontPrivBusAwake m635 : 19|1@1+ (1,0) [0|0] "" Vector__XXX
 SG_ VCFRONT_a643_rightHeadlampCurren m643 : 19|10@1+ (0.027,0) [0|0] "" Vector__XXX
 SG_ VCFRONT_a669_defogEnabled m669 : 19|1@1+ (1,0) [0|0] "" Vector__XXX
 SG_ VCFRONT_a004_DASAdaptiveHighBeam m4 : 18|1@1+ (1,0) [0|0] "" Vector__XXX
 SG_ VCFRONT_a008_DASAdaptiveHighBeam m8 : 18|1@1+ (1,0) [0|0] "" Vector__XXX
 SG_ VCFRONT_a012_SoftwareReset m12 : 18|1@1+ (1,0) [0|0] "" Vector__XXX
 SG_ VCFRONT_a015_NVMMRecordIDError m15 : 18|1@1+ (1,0) [0|0] "" Vector__XXX
 SG_ VCFRONT_a021_Task1msMissed m21 : 18|1@1+ (1,0) [0|0] "" Vector__XXX
 SG_ VCFRONT_a032_watchdogState m32 : 18|1@1+ (1,0) [0|0] "" Vector__XXX
 SG_ VCFRONT_a038_userRead m38 : 18|1@1+ (1,0) [0|0] "" Vector__XXX
 SG_ VCFRONT_a047_DpslpFault m47 : 18|1@1+ (1,0) [0|0] "" Vector__XXX
 SG_ VCFRONT_a082_RIPC_railStatus m82 : 18|1@1+ (1,0) [0|0] "" Vector__XXX
 SG_ VCFRONT_a083_LIPC_railStatus m83 : 18|1@1+ (1,0) [0|0] "" Vector__XXX
 SG_ VCFRONT_a086_VEH_status m86 : 18|1@1+ (1,0) [0|0] "" Vector__XXX
 SG_ VCFRONT_a087_VEH_torque m87 : 18|1@1+ (1,0) [0|0] "" Vector__XXX
 SG_ VCFRONT_a088_VEH_torque m88 : 18|1@1+ (1,0) [0|0] "" Vector__XXX
 SG_ VCFRONT_a089_VEH_status m89 : 18|1@1+ (1,0) [0|0] "" Vector__XXX
 SG_ VCFRONT_a090_PARTY_eacMonitor m90 : 18|1@1+ (1,0) [0|0] "" Vector__XXX
 SG_ VCFRONT_a091_VEH_state m91 : 18|1@1+ (1,0) [0|0] "" Vector__XXX
 SG_ VCFRONT_a092_VEH_seatStatus2 m92 : 18|1@1+ (1,0) [0|0] "" Vector__XXX
 SG_ VCFRONT_a093_VEH_seatStatus2 m93 : 18|1@1+ (1,0) [0|0] "" Vector__XXX
 SG_ VCFRONT_a098_VEH_status m98 : 18|1@1+ (1,0) [0|0] "" Vector__XXX
 SG_ VCFRONT_a100_PT m100 : 18|1@1+ (1,0) [0|0] "" Vector__XXX
 SG_ VCFRONT_a101_LIPC_externalWatchd m101 : 18|1@1+ (1,0) [0|0] "" Vector__XXX
 SG_ VCFRONT_a102_VEH_sensorStatus m102 : 18|1@1+ (1,0) [0|0] "" Vector__XXX
 SG_ VCFRONT_a103_VEH_status m103 : 18|1@1+ (1,0) [0|0] "" Vector__XXX
 SG_ VCFRONT_a104_VEH_bodyControls m104 : 18|1@1+ (1,0) [0|0] "" Vector__XXX
 SG_ VCFRONT_a105_VEH_dampingStates m105 : 18|1@1+ (1,0) [0|0] "" Vector__XXX
 SG_ VCFRONT_a106_VEH_dcdcRailStatus m106 : 18|1@1+ (1,0) [0|0] "" Vector__XXX
 SG_ VCFRONT_a107_VEH_status m107 : 18|1@1+ (1,0) [0|0] "" Vector__XXX
 SG_ VCFRONT_a108_VEH_thermalControl m108 : 18|1@1+ (1,0) [0|0] "" Vector__XXX
 SG_ VCFRONT_a109_PARTY_nearDeploy m109 : 18|1@1+ (1,0) [0|0] "" Vector__XXX
 SG_ VCFRONT_a110_VEH_carConfig m110 : 18|1@1+ (1,0) [0|0] "" Vector__XXX
 SG_ VCFRONT_a111_VEH_vehNm m111 : 18|1@1+ (1,0) [0|0] "" Vector__XXX
 SG_ VCFRONT_a112_VEH_vehNm m112 : 18|1@1+ (1,0) [0|0] "" Vector__XXX
 SG_ VCFRONT_a113_VEH_chargeRequest m113 : 18|1@1+ (1,0) [0|0] "" Vector__XXX
 SG_ VCFRONT_a114_VEH_wheelSpeeds m114 : 18|1@1+ (1,0) [0|0] "" Vector__XXX
 SG_ VCFRONT_a115_VEH_BLEResetRequest m115 : 18|1@1+ (1,0) [0|0] "" Vector__XXX
 SG_ VCFRONT_a116_VEH_hvacRequest m116 : 18|1@1+ (1,0) [0|0] "" Vector__XXX
 SG_ VCFRONT_a117_VEH_prndStatus m117 : 18|1@1+ (1,0) [0|0] "" Vector__XXX
 SG_ VCFRONT_a118_VEH_sensors m118 : 18|1@1+ (1,0) [0|0] "" Vector__XXX
 SG_ VCFRONT_a119_VEH_rightStalk m119 : 18|1@1+ (1,0) [0|0] "" Vector__XXX
 SG_ VCFRONT_a120_CH_chassisCntl m120 : 18|1@1+ (1,0) [0|0] "" Vector__XXX
 SG_ VCFRONT_a121_lockedRotor m121 : 18|1@1+ (1,0) [0|0] "" Vector__XXX
 SG_ VCFRONT_a122_startUpOperation m122 : 18|1@1+ (1,0) [0|0] "" Vector__XXX
 SG_ VCFRONT_a123_lockedRotor m123 : 18|1@1+ (1,0) [0|0] "" Vector__XXX
 SG_ VCFRONT_a124_startUpOperation m124 : 18|1@1+ (1,0) [0|0] "" Vector__XXX
 SG_ VCFRONT_a125_lockedRotor m125 : 18|1@1+ (1,0) [0|0] "" Vector__XXX
 SG_ VCFRONT_a126_startUpOperation m126 : 18|1@1+ (1,0) [0|0] "" Vector__XXX
 SG_ VCFRONT_a136_snsRateChangeUp m136 : 18|1@1+ (1,0) [0|0] "" Vector__XXX
 SG_ VCFRONT_a137_snsRateChangeUp m137 : 18|1@1+ (1,0) [0|0] "" Vector__XXX
 SG_ VCFRONT_a138_snsRateChangeUp m138 : 18|1@1+ (1,0) [0|0] "" Vector__XXX
 SG_ VCFRONT_a139_snsRateChangeUp m139 : 18|1@1+ (1,0) [0|0] "" Vector__XXX
 SG_ VCFRONT_a140_snsRateChangeUp m140 : 18|1@1+ (1,0) [0|0] "" Vector__XXX
 SG_ VCFRONT_a141_snsRateChangeUp m141 : 18|1@1+ (1,0) [0|0] "" Vector__XXX
 SG_ VCFRONT_a143_chpUnderVoltage m143 : 18|1@1+ (1,0) [0|0] "" Vector__XXX
 SG_ VCFRONT_a144_chpUnderVoltage m144 : 18|1@1+ (1,0) [0|0] "" Vector__XXX
 SG_ VCFRONT_a145_chpUnderVoltage m145 : 18|1@1+ (1,0) [0|0] "" Vector__XXX
 SG_ VCFRONT_a153_UIDisplayOnForUser m153 : 18|1@1+ (1,0) [0|0] "" Vector__XXX
 SG_ VCFRONT_a160_highDischPressure m160 : 18|1@1+ (1,0) [0|0] "" Vector__XXX
 SG_ VCFRONT_a161_HVUnderVoltage m161 : 18|1@1+ (1,0) [0|0] "" Vector__XXX
 SG_ VCFRONT_a163_compressorType m163 : 18|4@1+ (1,0) [0|0] "" Vector__XXX
 SG_ VCFRONT_a171_VCLEFT m171 : 18|1@1+ (1,0) [0|0] "" Vector__XXX
 SG_ VCFRONT_a175_snsRateChangeUp m175 : 18|1@1+ (1,0) [0|0] "" Vector__XXX
 SG_ VCFRONT_a180_hvState m180 : 18|3@1+ (1,0) [0|0] "" Vector__XXX
 SG_ VCFRONT_a182_overcharge m182 : 18|1@1+ (1,0) [0|0] "" Vector__XXX
 SG_ VCFRONT_a183_overcharge m183 : 18|1@1+ (1,0) [0|0] "" Vector__XXX
 SG_ VCFRONT_a191_hvState m191 : 18|3@1+ (1,0) [0|0] "" Vector__XXX
 SG_ VCFRONT_a192_hvState m192 : 18|3@1+ (1,0) [0|0] "" Vector__XXX
 SG_ VCFRONT_a196_transportMode m196 : 18|1@1+ (1,0) [0|0] "" Vector__XXX
 SG_ VCFRONT_a198_lockoutState m198 : 18|1@1+ (1,0) [0|0] "" Vector__XXX
 SG_ VCFRONT_a199_lockoutState m199 : 18|1@1+ (1,0) [0|0] "" Vector__XXX
 SG_ VCFRONT_a210_valveNoTravel m210 : 18|1@1+ (1,0) [0|0] "" Vector__XXX
 SG_ VCFRONT_a221_tempSenseFaulted m221 : 18|1@1+ (1,0) [0|0] "" Vector__XXX
 SG_ VCFRONT_a222_tempSenseFaulted m222 : 18|1@1+ (1,0) [0|0] "" Vector__XXX
 SG_ VCFRONT_a237_spiDiagError m237 : 18|1@1+ (1,0) [0|0] "" Vector__XXX
 SG_ VCFRONT_a238_spiDiagError m238 : 18|1@1+ (1,0) [0|0] "" Vector__XXX
 SG_ VCFRONT_a239_spiDiagError m239 : 18|1@1+ (1,0) [0|0] "" Vector__XXX
 SG_ VCFRONT_a240_lowPsCutoutScavenge m240 : 18|1@1+ (1,0) [0|0] "" Vector__XXX
 SG_ VCFRONT_a250_isAimedHCML m250 : 18|1@1+ (1,0) [0|0] "" Vector__XXX
 SG_ VCFRONT_a253_IBSCurrent m253 : 18|16@1- (0.005,0) [0|0] "" Vector__XXX
 SG_ VCFRONT_a271_deadLVMinimalAhDisc m271 : 18|1@1+ (1,0) [0|0] "" Vector__XXX
 SG_ VCFRONT_a274_deadLVMinimalAhDisc m274 : 18|1@1+ (1,0) [0|0] "" Vector__XXX
 SG_ VCFRONT_a279_snsRateChangeUp m279 : 18|1@1+ (1,0) [0|0] "" Vector__XXX
 SG_ VCFRONT_a280_snsRateChangeUp m280 : 18|1@1+ (1,0) [0|0] "" Vector__XXX
 SG_ VCFRONT_a290_tempSenseFaulted m290 : 18|1@1+ (1,0) [0|0] "" Vector__XXX
 SG_ VCFRONT_a291_tempSenseFaulted m291 : 18|1@1+ (1,0) [0|0] "" Vector__XXX
 SG_ VCFRONT_a292_tempSenseFaulted m292 : 18|1@1+ (1,0) [0|0] "" Vector__XXX
 SG_ VCFRONT_a293_tempSenseFaulted m293 : 18|1@1+ (1,0) [0|0] "" Vector__XXX
 SG_ VCFRONT_a294_tempSenseFaulted m294 : 18|1@1+ (1,0) [0|0] "" Vector__XXX
 SG_ VCFRONT_a295_tempSenseFaulted m295 : 18|1@1+ (1,0) [0|0] "" Vector__XXX
 SG_ VCFRONT_a299_unsupportedCountry m299 : 18|1@1+ (1,0) [0|0] "" Vector__XXX
 SG_ VCFRONT_a300_newType m300 : 18|2@1+ (1,0) [0|0] "" Vector__XXX
 SG_ VCFRONT_a355_serviceLockout m355 : 18|1@1+ (1,0) [0|0] "" Vector__XXX
 SG_ VCFRONT_a356_serviceLockout m356 : 18|1@1+ (1,0) [0|0] "" Vector__XXX
 SG_ VCFRONT_a371_deadLVMinimalAhDisc m371 : 18|1@1+ (1,0) [0|0] "" Vector__XXX
 SG_ VCFRONT_a389_possiblyStuckClosed m389 : 18|1@1+ (1,0) [0|0] "" Vector__XXX
 SG_ VCFRONT_a390_batteryLoadType m390 : 18|2@1+ (1,0) [0|0] "" Vector__XXX
 SG_ VCFRONT_a391_switch1Disconnected m391 : 18|1@1+ (1,0) [0|0] "" Vector__XXX
 SG_ VCFRONT_a394_liquid m394 : 18|1@1+ (1,0) [0|0] "" Vector__XXX
 SG_ VCFRONT_a397_liquid m397 : 18|1@1+ (1,0) [0|0] "" Vector__XXX
 SG_ VCFRONT_a421_frunkOpen m421 : 18|1@1+ (1,0) [0|0] "" Vector__XXX
 SG_ VCFRONT_a445_SPIFaultCount m445 : 18|2@1+ (1,0) [0|0] "" Vector__XXX
 SG_ VCFRONT_a446_compFaultPdLow m446 : 18|1@1+ (1,0) [0|0] "" Vector__XXX
 SG_ VCFRONT_a447_activeLouverComprom m447 : 18|1@1+ (1,0) [0|0] "" Vector__XXX
 SG_ VCFRONT_a462_CellOVLevel3 m462 : 18|1@1+ (1,0) [0|0] "" Vector__XXX
 SG_ VCFRONT_a463_switch1Disconnected m463 : 18|1@1+ (1,0) [0|0] "" Vector__XXX
 SG_ VCFRONT_a474_ssl100Bank2Status m474 : 18|2@1+ (1,0) [0|0] "" Vector__XXX
 SG_ VCFRONT_a475_ssl100Bank2Status m475 : 18|2@1+ (1,0) [0|0] "" Vector__XXX
 SG_ VCFRONT_a476_FRM3_timedOut m476 : 18|1@1+ (1,0) [0|0] "" Vector__XXX
 SG_ VCFRONT_a478_battFaultChargeOver m478 : 18|1@1+ (1,0) [0|0] "" Vector__XXX
 SG_ VCFRONT_a482_lastPosition m482 : 18|10@1+ (1,0) [0|0] "" Vector__XXX
 SG_ VCFRONT_a485_lastPosition m485 : 18|10@1+ (1,0) [0|0] "" Vector__XXX
 SG_ VCFRONT_a489_RecircEXV m489 : 18|1@1+ (1,0) [0|0] "" Vector__XXX
 SG_ VCFRONT_a495_retryExpended m495 : 18|1@1+ (1,0) [0|0] "" Vector__XXX
 SG_ VCFRONT_a496_MOSState m496 : 18|2@1+ (1,0) [0|0] "" Vector__XXX
 SG_ VCFRONT_a506_refrigLccType m506 : 18|1@1+ (1,0) [0|0] "" Vector__XXX
 SG_ VCFRONT_a507_aimingAllowed m507 : 18|1@1+ (1,0) [0|0] "" Vector__XXX
 SG_ VCFRONT_a524_aimingAllowed m524 : 18|1@1+ (1,0) [0|0] "" Vector__XXX
 SG_ VCFRONT_a528_currentSenseFaulted m528 : 18|1@1+ (1,0) [0|0] "" Vector__XXX
 SG_ VCFRONT_a544_LVBMSSOC m544 : 18|5@1+ (3,0) [0|0] "" Vector__XXX
 SG_ VCFRONT_a548_notEnoughPowerForSu m548 : 18|1@1+ (1,0) [0|0] "" Vector__XXX
 SG_ VCFRONT_a556_transportMode m556 : 18|1@1+ (1,0) [0|0] "" Vector__XXX
 SG_ VCFRONT_a560_highSHCabinReheatCD m560 : 18|1@1+ (1,0) [0|0] "" Vector__XXX
 SG_ VCFRONT_a565_UIDisplayOnForUser m565 : 18|1@1+ (1,0) [0|0] "" Vector__XXX
 SG_ VCFRONT_a583_referenceSwitchGrou m583 : 18|2@1+ (1,0) [0|0] "" Vector__XXX
 SG_ VCFRONT_a584_frunkSwitchGro_0000 m584 : 18|2@1+ (1,0) [0|0] "" Vector__XXX
 SG_ VCFRONT_a587_transportMode m587 : 18|1@1+ (1,0) [0|0] "" Vector__XXX
 SG_ VCFRONT_a595_transportMode m595 : 18|1@1+ (1,0) [0|0] "" Vector__XXX
 SG_ VCFRONT_a600_transportMode m600 : 18|1@1+ (1,0) [0|0] "" Vector__XXX
 SG_ VCFRONT_a606_packTempTooWarm m606 : 18|1@1+ (1,0) [0|0] "" Vector__XXX
 SG_ VCFRONT_a610_switch2State m610 : 18|2@1+ (1,0) [0|0] "" Vector__XXX
 SG_ VCFRONT_a611_tempCoolantRad_0000 m611 : 18|6@1+ (1,20) [0|0] "" Vector__XXX
 SG_ VCFRONT_a619_switch2State m619 : 18|2@1+ (1,0) [0|0] "" Vector__XXX
 SG_ VCFRONT_a635_vehBusAwake m635 : 18|1@1+ (1,0) [0|0] "" Vector__XXX
 SG_ VCFRONT_a643_frunkOpen m643 : 18|1@1+ (1,0) [0|0] "" Vector__XXX
 SG_ VCFRONT_a669_thermalHVDevicesDis m669 : 18|1@1+ (1,0) [0|0] "" Vector__XXX
 SG_ VCFRONT_a697_calibratedVerticalP m697 : 18|10@1+ (1,0) [0|0] "" Vector__XXX
 SG_ VCFRONT_a698_calibratedVerticalP m698 : 18|10@1+ (1,0) [0|0] "" Vector__XXX
 SG_ VCFRONT_a002_PowerOnReset m2 : 17|1@1+ (1,0) [0|0] "" Vector__XXX
 SG_ VCFRONT_a004_DASHighLowBeamDecis m4 : 17|1@1+ (1,0) [0|0] "" Vector__XXX
 SG_ VCFRONT_a008_DASHighLowBeamDecis m8 : 17|1@1+ (1,0) [0|0] "" Vector__XXX
 SG_ VCFRONT_a010_UnderVoltageTimeout m10 : 17|1@1+ (1,0) [0|0] "" Vector__XXX
 SG_ VCFRONT_a012_FlashError m12 : 17|1@1+ (1,0) [0|0] "" Vector__XXX
 SG_ VCFRONT_a013_ClearQueueFull m13 : 17|1@1+ (1,0) [0|0] "" Vector__XXX
 SG_ VCFRONT_a015_NVMMFilesystemError m15 : 17|1@1+ (1,0) [0|0] "" Vector__XXX
 SG_ VCFRONT_a021_Task1msStarved m21 : 17|1@1+ (1,0) [0|0] "" Vector__XXX
 SG_ VCFRONT_a047_ActFault m47 : 17|1@1+ (1,0) [0|0] "" Vector__XXX
 SG_ VCFRONT_a060_resetUnlocked m60 : 17|1@1+ (1,0) [0|0] "" Vector__XXX
 SG_ VCFRONT_a082_RIPC_remoteHSD m82 : 17|1@1+ (1,0) [0|0] "" Vector__XXX
 SG_ VCFRONT_a083_LIPC_remoteHSD m83 : 17|1@1+ (1,0) [0|0] "" Vector__XXX
 SG_ VCFRONT_a086_VEH_LVBMS_statusLow m86 : 17|1@1+ (1,0) [0|0] "" Vector__XXX
 SG_ VCFRONT_a087_VEH_thermalControl m87 : 17|1@1+ (1,0) [0|0] "" Vector__XXX
 SG_ VCFRONT_a088_VEH_thermalControl m88 : 17|1@1+ (1,0) [0|0] "" Vector__XXX
 SG_ VCFRONT_a089_PARTY_status m89 : 17|1@1+ (1,0) [0|0] "" Vector__XXX
 SG_ VCFRONT_a090_VEH_state m90 : 17|1@1+ (1,0) [0|0] "" Vector__XXX
 SG_ VCFRONT_a091_VEH_info m91 : 17|1@1+ (1,0) [0|0] "" Vector__XXX
 SG_ VCFRONT_a092_VEH_switchStatus m92 : 17|1@1+ (1,0) [0|0] "" Vector__XXX
 SG_ VCFRONT_a093_VEH_switchStatus m93 : 17|1@1+ (1,0) [0|0] "" Vector__XXX
 SG_ VCFRONT_a094_PARTY_sysStatus m94 : 17|1@1+ (1,0) [0|0] "" Vector__XXX
 SG_ VCFRONT_a095_PT_status m95 : 17|1@1+ (1,0) [0|0] "" Vector__XXX
 SG_ VCFRONT_a096_CH_status m96 : 17|1@1+ (1,0) [0|0] "" Vector__XXX
 SG_ VCFRONT_a097_VEH_state m97 : 17|1@1+ (1,0) [0|0] "" Vector__XXX
 SG_ VCFRONT_a098_VEH_hvStatus m98 : 17|1@1+ (1,0) [0|0] "" Vector__XXX
 SG_ VCFRONT_a100_PARTY m100 : 17|1@1+ (1,0) [0|0] "" Vector__XXX
 SG_ VCFRONT_a101_PARTY_locState m101 : 17|1@1+ (1,0) [0|0] "" Vector__XXX
 SG_ VCFRONT_a102_VEH_feedbackStatus m102 : 17|1@1+ (1,0) [0|0] "" Vector__XXX
 SG_ VCFRONT_a103_VEH_vehNm m103 : 17|1@1+ (1,0) [0|0] "" Vector__XXX
 SG_ VCFRONT_a104_VEH_chNm m104 : 17|1@1+ (1,0) [0|0] "" Vector__XXX
 SG_ VCFRONT_a105_VEH_chNm m105 : 17|1@1+ (1,0) [0|0] "" Vector__XXX
 SG_ VCFRONT_a106_VEH_thermalControl m106 : 17|1@1+ (1,0) [0|0] "" Vector__XXX
 SG_ VCFRONT_a107_VEH_vehNm m107 : 17|1@1+ (1,0) [0|0] "" Vector__XXX
 SG_ VCFRONT_a108_VEH_temperature m108 : 17|1@1+ (1,0) [0|0] "" Vector__XXX
 SG_ VCFRONT_a109_PARTY_inertial2 m109 : 17|1@1+ (1,0) [0|0] "" Vector__XXX
 SG_ VCFRONT_a110_VEH_carState m110 : 17|1@1+ (1,0) [0|0] "" Vector__XXX
 SG_ VCFRONT_a111_VEH_status m111 : 17|1@1+ (1,0) [0|0] "" Vector__XXX
 SG_ VCFRONT_a112_VEH_status m112 : 17|1@1+ (1,0) [0|0] "" Vector__XXX
 SG_ VCFRONT_a113_VEH_hvacRequest m113 : 17|1@1+ (1,0) [0|0] "" Vector__XXX
 SG_ VCFRONT_a114_PARTY_wheelSpeeds m114 : 17|1@1+ (1,0) [0|0] "" Vector__XXX
 SG_ VCFRONT_a115_VEH_authentication m115 : 17|1@1+ (1,0) [0|0] "" Vector__XXX
 SG_ VCFRONT_a116_VEH_vehNm m116 : 17|1@1+ (1,0) [0|0] "" Vector__XXX
 SG_ VCFRONT_a117_BDY_restraintStatus m117 : 17|1@1+ (1,0) [0|0] "" Vector__XXX
 SG_ VCFRONT_a118_VEH_lighting m118 : 17|1@1+ (1,0) [0|0] "" Vector__XXX
 SG_ VCFRONT_a119_VEH_leftStalk m119 : 17|1@1+ (1,0) [0|0] "" Vector__XXX
 SG_ VCFRONT_a120_VEH_systemStatus m120 : 17|1@1+ (1,0) [0|0] "" Vector__XXX
 SG_ VCFRONT_a121_fetShortCircuit m121 : 17|1@1+ (1,0) [0|0] "" Vector__XXX
 SG_ VCFRONT_a122_junctionOverTemp m122 : 17|1@1+ (1,0) [0|0] "" Vector__XXX
 SG_ VCFRONT_a123_fetShortCircuit m123 : 17|1@1+ (1,0) [0|0] "" Vector__XXX
 SG_ VCFRONT_a124_junctionOverTemp m124 : 17|1@1+ (1,0) [0|0] "" Vector__XXX
 SG_ VCFRONT_a125_fetShortCircuit m125 : 17|1@1+ (1,0) [0|0] "" Vector__XXX
 SG_ VCFRONT_a126_junctionOverTemp m126 : 17|1@1+ (1,0) [0|0] "" Vector__XXX
 SG_ VCFRONT_a136_snsDisconnect m136 : 17|1@1+ (1,0) [0|0] "" Vector__XXX
 SG_ VCFRONT_a137_snsDisconnect m137 : 17|1@1+ (1,0) [0|0] "" Vector__XXX
 SG_ VCFRONT_a138_snsDisconnect m138 : 17|1@1+ (1,0) [0|0] "" Vector__XXX
 SG_ VCFRONT_a139_snsDisconnect m139 : 17|1@1+ (1,0) [0|0] "" Vector__XXX
 SG_ VCFRONT_a140_snsDisconnect m140 : 17|1@1+ (1,0) [0|0] "" Vector__XXX
 SG_ VCFRONT_a141_snsDisconnect m141 : 17|1@1+ (1,0) [0|0] "" Vector__XXX
 SG_ VCFRONT_a143_vsOverVoltage m143 : 17|1@1+ (1,0) [0|0] "" Vector__XXX
 SG_ VCFRONT_a144_vsOverVoltage m144 : 17|1@1+ (1,0) [0|0] "" Vector__XXX
 SG_ VCFRONT_a145_vsOverVoltage m145 : 17|1@1+ (1,0) [0|0] "" Vector__XXX
 SG_ VCFRONT_a159_angleActual m159 : 17|10@1+ (0.25,-70) [0|0] "" Vector__XXX
 SG_ VCFRONT_a160_lowDischPressure m160 : 17|1@1+ (1,0) [0|0] "" Vector__XXX
 SG_ VCFRONT_a161_HVOverVoltage m161 : 17|1@1+ (1,0) [0|0] "" Vector__XXX
 SG_ VCFRONT_a163_compRecoverAfterFSR m163 : 17|1@1+ (1,0) [0|0] "" Vector__XXX
 SG_ VCFRONT_a168_rightECU m168 : 17|1@1+ (1,0) [0|0] "" Vector__XXX
 SG_ VCFRONT_a169_rightECU m169 : 17|1@1+ (1,0) [0|0] "" Vector__XXX
 SG_ VCFRONT_a170_rightECU m170 : 17|1@1+ (1,0) [0|0] "" Vector__XXX
 SG_ VCFRONT_a171_VCRIGHT m171 : 17|1@1+ (1,0) [0|0] "" Vector__XXX
 SG_ VCFRONT_a175_snsDisconnect m175 : 17|1@1+ (1,0) [0|0] "" Vector__XXX
 SG_ VCFRONT_a182_voltageDrop m182 : 17|1@1+ (1,0) [0|0] "" Vector__XXX
 SG_ VCFRONT_a183_voltageDrop m183 : 17|1@1+ (1,0) [0|0] "" Vector__XXX
 SG_ VCFRONT_a196_serviceMode m196 : 17|1@1+ (1,0) [0|0] "" Vector__XXX
 SG_ VCFRONT_a198_NVRAMState m198 : 17|1@1+ (1,0) [0|0] "" Vector__XXX
 SG_ VCFRONT_a199_NVRAMState m199 : 17|1@1+ (1,0) [0|0] "" Vector__XXX
 SG_ VCFRONT_a210_valveOverTravel m210 : 17|1@1+ (1,0) [0|0] "" Vector__XXX
 SG_ VCFRONT_a216_hvState m216 : 17|3@1+ (1,0) [0|0] "" Vector__XXX
 SG_ VCFRONT_a221_currentSenseFaulted m221 : 17|1@1+ (1,0) [0|0] "" Vector__XXX
 SG_ VCFRONT_a222_currentSenseFaulted m222 : 17|1@1+ (1,0) [0|0] "" Vector__XXX
 SG_ VCFRONT_a237_spiRegisterMismatch m237 : 17|1@1+ (1,0) [0|0] "" Vector__XXX
 SG_ VCFRONT_a238_spiRegisterMismatch m238 : 17|1@1+ (1,0) [0|0] "" Vector__XXX
 SG_ VCFRONT_a239_spiRegisterMismatch m239 : 17|1@1+ (1,0) [0|0] "" Vector__XXX
 SG_ VCFRONT_a240_lowPsCutoutCabinBat m240 : 17|1@1+ (1,0) [0|0] "" Vector__XXX
 SG_ VCFRONT_a250_isVirtualPitchSenso m250 : 17|1@1+ (1,0) [0|0] "" Vector__XXX
 SG_ VCFRONT_a253_ampHourTargetNotRea m253 : 17|1@1+ (1,0) [0|0] "" Vector__XXX
 SG_ VCFRONT_a259_voltageDropCounter m259 : 17|3@1+ (2,0) [0|0] "" Vector__XXX
 SG_ VCFRONT_a271_voltDropOnHighCurre m271 : 17|1@1+ (1,0) [0|0] "" Vector__XXX
 SG_ VCFRONT_a273_outwipePowerFailure m273 : 17|1@1+ (1,0) [0|0] "" Vector__XXX
 SG_ VCFRONT_a274_voltDropOnHighCurre m274 : 17|1@1+ (1,0) [0|0] "" Vector__XXX
 SG_ VCFRONT_a279_snsDisconnect m279 : 17|1@1+ (1,0) [0|0] "" Vector__XXX
 SG_ VCFRONT_a280_snsDisconnect m280 : 17|1@1+ (1,0) [0|0] "" Vector__XXX
 SG_ VCFRONT_a283_thmlFanLimited m283 : 17|1@1+ (1,0) [0|0] "" Vector__XXX
 SG_ VCFRONT_a290_currentSenseFaulted m290 : 17|1@1+ (1,0) [0|0] "" Vector__XXX
 SG_ VCFRONT_a291_currentSenseFaulted m291 : 17|1@1+ (1,0) [0|0] "" Vector__XXX
 SG_ VCFRONT_a292_currentSenseFaulted m292 : 17|1@1+ (1,0) [0|0] "" Vector__XXX
 SG_ VCFRONT_a293_currentSenseFaulted m293 : 17|1@1+ (1,0) [0|0] "" Vector__XXX
 SG_ VCFRONT_a294_currentSenseFaulted m294 : 17|1@1+ (1,0) [0|0] "" Vector__XXX
 SG_ VCFRONT_a295_currentSenseFaulted m295 : 17|1@1+ (1,0) [0|0] "" Vector__XXX
 SG_ VCFRONT_a299_LINError m299 : 17|1@1+ (1,0) [0|0] "" Vector__XXX
 SG_ VCFRONT_a355_systemNotCommission m355 : 17|1@1+ (1,0) [0|0] "" Vector__XXX
 SG_ VCFRONT_a356_systemNotCommission m356 : 17|1@1+ (1,0) [0|0] "" Vector__XXX
 SG_ VCFRONT_a360_notEnoughPowerForSu m360 : 17|1@1+ (1,0) [0|0] "" Vector__XXX
 SG_ VCFRONT_a364_previousHeaterType m364 : 17|3@1+ (1,0) [0|0] "" Vector__XXX
 SG_ VCFRONT_a365_enteringState m365 : 17|3@1+ (1,0) [0|0] "" Vector__XXX
 SG_ VCFRONT_a368_enteringState m368 : 17|3@1+ (1,0) [0|0] "" Vector__XXX
 SG_ VCFRONT_a369_heatRejectionLimite m369 : 17|1@1+ (1,0) [0|0] "" Vector__XXX
 SG_ VCFRONT_a371_voltDropOnHighCurre m371 : 17|1@1+ (1,0) [0|0] "" Vector__XXX
 SG_ VCFRONT_a377_wiperStuckInPark m377 : 17|1@1+ (1,0) [0|0] "" Vector__XXX
 SG_ VCFRONT_a378_wiperOverload m378 : 17|2@1+ (1,0) [0|0] "" Vector__XXX
 SG_ VCFRONT_a389_faultedWhileOpenAtS m389 : 17|1@1+ (1,0) [0|0] "" Vector__XXX
 SG_ VCFRONT_a391_switch1Shorted m391 : 17|1@1+ (1,0) [0|0] "" Vector__XXX
 SG_ VCFRONT_a394_suction m394 : 17|1@1+ (1,0) [0|0] "" Vector__XXX
 SG_ VCFRONT_a397_suction m397 : 17|1@1+ (1,0) [0|0] "" Vector__XXX
 SG_ VCFRONT_a421_inServiceMode m421 : 17|1@1+ (1,0) [0|0] "" Vector__XXX
 SG_ VCFRONT_a437_nvmDataMissingB m437 : 17|1@1+ (1,0) [0|0] "" Vector__XXX
 SG_ VCFRONT_a446_compFaultTdHigh m446 : 17|1@1+ (1,0) [0|0] "" Vector__XXX
 SG_ VCFRONT_a447_heatPumpHVACUnavail m447 : 17|1@1+ (1,0) [0|0] "" Vector__XXX
 SG_ VCFRONT_a459_refrigerantFillActi m459 : 17|1@1+ (1,0) [0|0] "" Vector__XXX
 SG_ VCFRONT_a462_CellOVLevel2 m462 : 17|1@1+ (1,0) [0|0] "" Vector__XXX
 SG_ VCFRONT_a463_switch1Shorted m463 : 17|1@1+ (1,0) [0|0] "" Vector__XXX
 SG_ VCFRONT_a476_FRM2_timedOut m476 : 17|1@1+ (1,0) [0|0] "" Vector__XXX
 SG_ VCFRONT_a478_battFaultHardwareOv m478 : 17|1@1+ (1,0) [0|0] "" Vector__XXX
 SG_ VCFRONT_a479_ECPAState m479 : 17|2@1+ (1,0) [0|0] "" Vector__XXX
 SG_ VCFRONT_a489_EvapEXV m489 : 17|1@1+ (1,0) [0|0] "" Vector__XXX
 SG_ VCFRONT_a495_SocTooLow m495 : 17|1@1+ (1,0) [0|0] "" Vector__XXX
 SG_ VCFRONT_a496_vehicleLoadShedActi m496 : 17|1@1+ (1,0) [0|0] "" Vector__XXX
 SG_ VCFRONT_a497_FactoryMode m497 : 17|1@1+ (1,0) [0|0] "" Vector__XXX
 SG_ VCFRONT_a528_ECPAFrameTimeout m528 : 17|1@1+ (1,0) [0|0] "" Vector__XXX
 SG_ VCFRONT_a544_frunkOpen m544 : 17|1@1+ (1,0) [0|0] "" Vector__XXX
 SG_ VCFRONT_a547_frunkOpen m547 : 17|1@1+ (1,0) [0|0] "" Vector__XXX
 SG_ VCFRONT_a556_serviceMode m556 : 17|1@1+ (1,0) [0|0] "" Vector__XXX
 SG_ VCFRONT_a560_highSHBattCondition m560 : 17|1@1+ (1,0) [0|0] "" Vector__XXX
 SG_ VCFRONT_a587_serviceMode m587 : 17|1@1+ (1,0) [0|0] "" Vector__XXX
 SG_ VCFRONT_a588_vcleftCurveOffsetCh m588 : 17|3@1+ (1,0) [0|0] "" Vector__XXX
 SG_ VCFRONT_a589_vcleftCurrentThresh m589 : 17|12@1+ (0.1,0) [0|0] "" Vector__XXX
 SG_ VCFRONT_a590_vcrightCurveOffsetC m590 : 17|3@1+ (1,0) [0|0] "" Vector__XXX
 SG_ VCFRONT_a591_vcrightCurrentThres m591 : 17|12@1+ (0.1,0) [0|0] "" Vector__XXX
 SG_ VCFRONT_a592_vcleftCutoffCurveOf m592 : 17|3@1+ (1,0) [0|0] "" Vector__XXX
 SG_ VCFRONT_a593_vcleftCutoffCurrent m593 : 17|12@1+ (0.1,0) [0|0] "" Vector__XXX
 SG_ VCFRONT_a595_serviceMode m595 : 17|1@1+ (1,0) [0|0] "" Vector__XXX
 SG_ VCFRONT_a596_vcrightCutoffCurveO m596 : 17|3@1+ (1,0) [0|0] "" Vector__XXX
 SG_ VCFRONT_a597_vcrightCutoffCurren m597 : 17|12@1+ (0.1,0) [0|0] "" Vector__XXX
 SG_ VCFRONT_a600_serviceMode m600 : 17|1@1+ (1,0) [0|0] "" Vector__XXX
 SG_ VCFRONT_a606_tempDuctMissTooHigh m606 : 17|1@1+ (1,0) [0|0] "" Vector__XXX
 SG_ VCFRONT_a609_vehiclePowerState m609 : 17|2@1+ (1,0) [0|0] "" Vector__XXX
 SG_ VCFRONT_a611_isCoolantModeParall m611 : 17|1@1+ (1,0) [0|0] "" Vector__XXX
 SG_ VCFRONT_a635_allBusesSleeping m635 : 17|1@1+ (1,0) [0|0] "" Vector__XXX
 SG_ VCFRONT_a643_inServiceMode m643 : 17|1@1+ (1,0) [0|0] "" Vector__XXX
 SG_ VCFRONT_a649_hvBlockingPersistAc m649 : 17|1@1+ (1,0) [0|0] "" Vector__XXX
 SG_ VCFRONT_a669_thermalHVDevicesLim m669 : 17|1@1+ (1,0) [0|0] "" Vector__XXX
 SG_ VCFRONT_a697_isVirtualPitchSenso m697 : 17|1@1+ (1,0) [0|0] "" Vector__XXX
 SG_ VCFRONT_a698_isVirtualPitchSenso m698 : 17|1@1+ (1,0) [0|0] "" Vector__XXX
 SG_ VCFRONT_a000_alertDataW0 m0 : 16|16@1+ (1,0) [0|0] "" Vector__XXX
 SG_ VCFRONT_a001_InternalWatchdog m1 : 16|1@1+ (1,0) [0|0] "" Vector__XXX
 SG_ VCFRONT_a002_CPUUndervoltage m2 : 16|1@1+ (1,0) [0|0] "" Vector__XXX
 SG_ VCFRONT_a003_AssertID m3 : 16|16@1+ (1,0) [0|0] "" Vector__XXX
 SG_ VCFRONT_a004_APPWatchdogFaultOrM m4 : 16|1@1+ (1,0) [0|0] "" Vector__XXX
 SG_ VCFRONT_a005_busID0 m5 : 16|4@1+ (1,0) [0|0] "" Vector__XXX
 SG_ VCFRONT_a006_busID m6 : 16|4@1+ (1,0) [0|0] "" Vector__XXX
 SG_ VCFRONT_a008_APPWatchdogFaultOrM m8 : 16|1@1+ (1,0) [0|0] "" Vector__XXX
 SG_ VCFRONT_a009_purgeTimeSeconds m9 : 16|5@1+ (1,0) [0|0] "" Vector__XXX
 SG_ VCFRONT_a010_UnderVoltageDetecte m10 : 16|1@1+ (1,0) [0|0] "" Vector__XXX
 SG_ VCFRONT_a012_ClockError m12 : 16|1@1+ (1,0) [0|0] "" Vector__XXX
 SG_ VCFRONT_a013_LogQueueFull m13 : 16|1@1+ (1,0) [0|0] "" Vector__XXX
 SG_ VCFRONT_a015_NVMMMemOverflow m15 : 16|1@1+ (1,0) [0|0] "" Vector__XXX
 SG_ VCFRONT_a016_NVMMRecordID m16 : 16|16@1+ (1,0) [0|0] "" Vector__XXX
 SG_ VCFRONT_a017_NVMMLifetimeEraseCy m17 : 16|32@1+ (1,0) [0|0] "" Vector__XXX
 SG_ VCFRONT_a021_Task1msLate m21 : 16|1@1+ (1,0) [0|0] "" Vector__XXX
 SG_ VCFRONT_a022_TaskInitErrorCount m22 : 16|8@1+ (1,0) [0|0] "" Vector__XXX
 SG_ VCFRONT_a030_logId m30 : 16|4@1+ (1,0) [0|0] "" Vector__XXX
 SG_ VCFRONT_a031_uds_bytes_0 m31 : 16|8@1+ (1,0) [0|0] "" Vector__XXX
 SG_ VCFRONT_a032_core m32 : 16|2@1+ (1,0) [0|0] "" Vector__XXX
 SG_ VCFRONT_a033_index m33 : 16|7@1+ (1,0) [0|0] "" Vector__XXX
 SG_ VCFRONT_a038_faultType m38 : 16|2@1+ (1,0) [0|0] "" Vector__XXX
 SG_ VCFRONT_a039_faultType m39 : 16|2@1+ (1,0) [0|0] "" Vector__XXX
 SG_ VCFRONT_a040_depth m40 : 16|4@1+ (1,0) [0|0] "" Vector__XXX
 SG_ VCFRONT_a041_CPULoadTotal m41 : 16|8@1+ (1,0) [0|0] "" Vector__XXX
 SG_ VCFRONT_a042_Usage1msTask m42 : 16|8@1+ (1,0) [0|0] "" Vector__XXX
 SG_ VCFRONT_a043_CallTrace0 m43 : 16|24@1+ (1,0) [0|0] "" Vector__XXX
 SG_ VCFRONT_a044_CallTrace0 m44 : 16|24@1+ (1,0) [0|0] "" Vector__XXX
 SG_ VCFRONT_a045_CallTrace0 m45 : 16|24@1+ (1,0) [0|0] "" Vector__XXX
 SG_ VCFRONT_a046_CallTrace0 m46 : 16|24@1+ (1,0) [0|0] "" Vector__XXX
 SG_ VCFRONT_a047_Wdt m47 : 16|1@1+ (1,0) [0|0] "" Vector__XXX
 SG_ VCFRONT_a057_VEH_cpControl m57 : 16|1@1+ (1,0) [0|0] "" Vector__XXX
 SG_ VCFRONT_a058_voltageDrop m58 : 16|12@1+ (0.005443676098,0) [0|0] "" Vector__XXX
 SG_ VCFRONT_a059_voltageDrop m59 : 16|12@1+ (0.005443676098,0) [0|0] "" Vector__XXX
 SG_ VCFRONT_a060_lockoutDisabled m60 : 16|1@1+ (1,0) [0|0] "" Vector__XXX
 SG_ VCFRONT_a063_switchChannel m63 : 16|8@1+ (1,0) [0|0] "" Vector__XXX
 SG_ VCFRONT_a064_busBitField m64 : 16|8@1+ (1,0) [0|0] "" Vector__XXX
 SG_ VCFRONT_a082_RIPC_epbPrivateStat m82 : 16|1@1+ (1,0) [0|0] "" Vector__XXX
 SG_ VCFRONT_a083_LIPC_epbPrivateStat m83 : 16|1@1+ (1,0) [0|0] "" Vector__XXX
 SG_ VCFRONT_a084_CH_StatusC m84 : 16|1@1+ (1,0) [0|0] "" Vector__XXX
 SG_ VCFRONT_a085_PARTY_buttonStatus m85 : 16|1@1+ (1,0) [0|0] "" Vector__XXX
 SG_ VCFRONT_a086_VEH_LVBMS_statusHig m86 : 16|1@1+ (1,0) [0|0] "" Vector__XXX
 SG_ VCFRONT_a087_VEH_temperature m87 : 16|1@1+ (1,0) [0|0] "" Vector__XXX
 SG_ VCFRONT_a088_VEH_temperature m88 : 16|1@1+ (1,0) [0|0] "" Vector__XXX
 SG_ VCFRONT_a089_PARTY_party1 m89 : 16|1@1+ (1,0) [0|0] "" Vector__XXX
 SG_ VCFRONT_a090_VEH_chNm m90 : 16|1@1+ (1,0) [0|0] "" Vector__XXX
 SG_ VCFRONT_a091_VEH_faultsAndExtras m91 : 16|1@1+ (1,0) [0|0] "" Vector__XXX
 SG_ VCFRONT_a092_VEH_restraintStatus m92 : 16|1@1+ (1,0) [0|0] "" Vector__XXX
 SG_ VCFRONT_a093_VEH_restraintStatus m93 : 16|1@1+ (1,0) [0|0] "" Vector__XXX
 SG_ VCFRONT_a094_VEH_sysStatus m94 : 16|1@1+ (1,0) [0|0] "" Vector__XXX
 SG_ VCFRONT_a095_PT_ptNm m95 : 16|1@1+ (1,0) [0|0] "" Vector__XXX
 SG_ VCFRONT_a096_VEH_status m96 : 16|1@1+ (1,0) [0|0] "" Vector__XXX
 SG_ VCFRONT_a097_VEH_HVStatus m97 : 16|1@1+ (1,0) [0|0] "" Vector__XXX
 SG_ VCFRONT_a098_CH_torque m98 : 16|1@1+ (1,0) [0|0] "" Vector__XXX
 SG_ VCFRONT_a099_VEH_oocStatus m99 : 16|1@1+ (1,0) [0|0] "" Vector__XXX
 SG_ VCFRONT_a100_VEH m100 : 16|1@1+ (1,0) [0|0] "" Vector__XXX
 SG_ VCFRONT_a101_VEH_state m101 : 16|1@1+ (1,0) [0|0] "" Vector__XXX
 SG_ VCFRONT_a102_VEH_faultsAndExtras m102 : 16|1@1+ (1,0) [0|0] "" Vector__XXX
 SG_ VCFRONT_a103_VEH_hvsNm m103 : 16|1@1+ (1,0) [0|0] "" Vector__XXX
 SG_ VCFRONT_a104_VEH_defogInfoMessag m104 : 16|1@1+ (1,0) [0|0] "" Vector__XXX
 SG_ VCFRONT_a105_VEH_states m105 : 16|1@1+ (1,0) [0|0] "" Vector__XXX
 SG_ VCFRONT_a106_VEH_dcdcStatus m106 : 16|1@1+ (1,0) [0|0] "" Vector__XXX
 SG_ VCFRONT_a107_VEH_hvsNm m107 : 16|1@1+ (1,0) [0|0] "" Vector__XXX
 SG_ VCFRONT_a108_VEH_hvStatus m108 : 16|1@1+ (1,0) [0|0] "" Vector__XXX
 SG_ VCFRONT_a109_PARTY_status m109 : 16|1@1+ (1,0) [0|0] "" Vector__XXX
 SG_ VCFRONT_a110_VEH_status m110 : 16|1@1+ (1,0) [0|0] "" Vector__XXX
 SG_ VCFRONT_a111_VEH_internalStatus m111 : 16|1@1+ (1,0) [0|0] "" Vector__XXX
 SG_ VCFRONT_a112_VEH_internalStatus m112 : 16|1@1+ (1,0) [0|0] "" Vector__XXX
 SG_ VCFRONT_a113_VEH_ethNm m113 : 16|1@1+ (1,0) [0|0] "" Vector__XXX
 SG_ VCFRONT_a114_PARTY_status m114 : 16|1@1+ (1,0) [0|0] "" Vector__XXX
 SG_ VCFRONT_a115_VEH_vehNm m115 : 16|1@1+ (1,0) [0|0] "" Vector__XXX
 SG_ VCFRONT_a116_PARTY_epbmStatus m116 : 16|1@1+ (1,0) [0|0] "" Vector__XXX
 SG_ VCFRONT_a117_BDY_epbmStatus m117 : 16|1@1+ (1,0) [0|0] "" Vector__XXX
 SG_ VCFRONT_a118_VEH_vehNm m118 : 16|1@1+ (1,0) [0|0] "" Vector__XXX
 SG_ VCFRONT_a119_VEH_steerAngle m119 : 16|1@1+ (1,0) [0|0] "" Vector__XXX
 SG_ VCFRONT_a120_PARTY_chassisCntl m120 : 16|1@1+ (1,0) [0|0] "" Vector__XXX
 SG_ VCFRONT_a121_overCurrentError m121 : 16|1@1+ (1,0) [0|0] "" Vector__XXX
 SG_ VCFRONT_a122_junctionTempWarning m122 : 16|1@1+ (1,0) [0|0] "" Vector__XXX
 SG_ VCFRONT_a123_overCurrentError m123 : 16|1@1+ (1,0) [0|0] "" Vector__XXX
 SG_ VCFRONT_a124_junctionTempWarning m124 : 16|1@1+ (1,0) [0|0] "" Vector__XXX
 SG_ VCFRONT_a125_overCurrentError m125 : 16|1@1+ (1,0) [0|0] "" Vector__XXX
 SG_ VCFRONT_a126_junctionTempWarning m126 : 16|1@1+ (1,0) [0|0] "" Vector__XXX
 SG_ VCFRONT_a127_vcleftEFuseCurrent m127 : 16|16@1+ (0.1,0) [0|0] "" Vector__XXX
 SG_ VCFRONT_a128_vcrightEFuseCurrent m128 : 16|16@1+ (0.1,0) [0|0] "" Vector__XXX
 SG_ VCFRONT_a129_pcsEFuseCurrent m129 : 16|16@1+ (0.1,0) [0|0] "" Vector__XXX
 SG_ VCFRONT_a130_epas3pEFuseCurrent m130 : 16|16@1+ (0.1,0) [0|0] "" Vector__XXX
 SG_ VCFRONT_a131_epas3sEFuseCurrent m131 : 16|16@1+ (0.1,0) [0|0] "" Vector__XXX
 SG_ VCFRONT_a132_iBoosterCurrent m132 : 16|16@1+ (0.1,0) [0|0] "" Vector__XXX
 SG_ VCFRONT_a133_espEFuseCurrent m133 : 16|16@1+ (0.1,0) [0|0] "" Vector__XXX
 SG_ VCFRONT_a134_fusedHighCurrent m134 : 16|16@1+ (0.1,0) [0|0] "" Vector__XXX
 SG_ VCFRONT_a136_snsShortCircuit m136 : 16|1@1+ (1,0) [0|0] "" Vector__XXX
 SG_ VCFRONT_a137_snsShortCircuit m137 : 16|1@1+ (1,0) [0|0] "" Vector__XXX
 SG_ VCFRONT_a138_snsShortCircuit m138 : 16|1@1+ (1,0) [0|0] "" Vector__XXX
 SG_ VCFRONT_a139_snsShortCircuit m139 : 16|1@1+ (1,0) [0|0] "" Vector__XXX
 SG_ VCFRONT_a140_snsShortCircuit m140 : 16|1@1+ (1,0) [0|0] "" Vector__XXX
 SG_ VCFRONT_a141_snsShortCircuit m141 : 16|1@1+ (1,0) [0|0] "" Vector__XXX
 SG_ VCFRONT_a142_driverState m142 : 16|4@1+ (1,0) [0|0] "" Vector__XXX
 SG_ VCFRONT_a143_vsUnderVoltage m143 : 16|1@1+ (1,0) [0|0] "" Vector__XXX
 SG_ VCFRONT_a144_vsUnderVoltage m144 : 16|1@1+ (1,0) [0|0] "" Vector__XXX
 SG_ VCFRONT_a145_vsUnderVoltage m145 : 16|1@1+ (1,0) [0|0] "" Vector__XXX
 SG_ VCFRONT_a146_RPMActual m146 : 16|10@1+ (10,0) [0|0] "" Vector__XXX
 SG_ VCFRONT_a147_RPMActual m147 : 16|10@1+ (10,0) [0|0] "" Vector__XXX
 SG_ VCFRONT_a148_RPMActual m148 : 16|10@1+ (10,0) [0|0] "" Vector__XXX
 SG_ VCFRONT_a150_RPMActual m150 : 16|10@1+ (10,0) [0|0] "" Vector__XXX
 SG_ VCFRONT_a151_RPMActual m151 : 16|10@1+ (10,0) [0|0] "" Vector__XXX
 SG_ VCFRONT_a152_RPMActual m152 : 16|10@1+ (10,0) [0|0] "" Vector__XXX
 SG_ VCFRONT_a153_userPresenceState m153 : 16|2@1+ (1,0) [0|0] "" Vector__XXX
 SG_ VCFRONT_a154_lastSilentWakeIBSVo m154 : 16|11@1+ (0.005,5) [0|0] "" Vector__XXX
 SG_ VCFRONT_a155_IBSAmpHoursAtContac m155 : 16|6@1+ (0.05,-3) [0|0] "" Vector__XXX
 SG_ VCFRONT_a156_motorCounts m156 : 16|11@1+ (1,-100) [0|0] "" Vector__XXX
 SG_ VCFRONT_a157_motorCounts m157 : 16|11@1+ (1,-100) [0|0] "" Vector__XXX
 SG_ VCFRONT_a159_stall m159 : 16|1@1+ (1,0) [0|0] "" Vector__XXX
 SG_ VCFRONT_a160_highDischTemp m160 : 16|1@1+ (1,0) [0|0] "" Vector__XXX
 SG_ VCFRONT_a161_failedStart m161 : 16|1@1+ (1,0) [0|0] "" Vector__XXX
 SG_ VCFRONT_a162_dischargePressure m162 : 16|6@1+ (0.5,0) [0|0] "" Vector__XXX
 SG_ VCFRONT_a163_compDisabledFSR m163 : 16|1@1+ (1,0) [0|0] "" Vector__XXX
 SG_ VCFRONT_a164_lockoutVoltage m164 : 16|16@1+ (0.1,0) [0|0] "" Vector__XXX
 SG_ VCFRONT_a165_lockoutVoltage m165 : 16|16@1+ (0.1,0) [0|0] "" Vector__XXX
 SG_ VCFRONT_a168_leftECU m168 : 16|1@1+ (1,0) [0|0] "" Vector__XXX
 SG_ VCFRONT_a169_leftECU m169 : 16|1@1+ (1,0) [0|0] "" Vector__XXX
 SG_ VCFRONT_a170_leftECU m170 : 16|1@1+ (1,0) [0|0] "" Vector__XXX
 SG_ VCFRONT_a171_VCFRONT m171 : 16|1@1+ (1,0) [0|0] "" Vector__XXX
 SG_ VCFRONT_a172_ECUMismatchBits m172 : 16|47@1+ (1,0) [0|0] "" Vector__XXX
 SG_ VCFRONT_a173_ECUMismatchBits m173 : 16|47@1+ (1,0) [0|0] "" Vector__XXX
 SG_ VCFRONT_a174_driveNotAuthedData m174 : 16|1@1+ (1,0) [0|0] "" Vector__XXX
 SG_ VCFRONT_a175_snsShortCircuit m175 : 16|1@1+ (1,0) [0|0] "" Vector__XXX
 SG_ VCFRONT_a176_vehicleState m176 : 16|3@1+ (1,0) [0|0] "" Vector__XXX
 SG_ VCFRONT_a177_mcuAudioCurrent m177 : 16|10@1+ (0.1,0) [0|0] "" Vector__XXX
 SG_ VCFRONT_a178_pumpOutState m178 : 16|3@1+ (1,0) [0|0] "" Vector__XXX
 SG_ VCFRONT_a179_highLVAmpsIntoPCSLo m179 : 16|1@1+ (1,0) [0|0] "" Vector__XXX
 SG_ VCFRONT_a180_vehiclePowerState m180 : 16|2@1+ (1,0) [0|0] "" Vector__XXX
 SG_ VCFRONT_a181_vehicleState m181 : 16|2@1+ (1,0) [0|0] "" Vector__XXX
 SG_ VCFRONT_a182_deadLV m182 : 16|1@1+ (1,0) [0|0] "" Vector__XXX
 SG_ VCFRONT_a183_deadLV m183 : 16|1@1+ (1,0) [0|0] "" Vector__XXX
 SG_ VCFRONT_a184_hvacFlow m184 : 16|7@1+ (2,0) [0|0] "" Vector__XXX
 SG_ VCFRONT_a186_noDriveChgCableConX m186 : 16|1@1+ (1,0) [0|0] "" Vector__XXX
 SG_ VCFRONT_a187_vehBusRetryCount m187 : 16|9@1+ (1,0) [0|0] "" Vector__XXX
 SG_ VCFRONT_a188_sleepBypassCurrent m188 : 16|8@1+ (0.2,0) [0|0] "" Vector__XXX
 SG_ VCFRONT_a190_frameID m190 : 16|6@1+ (1,0) [0|0] "" Vector__XXX
 SG_ VCFRONT_a191_vehiclePowerState m191 : 16|2@1+ (1,0) [0|0] "" Vector__XXX
 SG_ VCFRONT_a192_vehiclePowerState m192 : 16|2@1+ (1,0) [0|0] "" Vector__XXX
 SG_ VCFRONT_a195_IBSVoltage m195 : 16|12@1+ (0.005443676098,0) [0|0] "" Vector__XXX
 SG_ VCFRONT_a196_factoryMode m196 : 16|1@1+ (1,0) [0|0] "" Vector__XXX
 SG_ VCFRONT_a197_IBSAmpHoursAtStartO m197 : 16|14@1+ (0.005,-40.96) [0|0] "" Vector__XXX
 SG_ VCFRONT_a198_outputState m198 : 16|1@1+ (1,0) [0|0] "" Vector__XXX
 SG_ VCFRONT_a199_outputState m199 : 16|1@1+ (1,0) [0|0] "" Vector__XXX
 SG_ VCFRONT_a200_vcleftSelfTest m200 : 16|4@1+ (1,0) [0|0] "" Vector__XXX
 SG_ VCFRONT_a201_vcrightSelfTest m201 : 16|4@1+ (1,0) [0|0] "" Vector__XXX
 SG_ VCFRONT_a202_pcsSelfTest m202 : 16|4@1+ (1,0) [0|0] "" Vector__XXX
 SG_ VCFRONT_a203_epas3pSelfTest m203 : 16|4@1+ (1,0) [0|0] "" Vector__XXX
 SG_ VCFRONT_a204_epas3sSelfTest m204 : 16|4@1+ (1,0) [0|0] "" Vector__XXX
 SG_ VCFRONT_a205_iBoosterSelfTest m205 : 16|4@1+ (1,0) [0|0] "" Vector__XXX
 SG_ VCFRONT_a206_espSelfTest m206 : 16|4@1+ (1,0) [0|0] "" Vector__XXX
 SG_ VCFRONT_a207_vbatFusedSelfTest m207 : 16|4@1+ (1,0) [0|0] "" Vector__XXX
 SG_ VCFRONT_a210_valveUnderTravel m210 : 16|1@1+ (1,0) [0|0] "" Vector__XXX
 SG_ VCFRONT_a211_DeviceIDBits m211 : 16|8@1+ (1,0) [0|0] "" Vector__XXX
 SG_ VCFRONT_a212_IBSTemp m212 : 16|16@1- (0.01,0) [0|0] "" Vector__XXX
 SG_ VCFRONT_a213_IBSVolts m213 : 16|12@1+ (0.005443676098,0) [0|0] "" Vector__XXX
 SG_ VCFRONT_a216_inDrive m216 : 16|1@1+ (1,0) [0|0] "" Vector__XXX
 SG_ VCFRONT_a218_socPercentThreshold m218 : 16|8@1+ (1,0) [0|0] "" Vector__XXX
 SG_ VCFRONT_a219_IBSVolts m219 : 16|12@1+ (0.005443676098,0) [0|0] "" Vector__XXX
 SG_ VCFRONT_a220_IBSCurrent m220 : 16|16@1- (0.005,0) [0|0] "" Vector__XXX
 SG_ VCFRONT_a221_outputFaulted m221 : 16|1@1+ (1,0) [0|0] "" Vector__XXX
 SG_ VCFRONT_a222_outputFaulted m222 : 16|1@1+ (1,0) [0|0] "" Vector__XXX
 SG_ VCFRONT_a223_12VTemperature m223 : 16|16@1- (0.1,0) [0|0] "" Vector__XXX
 SG_ VCFRONT_a228_RPMActual m228 : 16|10@1+ (10,0) [0|0] "" Vector__XXX
 SG_ VCFRONT_a229_RPMActual m229 : 16|10@1+ (10,0) [0|0] "" Vector__XXX
 SG_ VCFRONT_a230_RPMActual m230 : 16|10@1+ (10,0) [0|0] "" Vector__XXX
 SG_ VCFRONT_a231_12VTemperature m231 : 16|16@1- (0.1,0) [0|0] "" Vector__XXX
 SG_ VCFRONT_a232_sHFeedbackHigherTha m232 : 16|1@1+ (1,0) [0|0] "" Vector__XXX
 SG_ VCFRONT_a233_current m233 : 16|10@1+ (0.1,0) [0|0] "" Vector__XXX
 SG_ VCFRONT_a234_current m234 : 16|10@1+ (0.1,0) [0|0] "" Vector__XXX
 SG_ VCFRONT_a235_ptSensorTemp m235 : 16|11@1+ (0.125,-40) [0|0] "" Vector__XXX
 SG_ VCFRONT_a236_batSensorTemp m236 : 16|11@1+ (0.125,-40) [0|0] "" Vector__XXX
 SG_ VCFRONT_a237_spiErrorCount m237 : 16|1@1+ (1,0) [0|0] "" Vector__XXX
 SG_ VCFRONT_a238_spiErrorCount m238 : 16|1@1+ (1,0) [0|0] "" Vector__XXX
 SG_ VCFRONT_a239_spiErrorCount m239 : 16|1@1+ (1,0) [0|0] "" Vector__XXX
 SG_ VCFRONT_a240_lowPsCutoutCabinCoo m240 : 16|1@1+ (1,0) [0|0] "" Vector__XXX
 SG_ VCFRONT_a242_LVBatteryTemp m242 : 16|7@1+ (1,-40) [0|0] "" Vector__XXX
 SG_ VCFRONT_a243_IBSVolts m243 : 16|12@1+ (0.005443676098,0) [0|0] "" Vector__XXX
 SG_ VCFRONT_a244_current m244 : 16|16@1+ (0.1,0) [0|0] "" Vector__XXX
 SG_ VCFRONT_a245_current m245 : 16|16@1+ (0.1,0) [0|0] "" Vector__XXX
 SG_ VCFRONT_a246_current m246 : 16|16@1+ (0.1,0) [0|0] "" Vector__XXX
 SG_ VCFRONT_a247_solenoidISense m247 : 16|8@1- (0.01,0) [0|0] "" Vector__XXX
 SG_ VCFRONT_a248_AS8510Voltage m248 : 16|12@1+ (0.005443676098,0) [0|0] "" Vector__XXX
 SG_ VCFRONT_a249_tempCoolantBatInlet m249 : 16|10@1+ (0.125,-40) [0|0] "" Vector__XXX
 SG_ VCFRONT_a250_isGlobalHeadlamps m250 : 16|1@1+ (1,0) [0|0] "" Vector__XXX
 SG_ VCFRONT_a251_UIKeepAwake m251 : 16|6@1+ (1,0) [0|0] "" Vector__XXX
 SG_ VCFRONT_a252_IBSVoltage m252 : 16|12@1+ (0.005443676098,0) [0|0] "" Vector__XXX
 SG_ VCFRONT_a253_currentNotTapered m253 : 16|1@1+ (1,0) [0|0] "" Vector__XXX
 SG_ VCFRONT_a254_RPMActual m254 : 16|10@1+ (10,0) [0|0] "" Vector__XXX
 SG_ VCFRONT_a255_RPMActual m255 : 16|10@1+ (10,0) [0|0] "" Vector__XXX
 SG_ VCFRONT_a257_lockoutVoltage m257 : 16|16@1+ (0.1,0) [0|0] "" Vector__XXX
 SG_ VCFRONT_a258_minVoltageReached m258 : 16|12@1+ (0.005443676098,0) [0|0] "" Vector__XXX
 SG_ VCFRONT_a259_serviceMode m259 : 16|1@1+ (1,0) [0|0] "" Vector__XXX
 SG_ VCFRONT_a260_IBSVolts m260 : 16|12@1+ (0.005443676098,0) [0|0] "" Vector__XXX
 SG_ VCFRONT_a261_eFuseVoltage m261 : 16|16@1+ (0.1,0) [0|0] "" Vector__XXX
 SG_ VCFRONT_a262_eFuseVoltage m262 : 16|16@1+ (0.1,0) [0|0] "" Vector__XXX
 SG_ VCFRONT_a263_eFuseVoltage m263 : 16|16@1+ (0.1,0) [0|0] "" Vector__XXX
 SG_ VCFRONT_a264_eFuseVoltage m264 : 16|16@1+ (0.1,0) [0|0] "" Vector__XXX
 SG_ VCFRONT_a265_eFuseVoltage m265 : 16|16@1+ (0.1,0) [0|0] "" Vector__XXX
 SG_ VCFRONT_a266_eFuseVoltage m266 : 16|16@1+ (0.1,0) [0|0] "" Vector__XXX
 SG_ VCFRONT_a267_eFuseVoltage m267 : 16|16@1+ (0.1,0) [0|0] "" Vector__XXX
 SG_ VCFRONT_a268_eFuseVoltage m268 : 16|16@1+ (0.1,0) [0|0] "" Vector__XXX
 SG_ VCFRONT_a269_LVBatteryTemp m269 : 16|7@1+ (1,-40) [0|0] "" Vector__XXX
 SG_ VCFRONT_a271_shortedCellTestTrig m271 : 16|1@1+ (1,0) [0|0] "" Vector__XXX
 SG_ VCFRONT_a273_inwipePowerFailureT m273 : 16|1@1+ (1,0) [0|0] "" Vector__XXX
 SG_ VCFRONT_a274_shortedCellTestTrig m274 : 16|1@1+ (1,0) [0|0] "" Vector__XXX
 SG_ VCFRONT_a275_breakLocationA m275 : 16|5@1+ (1,0) [0|0] "" Vector__XXX
 SG_ VCFRONT_a276_breakLocationA m276 : 16|5@1+ (1,0) [0|0] "" Vector__XXX
 SG_ VCFRONT_a277_bmbDeviceMask m277 : 16|16@1+ (1,0) [0|0] "" Vector__XXX
 SG_ VCFRONT_a279_snsShortCircuit m279 : 16|1@1+ (1,0) [0|0] "" Vector__XXX
 SG_ VCFRONT_a280_snsShortCircuit m280 : 16|1@1+ (1,0) [0|0] "" Vector__XXX
 SG_ VCFRONT_a283_thmlFanDisabled m283 : 16|1@1+ (1,0) [0|0] "" Vector__XXX
 SG_ VCFRONT_a284_driverState m284 : 16|4@1+ (1,0) [0|0] "" Vector__XXX
 SG_ VCFRONT_a285_driverState m285 : 16|4@1+ (1,0) [0|0] "" Vector__XXX
 SG_ VCFRONT_a286_driverState m286 : 16|4@1+ (1,0) [0|0] "" Vector__XXX
 SG_ VCFRONT_a287_driverState m287 : 16|4@1+ (1,0) [0|0] "" Vector__XXX
 SG_ VCFRONT_a288_driverState m288 : 16|4@1+ (1,0) [0|0] "" Vector__XXX
 SG_ VCFRONT_a289_driverState m289 : 16|4@1+ (1,0) [0|0] "" Vector__XXX
 SG_ VCFRONT_a290_outputFaulted m290 : 16|1@1+ (1,0) [0|0] "" Vector__XXX
 SG_ VCFRONT_a291_outputFaulted m291 : 16|1@1+ (1,0) [0|0] "" Vector__XXX
 SG_ VCFRONT_a292_outputFaulted m292 : 16|1@1+ (1,0) [0|0] "" Vector__XXX
 SG_ VCFRONT_a293_outputFaulted m293 : 16|1@1+ (1,0) [0|0] "" Vector__XXX
 SG_ VCFRONT_a294_outputFaulted m294 : 16|1@1+ (1,0) [0|0] "" Vector__XXX
 SG_ VCFRONT_a295_outputFaulted m295 : 16|1@1+ (1,0) [0|0] "" Vector__XXX
 SG_ VCFRONT_a296_turnIndicatorStalkS m296 : 16|3@1+ (1,0) [0|0] "" Vector__XXX
 SG_ VCFRONT_a297_bmbDeviceId m297 : 16|4@1+ (1,1) [0|0] "" Vector__XXX
 SG_ VCFRONT_a299_LINBusy m299 : 16|1@1+ (1,0) [0|0] "" Vector__XXX
 SG_ VCFRONT_a300_oldType m300 : 16|2@1+ (1,0) [0|0] "" Vector__XXX
 SG_ VCFRONT_a302_LINFrameStatus m302 : 16|3@1+ (1,0) [0|0] "" Vector__XXX
 SG_ VCFRONT_a303_vehicleSpeed m303 : 16|12@1+ (0.08,-40) [0|0] "" Vector__XXX
 SG_ VCFRONT_a304_voltage m304 : 16|7@1+ (0.15,0) [0|0] "" Vector__XXX
 SG_ VCFRONT_a305_voltage m305 : 16|7@1+ (0.15,0) [0|0] "" Vector__XXX
 SG_ VCFRONT_a306_voltage m306 : 16|7@1+ (0.15,0) [0|0] "" Vector__XXX
 SG_ VCFRONT_a307_voltage m307 : 16|7@1+ (0.15,0) [0|0] "" Vector__XXX
 SG_ VCFRONT_a308_voltage m308 : 16|7@1+ (0.15,0) [0|0] "" Vector__XXX
 SG_ VCFRONT_a309_vehicleSpeed m309 : 16|12@1+ (0.08,-40) [0|0] "" Vector__XXX
 SG_ VCFRONT_a310_maxSlope m310 : 16|11@1+ (0.125,-40) [0|0] "" Vector__XXX
 SG_ VCFRONT_a311_maxSlope m311 : 16|11@1+ (0.125,-40) [0|0] "" Vector__XXX
 SG_ VCFRONT_a312_maxSlope m312 : 16|11@1+ (0.125,-40) [0|0] "" Vector__XXX
 SG_ VCFRONT_a313_maxSlope m313 : 16|11@1+ (0.125,-40) [0|0] "" Vector__XXX
 SG_ VCFRONT_a314_maxSlope m314 : 16|11@1+ (0.125,-40) [0|0] "" Vector__XXX
 SG_ VCFRONT_a315_maxSlope m315 : 16|11@1+ (0.125,-40) [0|0] "" Vector__XXX
 SG_ VCFRONT_a316_maxSlope m316 : 16|11@1+ (0.125,-40) [0|0] "" Vector__XXX
 SG_ VCFRONT_a317_maxSlope m317 : 16|11@1+ (0.125,-40) [0|0] "" Vector__XXX
 SG_ VCFRONT_a318_maxSlope m318 : 16|11@1+ (0.125,-40) [0|0] "" Vector__XXX
 SG_ VCFRONT_a319_maxSlope m319 : 16|11@1+ (0.125,-40) [0|0] "" Vector__XXX
 SG_ VCFRONT_a320_maxSlope m320 : 16|11@1+ (0.125,-40) [0|0] "" Vector__XXX
 SG_ VCFRONT_a321_maxSlope m321 : 16|11@1+ (0.125,-40) [0|0] "" Vector__XXX
 SG_ VCFRONT_a322_maxSlope m322 : 16|11@1+ (0.125,-40) [0|0] "" Vector__XXX
 SG_ VCFRONT_a323_maxSlope m323 : 16|11@1+ (0.125,-40) [0|0] "" Vector__XXX
 SG_ VCFRONT_a324_maxSlope m324 : 16|11@1+ (0.125,-40) [0|0] "" Vector__XXX
 SG_ VCFRONT_a325_maxSlope m325 : 16|11@1+ (0.125,-40) [0|0] "" Vector__XXX
 SG_ VCFRONT_a326_avgCurrent m326 : 16|16@1+ (0.1,0) [0|0] "" Vector__XXX
 SG_ VCFRONT_a327_avgCurrent m327 : 16|16@1+ (0.1,0) [0|0] "" Vector__XXX
 SG_ VCFRONT_a328_avgCurrent m328 : 16|16@1+ (0.1,0) [0|0] "" Vector__XXX
 SG_ VCFRONT_a329_avgCurrent m329 : 16|16@1+ (0.1,0) [0|0] "" Vector__XXX
 SG_ VCFRONT_a330_avgCurrent m330 : 16|16@1+ (0.1,0) [0|0] "" Vector__XXX
 SG_ VCFRONT_a331_avgCurrent m331 : 16|16@1+ (0.1,0) [0|0] "" Vector__XXX
 SG_ VCFRONT_a332_avgCurrent m332 : 16|16@1+ (0.1,0) [0|0] "" Vector__XXX
 SG_ VCFRONT_a333_avgCurrent m333 : 16|16@1+ (0.1,0) [0|0] "" Vector__XXX
 SG_ VCFRONT_a334_maxSlope m334 : 16|12@1+ (0.1,0) [0|0] "" Vector__XXX
 SG_ VCFRONT_a335_maxSlope m335 : 16|12@1+ (0.1,0) [0|0] "" Vector__XXX
 SG_ VCFRONT_a336_maxSlope m336 : 16|12@1+ (0.1,0) [0|0] "" Vector__XXX
 SG_ VCFRONT_a337_maxSlope m337 : 16|12@1+ (0.1,0) [0|0] "" Vector__XXX
 SG_ VCFRONT_a338_maxSlope m338 : 16|12@1+ (0.1,0) [0|0] "" Vector__XXX
 SG_ VCFRONT_a339_maxSlope m339 : 16|12@1+ (0.1,0) [0|0] "" Vector__XXX
 SG_ VCFRONT_a340_maxSlope m340 : 16|12@1+ (0.1,0) [0|0] "" Vector__XXX
 SG_ VCFRONT_a341_maxSlope m341 : 16|12@1+ (0.1,0) [0|0] "" Vector__XXX
 SG_ VCFRONT_a342_maxSlope m342 : 16|12@1+ (0.1,0) [0|0] "" Vector__XXX
 SG_ VCFRONT_a343_maxSlope m343 : 16|12@1+ (0.1,0) [0|0] "" Vector__XXX
 SG_ VCFRONT_a344_maxSlope m344 : 16|12@1+ (0.1,0) [0|0] "" Vector__XXX
 SG_ VCFRONT_a345_maxSlope m345 : 16|12@1+ (0.1,0) [0|0] "" Vector__XXX
 SG_ VCFRONT_a346_maxSlope m346 : 16|12@1+ (0.1,0) [0|0] "" Vector__XXX
 SG_ VCFRONT_a347_maxSlope m347 : 16|12@1+ (0.1,0) [0|0] "" Vector__XXX
 SG_ VCFRONT_a348_maxSlope m348 : 16|12@1+ (0.1,0) [0|0] "" Vector__XXX
 SG_ VCFRONT_a349_maxSlope m349 : 16|12@1+ (0.1,0) [0|0] "" Vector__XXX
 SG_ VCFRONT_a350_espValveCurrent m350 : 16|10@1+ (0.1,0) [0|0] "" Vector__XXX
 SG_ VCFRONT_a352_pointsAboveThreshol m352 : 16|10@1+ (1,0) [0|0] "" Vector__XXX
 SG_ VCFRONT_a353_wiperHeaterCurrent m353 : 16|8@1+ (0.1,0) [0|0] "" Vector__XXX
 SG_ VCFRONT_a354_windshieldCameraHea m354 : 16|8@1+ (0.1,0) [0|0] "" Vector__XXX
 SG_ VCFRONT_a355_fluidNotFilled m355 : 16|1@1+ (1,0) [0|0] "" Vector__XXX
 SG_ VCFRONT_a356_fluidNotFilled m356 : 16|1@1+ (1,0) [0|0] "" Vector__XXX
 SG_ VCFRONT_a357_maxTransientCurrent m357 : 16|10@1+ (0.02,0) [0|0] "" Vector__XXX
 SG_ VCFRONT_a358_maxTransientCurrent m358 : 16|10@1+ (0.05,0) [0|0] "" Vector__XXX
 SG_ VCFRONT_a359_IBSVolts m359 : 16|12@1+ (0.005443676098,0) [0|0] "" Vector__XXX
 SG_ VCFRONT_a360_vehicleLoadShedActi m360 : 16|1@1+ (1,0) [0|0] "" Vector__XXX
 SG_ VCFRONT_a363_minBleedCharge m363 : 16|15@1+ (0.001,0) [0|0] "" Vector__XXX
 SG_ VCFRONT_a364_channel m364 : 16|1@1+ (1,0) [0|0] "" Vector__XXX
 SG_ VCFRONT_a365_startSuccessful m365 : 16|1@1+ (1,0) [0|0] "" Vector__XXX
 SG_ VCFRONT_a366_enteringState m366 : 16|3@1+ (1,0) [0|0] "" Vector__XXX
 SG_ VCFRONT_a367_bmsSoc m367 : 16|8@1+ (0.5,0) [0|0] "" Vector__XXX
 SG_ VCFRONT_a368_bmsRequestRemoved m368 : 16|1@1+ (1,0) [0|0] "" Vector__XXX
 SG_ VCFRONT_a369_powerGenerationLimi m369 : 16|1@1+ (1,0) [0|0] "" Vector__XXX
 SG_ VCFRONT_a370_IBSVolts m370 : 16|12@1+ (0.005443676098,0) [0|0] "" Vector__XXX
 SG_ VCFRONT_a371_shortedCellTestTrig m371 : 16|1@1+ (1,0) [0|0] "" Vector__XXX
 SG_ VCFRONT_a372_bmbDeviceId m372 : 16|4@1+ (1,1) [0|0] "" Vector__XXX
 SG_ VCFRONT_a373_tempSuperheatActual m373 : 16|10@1+ (0.1,-20) [0|0] "" Vector__XXX
 SG_ VCFRONT_a374_lccInletSolenoidISe m374 : 16|8@1- (0.01,0) [0|0] "" Vector__XXX
 SG_ VCFRONT_a375_refVoltageScaleFact m375 : 16|12@1+ (0.1,0) [0|0] "" Vector__XXX
 SG_ VCFRONT_a376_IBSCurrentSampleCou m376 : 16|16@1+ (1,0) [0|0] "" Vector__XXX
 SG_ VCFRONT_a377_wiperStuckOutOfPark m377 : 16|1@1+ (1,0) [0|0] "" Vector__XXX
 SG_ VCFRONT_a378_wiperBlocked m378 : 16|1@1+ (1,0) [0|0] "" Vector__XXX
 SG_ VCFRONT_a379_minVoltageReached m379 : 16|12@1+ (0.005443676098,0) [0|0] "" Vector__XXX
 SG_ VCFRONT_a380_driverState m380 : 16|4@1+ (1,0) [0|0] "" Vector__XXX
 SG_ VCFRONT_a381_driverState m381 : 16|4@1+ (1,0) [0|0] "" Vector__XXX
 SG_ VCFRONT_a382_driverState m382 : 16|4@1+ (1,0) [0|0] "" Vector__XXX
 SG_ VCFRONT_a383_driverState m383 : 16|4@1+ (1,0) [0|0] "" Vector__XXX
 SG_ VCFRONT_a384_driverState m384 : 16|4@1+ (1,0) [0|0] "" Vector__XXX
 SG_ VCFRONT_a385_driverState m385 : 16|4@1+ (1,0) [0|0] "" Vector__XXX
 SG_ VCFRONT_a386_driverState m386 : 16|4@1+ (1,0) [0|0] "" Vector__XXX
 SG_ VCFRONT_a387_shortedCellFaultCou m387 : 16|3@1+ (1,0) [0|0] "" Vector__XXX
 SG_ VCFRONT_a388_shortedCellFaultCou m388 : 16|3@1+ (1,0) [0|0] "" Vector__XXX
 SG_ VCFRONT_a389_closedAtSpeed m389 : 16|1@1+ (1,0) [0|0] "" Vector__XXX
 SG_ VCFRONT_a390_cabinLoadType m390 : 16|2@1+ (1,0) [0|0] "" Vector__XXX
 SG_ VCFRONT_a391_switchMismatch m391 : 16|1@1+ (1,0) [0|0] "" Vector__XXX
 SG_ VCFRONT_a392_bmbDeviceId m392 : 16|4@1+ (1,1) [0|0] "" Vector__XXX
 SG_ VCFRONT_a394_discharge m394 : 16|1@1+ (1,0) [0|0] "" Vector__XXX
 SG_ VCFRONT_a397_discharge m397 : 16|1@1+ (1,0) [0|0] "" Vector__XXX
 SG_ VCFRONT_a400_VrefSample m400 : 16|16@1+ (0.0001,0) [0|0] "" Vector__XXX
 SG_ VCFRONT_a401_LVBatteryTemp m401 : 16|7@1+ (1,-40) [0|0] "" Vector__XXX
 SG_ VCFRONT_a402_LVBatteryTemp m402 : 16|7@1+ (1,-40) [0|0] "" Vector__XXX
 SG_ VCFRONT_a403_IBSCurrent m403 : 16|15@1- (0.005,0) [0|0] "" Vector__XXX
 SG_ VCFRONT_a404_minVoltageReached m404 : 16|12@1+ (0.005443676098,0) [0|0] "" Vector__XXX
 SG_ VCFRONT_a405_dcrMilliOhms m405 : 16|8@1+ (0.2,0) [0|0] "" Vector__XXX
 SG_ VCFRONT_a406_pulseVoltage1 m406 : 16|8@1+ (0.02,9) [0|0] "" Vector__XXX
 SG_ VCFRONT_a407_dcrMilliOhms m407 : 16|8@1+ (0.2,0) [0|0] "" Vector__XXX
 SG_ VCFRONT_a408_IBSCurrent m408 : 16|16@1- (0.005,0) [0|0] "" Vector__XXX
 SG_ VCFRONT_a409_brushlessMotorConfi m409 : 16|1@1+ (1,0) [0|0] "" Vector__XXX
 SG_ VCFRONT_a410_LVBatteryTemp m410 : 16|7@1+ (1,-40) [0|0] "" Vector__XXX
 SG_ VCFRONT_a411_LVBatteryTemp m411 : 16|7@1+ (1,-40) [0|0] "" Vector__XXX
 SG_ VCFRONT_a412_dcrMilliOhmsShifted m412 : 16|8@1+ (0.2,0) [0|0] "" Vector__XXX
 SG_ VCFRONT_a413_VrefSample m413 : 16|16@1+ (0.0001,0) [0|0] "" Vector__XXX
 SG_ VCFRONT_a414_dcrMilliOhms m414 : 16|6@1+ (1,0) [0|0] "" Vector__XXX
 SG_ VCFRONT_a415_dcrMilliOhms m415 : 16|6@1+ (1,0) [0|0] "" Vector__XXX
 SG_ VCFRONT_a416_brickVoltageMin m416 : 16|10@1+ (0.005,0) [0|0] "" Vector__XXX
 SG_ VCFRONT_a417_brickVoltageMin m417 : 16|10@1+ (0.005,0) [0|0] "" Vector__XXX
 SG_ VCFRONT_a418_brickVoltageMin m418 : 16|10@1+ (0.005,0) [0|0] "" Vector__XXX
 SG_ VCFRONT_a419_brickVoltageMin m419 : 16|10@1+ (0.005,0) [0|0] "" Vector__XXX
 SG_ VCFRONT_a420_partyTimeS m420 : 16|10@1+ (1,0) [0|0] "" Vector__XXX
 SG_ VCFRONT_a421_inFactoryMode m421 : 16|1@1+ (1,0) [0|0] "" Vector__XXX
 SG_ VCFRONT_a423_brickVoltageMin m423 : 16|10@1+ (0.005,0) [0|0] "" Vector__XXX
 SG_ VCFRONT_a424_brickVoltageMin m424 : 16|10@1+ (0.005,0) [0|0] "" Vector__XXX
 SG_ VCFRONT_a425_busVoltage m425 : 16|16@1+ (0.002,0) [0|0] "" Vector__XXX
 SG_ VCFRONT_a426_busVoltage m426 : 16|16@1+ (0.002,0) [0|0] "" Vector__XXX
 SG_ VCFRONT_a427_initialSoc m427 : 16|9@1+ (0.2,0) [0|0] "" Vector__XXX
 SG_ VCFRONT_a428_minBrickCacId m428 : 16|7@1+ (1,1) [0|0] "" Vector__XXX
 SG_ VCFRONT_a429_sohTestEndMode m429 : 16|4@1+ (1,0) [0|0] "" Vector__XXX
 SG_ VCFRONT_a430_netPackCurrent m430 : 16|16@1- (0.1,0) [0|0] "" Vector__XXX
 SG_ VCFRONT_a431_netPackCurrent m431 : 16|16@1- (0.1,0) [0|0] "" Vector__XXX
 SG_ VCFRONT_a432_targetCurrent m432 : 16|16@1- (0.1,0) [0|0] "" Vector__XXX
 SG_ VCFRONT_a433_bmbModuleId m433 : 16|16@1+ (1,0) [0|0] "" Vector__XXX
 SG_ VCFRONT_a434_bmbModuleId m434 : 16|16@1+ (1,0) [0|0] "" Vector__XXX
 SG_ VCFRONT_a435_netPackCurrent m435 : 16|16@1- (0.1,0) [0|0] "" Vector__XXX
 SG_ VCFRONT_a436_netPackCurrent m436 : 16|16@1- (0.1,0) [0|0] "" Vector__XXX
 SG_ VCFRONT_a437_nvmDataMissingA m437 : 16|1@1+ (1,0) [0|0] "" Vector__XXX
 SG_ VCFRONT_a438_temperature m438 : 16|16@1+ (0.01,0) [0|0] "" Vector__XXX
 SG_ VCFRONT_a439_temperature m439 : 16|16@1+ (0.01,0) [0|0] "" Vector__XXX
 SG_ VCFRONT_a441_bmbModuleId m441 : 16|16@1+ (1,0) [0|0] "" Vector__XXX
 SG_ VCFRONT_a442_maxSocChange m442 : 16|11@1- (0.1,0) [0|0] "" Vector__XXX
 SG_ VCFRONT_a443_bmbDeviceId m443 : 16|4@1+ (1,1) [0|0] "" Vector__XXX
 SG_ VCFRONT_a444_retriesAvailable m444 : 16|8@1+ (1,0) [0|0] "" Vector__XXX
 SG_ VCFRONT_a445_checksFailedCount m445 : 16|2@1+ (1,0) [0|0] "" Vector__XXX
 SG_ VCFRONT_a446_compFaultRefrigeran m446 : 16|1@1+ (1,0) [0|0] "" Vector__XXX
 SG_ VCFRONT_a447_caseHVACUnavailable m447 : 16|1@1+ (1,0) [0|0] "" Vector__XXX
 SG_ VCFRONT_a448_bootpCount m448 : 16|8@1+ (1,0) [0|0] "" Vector__XXX
 SG_ VCFRONT_a459_coolantFillActive m459 : 16|1@1+ (1,0) [0|0] "" Vector__XXX
 SG_ VCFRONT_a461_socByAhRaw m461 : 16|11@1+ (0.1,0) [0|0] "" Vector__XXX
 SG_ VCFRONT_a462_CellOVLevel1 m462 : 16|1@1+ (1,0) [0|0] "" Vector__XXX
 SG_ VCFRONT_a463_switchMismatch m463 : 16|1@1+ (1,0) [0|0] "" Vector__XXX
 SG_ VCFRONT_a464_flowIndex m464 : 16|8@1+ (1,0) [0|0] "" Vector__XXX
 SG_ VCFRONT_a465_flowIndex m465 : 16|8@1+ (1,0) [0|0] "" Vector__XXX
 SG_ VCFRONT_a466_flowIndex m466 : 16|8@1+ (1,0) [0|0] "" Vector__XXX
 SG_ VCFRONT_a467_powerIndexFiltered m467 : 16|7@1+ (1,0) [0|0] "" Vector__XXX
 SG_ VCFRONT_a468_powerIndexFiltered m468 : 16|7@1+ (1,0) [0|0] "" Vector__XXX
 SG_ VCFRONT_a469_pressureDischargeEs m469 : 16|8@1+ (0.2,0) [0|0] "" Vector__XXX
 SG_ VCFRONT_a470_pressureLiquid m470 : 16|8@1+ (0.2,0) [0|0] "" Vector__XXX
 SG_ VCFRONT_a472_range m472 : 16|10@1+ (1,0) [0|0] "" Vector__XXX
 SG_ VCFRONT_a473_range m473 : 16|10@1+ (1,0) [0|0] "" Vector__XXX
 SG_ VCFRONT_a474_ssl100Bank1Status m474 : 16|2@1+ (1,0) [0|0] "" Vector__XXX
 SG_ VCFRONT_a475_ssl100Bank1Status m475 : 16|2@1+ (1,0) [0|0] "" Vector__XXX
 SG_ VCFRONT_a476_FRM1_timedOut m476 : 16|1@1+ (1,0) [0|0] "" Vector__XXX
 SG_ VCFRONT_a477_cell1Voltage m477 : 16|9@1+ (0.01,0) [0|0] "" Vector__XXX
 SG_ VCFRONT_a478_battFaultPackOverVo m478 : 16|1@1+ (1,0) [0|0] "" Vector__XXX
 SG_ VCFRONT_a479_FRM3_timedOut m479 : 16|1@1+ (1,0) [0|0] "" Vector__XXX
 SG_ VCFRONT_a480_channel m480 : 16|3@1+ (1,0) [0|0] "" Vector__XXX
 SG_ VCFRONT_a481_channel m481 : 16|8@1+ (1,0) [0|0] "" Vector__XXX
 SG_ VCFRONT_a482_migrationState m482 : 16|2@1+ (1,0) [0|0] "" Vector__XXX
 SG_ VCFRONT_a483_NCV70501Fault m483 : 16|3@1+ (1,0) [0|0] "" Vector__XXX
 SG_ VCFRONT_a484_frontRideHeight m484 : 16|8@1- (1,0) [0|0] "" Vector__XXX
 SG_ VCFRONT_a485_migrationState m485 : 16|2@1+ (1,0) [0|0] "" Vector__XXX
 SG_ VCFRONT_a486_mcuGraphicsEFuseCur m486 : 16|10@1+ (0.1,0) [0|0] "" Vector__XXX
 SG_ VCFRONT_a487_lastPosition m487 : 16|10@1+ (1,0) [0|0] "" Vector__XXX
 SG_ VCFRONT_a488_NCV70501Fault m488 : 16|3@1+ (1,0) [0|0] "" Vector__XXX
 SG_ VCFRONT_a489_ChillerEXV m489 : 16|1@1+ (1,0) [0|0] "" Vector__XXX
 SG_ VCFRONT_a490_coolantPumpType m490 : 16|3@1+ (1,0) [0|0] "" Vector__XXX
 SG_ VCFRONT_a491_lastPosition m491 : 16|10@1+ (1,0) [0|0] "" Vector__XXX
 SG_ VCFRONT_a492_minBrickSocId m492 : 16|7@1+ (1,1) [0|0] "" Vector__XXX
 SG_ VCFRONT_a493_minBrickSocId m493 : 16|7@1+ (1,1) [0|0] "" Vector__XXX
 SG_ VCFRONT_a495_SoCUnrecoverable m495 : 16|1@1+ (1,0) [0|0] "" Vector__XXX
 SG_ VCFRONT_a496_reverseBatteryEFuse m496 : 16|1@1+ (1,0) [0|0] "" Vector__XXX
 SG_ VCFRONT_a497_serviceMode m497 : 16|1@1+ (1,0) [0|0] "" Vector__XXX
 SG_ VCFRONT_a498_packTemp m498 : 16|8@1+ (0.5,-20) [0|0] "" Vector__XXX
 SG_ VCFRONT_a499_maxHVBMSCellTemp m499 : 16|8@1+ (1,0) [0|0] "" Vector__XXX
 SG_ VCFRONT_a500_channel m500 : 16|8@1+ (1,0) [0|0] "" Vector__XXX
 SG_ VCFRONT_a501_channel m501 : 16|8@1+ (1,0) [0|0] "" Vector__XXX
 SG_ VCFRONT_a502_worstBrickId m502 : 16|7@1+ (1,1) [0|0] "" Vector__XXX
 SG_ VCFRONT_a503_brickVoltageMin m503 : 16|10@1+ (0.005,0) [0|0] "" Vector__XXX
 SG_ VCFRONT_a505_voltageInmV m505 : 16|16@1+ (1,0) [0|0] "" Vector__XXX
 SG_ VCFRONT_a506_superManifoldType m506 : 16|2@1+ (1,0) [0|0] "" Vector__XXX
 SG_ VCFRONT_a507_headlampAimRequestS m507 : 16|2@1+ (1,0) [0|0] "" Vector__XXX
 SG_ VCFRONT_a508_brickImpedance m508 : 16|14@1+ (2.5e-05,0) [0|0] "" Vector__XXX
 SG_ VCFRONT_a509_vcrightEFuseCurrent m509 : 16|16@1- (0.1,0) [0|0] "" Vector__XXX
 SG_ VCFRONT_a510_sumCellVoltage m510 : 16|8@1+ (0.1,0) [0|0] "" Vector__XXX
 SG_ VCFRONT_a511_PCSEFuseCurrent m511 : 16|16@1- (0.1,0) [0|0] "" Vector__XXX
 SG_ VCFRONT_a512_packVoltageInt_0000 m512 : 16|8@1+ (0.1,0) [0|0] "" Vector__XXX
 SG_ VCFRONT_a513_packCurrent m513 : 16|12@1+ (0.2,-600) [0|0] "" Vector__XXX
 SG_ VCFRONT_a514_cell1Voltage m514 : 16|7@1+ (0.08,0) [0|0] "" Vector__XXX
 SG_ VCFRONT_a515_cell1Voltage m515 : 16|7@1+ (0.08,0) [0|0] "" Vector__XXX
 SG_ VCFRONT_a516_IBSVoltage m516 : 16|8@1+ (0.1,0) [0|0] "" Vector__XXX
 SG_ VCFRONT_a517_IBSVoltage m517 : 16|8@1+ (0.1,0) [0|0] "" Vector__XXX
 SG_ VCFRONT_a518_packVoltage m518 : 16|8@1+ (0.1,0) [0|0] "" Vector__XXX
 SG_ VCFRONT_a521_vcleftEFuseCurrent m521 : 16|16@1- (0.1,0) [0|0] "" Vector__XXX
 SG_ VCFRONT_a522_IBSVoltage m522 : 16|8@1+ (0.1,0) [0|0] "" Vector__XXX
 SG_ VCFRONT_a523_channel m523 : 16|8@1+ (1,0) [0|0] "" Vector__XXX
 SG_ VCFRONT_a524_headlampAimRequestS m524 : 16|2@1+ (1,0) [0|0] "" Vector__XXX
 SG_ VCFRONT_a525_GTW_twelveVBatteryT m525 : 16|3@1+ (1,0) [0|0] "" Vector__XXX
 SG_ VCFRONT_a527_cell1Voltage m527 : 16|10@1+ (0.01,0) [0|0] "" Vector__XXX
 SG_ VCFRONT_a528_ECPAStateSNA m528 : 16|1@1+ (1,0) [0|0] "" Vector__XXX
 SG_ VCFRONT_a529_sumCellVoltage m529 : 16|8@1+ (0.1,0) [0|0] "" Vector__XXX
 SG_ VCFRONT_a530_PCSCurrent m530 : 16|16@1- (0.1,0) [0|0] "" Vector__XXX
 SG_ VCFRONT_a531_powerIndexFiltered m531 : 16|7@1+ (1,0) [0|0] "" Vector__XXX
 SG_ VCFRONT_a532_eFuseFault m532 : 16|1@1+ (1,0) [0|0] "" Vector__XXX
 SG_ VCFRONT_a533_temperature m533 : 16|16@1+ (0.01,0) [0|0] "" Vector__XXX
 SG_ VCFRONT_a534_calibrationOffset m534 : 16|8@1- (4,0) [0|0] "" Vector__XXX
 SG_ VCFRONT_a535_calibrationOffset m535 : 16|8@1- (4,0) [0|0] "" Vector__XXX
 SG_ VCFRONT_a536_calibrationOffset m536 : 16|8@1- (4,0) [0|0] "" Vector__XXX
 SG_ VCFRONT_a537_calibrationOffset m537 : 16|8@1- (4,0) [0|0] "" Vector__XXX
 SG_ VCFRONT_a538_calibrationOffset m538 : 16|8@1- (4,0) [0|0] "" Vector__XXX
 SG_ VCFRONT_a539_calibrationOffset m539 : 16|8@1- (4,0) [0|0] "" Vector__XXX
 SG_ VCFRONT_a541_PackTemperature m541 : 16|9@1+ (0.5,-50) [0|0] "" Vector__XXX
 SG_ VCFRONT_a542_dischargePressure m542 : 16|6@1+ (0.5,0) [0|0] "" Vector__XXX
 SG_ VCFRONT_a544_serviceMode m544 : 16|1@1+ (1,0) [0|0] "" Vector__XXX
 SG_ VCFRONT_a545_GTW_twelveVBatteryT m545 : 16|3@1+ (1,0) [0|0] "" Vector__XXX
 SG_ VCFRONT_a547_serviceMode m547 : 16|1@1+ (1,0) [0|0] "" Vector__XXX
 SG_ VCFRONT_a548_vehiclePowerState m548 : 16|2@1+ (1,0) [0|0] "" Vector__XXX
 SG_ VCFRONT_a551_headlampCurrent m551 : 16|8@1+ (0.1,0) [0|0] "" Vector__XXX
 SG_ VCFRONT_a552_vcrightSelfTestResu m552 : 16|4@1+ (1,0) [0|0] "" Vector__XXX
 SG_ VCFRONT_a553_headlampCurrent m553 : 16|8@1+ (0.1,0) [0|0] "" Vector__XXX
 SG_ VCFRONT_a555_cell1Voltage m555 : 16|10@1+ (0.01,0) [0|0] "" Vector__XXX
 SG_ VCFRONT_a556_factoryMode m556 : 16|1@1+ (1,0) [0|0] "" Vector__XXX
 SG_ VCFRONT_a558_aimedVerticalPositi m558 : 16|10@1+ (1,0) [0|0] "" Vector__XXX
 SG_ VCFRONT_a559_SOC m559 : 16|7@1+ (1,0) [0|0] "" Vector__XXX
 SG_ VCFRONT_a560_highSHCOP1 m560 : 16|1@1+ (1,0) [0|0] "" Vector__XXX
 SG_ VCFRONT_a561_efuseTemperature m561 : 16|5@1+ (4,0) [0|0] "" Vector__XXX
 SG_ VCFRONT_a562_efuseTemperature m562 : 16|5@1+ (4,0) [0|0] "" Vector__XXX
 SG_ VCFRONT_a564_aimedVerticalPositi m564 : 16|10@1+ (1,0) [0|0] "" Vector__XXX
 SG_ VCFRONT_a565_userPresenceState m565 : 16|2@1+ (1,0) [0|0] "" Vector__XXX
 SG_ VCFRONT_a572_hvacCompressorCurre m572 : 16|16@1+ (0.1,0) [0|0] "" Vector__XXX
 SG_ VCFRONT_a573_radarCurrent m573 : 16|16@1+ (0.1,0) [0|0] "" Vector__XXX
 SG_ VCFRONT_a574_frontDriveInverterC m574 : 16|16@1+ (0.1,0) [0|0] "" Vector__XXX
 SG_ VCFRONT_a575_frontOilPumpCurrent m575 : 16|16@1+ (0.1,0) [0|0] "" Vector__XXX
 SG_ VCFRONT_a576_mcuLogicCurrent m576 : 16|16@1+ (0.1,0) [0|0] "" Vector__XXX
 SG_ VCFRONT_a577_tasCurrent m577 : 16|16@1+ (0.1,0) [0|0] "" Vector__XXX
 SG_ VCFRONT_a578_vbatFusedLowCurrent m578 : 16|16@1+ (0.1,0) [0|0] "" Vector__XXX
 SG_ VCFRONT_a579_leftHeadlightCurren m579 : 16|16@1+ (0.1,0) [0|0] "" Vector__XXX
 SG_ VCFRONT_a580_rightHeadlightCurre m580 : 16|16@1+ (0.1,0) [0|0] "" Vector__XXX
 SG_ VCFRONT_a581_windshieldWiperCurr m581 : 16|16@1+ (0.1,0) [0|0] "" Vector__XXX
 SG_ VCFRONT_a582_batterySMState m582 : 16|4@1+ (1,0) [0|0] "" Vector__XXX
 SG_ VCFRONT_a583_shadowSwitchGroupSt m583 : 16|2@1+ (1,0) [0|0] "" Vector__XXX
 SG_ VCFRONT_a584_frunkSwitchGroupSta m584 : 16|2@1+ (1,0) [0|0] "" Vector__XXX
 SG_ VCFRONT_a585_leftHeadlampInterna m585 : 16|20@1+ (1,0) [0|0] "" Vector__XXX
 SG_ VCFRONT_a587_factoryMode m587 : 16|1@1+ (1,0) [0|0] "" Vector__XXX
 SG_ VCFRONT_a588_vcleftEFuseCurveTyp m588 : 16|1@1+ (1,0) [0|0] "" Vector__XXX
 SG_ VCFRONT_a589_vcleftEFuseFastBlow m589 : 16|1@1+ (1,0) [0|0] "" Vector__XXX
 SG_ VCFRONT_a590_vcrightEFuseCurveTy m590 : 16|1@1+ (1,0) [0|0] "" Vector__XXX
 SG_ VCFRONT_a591_vcrightEFuseFastBlo m591 : 16|1@1+ (1,0) [0|0] "" Vector__XXX
 SG_ VCFRONT_a592_vcleftCutoffEFuseCu m592 : 16|1@1+ (1,0) [0|0] "" Vector__XXX
 SG_ VCFRONT_a593_vcleftCutoffEFuseFa m593 : 16|1@1+ (1,0) [0|0] "" Vector__XXX
 SG_ VCFRONT_a594_maxOffsetFusionSess m594 : 16|8@1- (0.001,0) [0|0] "" Vector__XXX
 SG_ VCFRONT_a595_factoryMode m595 : 16|1@1+ (1,0) [0|0] "" Vector__XXX
 SG_ VCFRONT_a596_vcrightCutoffEFuseC m596 : 16|1@1+ (1,0) [0|0] "" Vector__XXX
 SG_ VCFRONT_a597_vcrightCutoffEFuseF m597 : 16|1@1+ (1,0) [0|0] "" Vector__XXX
 SG_ VCFRONT_a598_vcleftSelfTestResul m598 : 16|4@1+ (1,0) [0|0] "" Vector__XXX
 SG_ VCFRONT_a599_GTW_twelveVBatteryT m599 : 16|3@1+ (1,0) [0|0] "" Vector__XXX
 SG_ VCFRONT_a600_factoryMode m600 : 16|1@1+ (1,0) [0|0] "" Vector__XXX
 SG_ VCFRONT_a601_firstPurgeRequestTi m601 : 16|32@1+ (1,0) [0|0] "" Vector__XXX
 SG_ VCFRONT_a605_vbatProtVoltage m605 : 16|10@1+ (0.1,0) [0|0] "" Vector__XXX
 SG_ VCFRONT_a606_expectedQChillerVer m606 : 16|1@1+ (1,0) [0|0] "" Vector__XXX
 SG_ VCFRONT_a607_avgSleepBypassCurre m607 : 16|10@1+ (0.01,0) [0|0] "" Vector__XXX
 SG_ VCFRONT_a608_deltaV m608 : 16|16@1+ (0.0001,0) [0|0] "" Vector__XXX
 SG_ VCFRONT_a609_driverPresent m609 : 16|1@1+ (1,0) [0|0] "" Vector__XXX
 SG_ VCFRONT_a610_switch1State m610 : 16|2@1+ (1,0) [0|0] "" Vector__XXX
 SG_ VCFRONT_a611_isCoolantModeSeries m611 : 16|1@1+ (1,0) [0|0] "" Vector__XXX
 SG_ VCFRONT_a612_DI_gear m612 : 16|3@1+ (1,0) [0|0] "" Vector__XXX
 SG_ VCFRONT_a614_finalState m614 : 16|3@1+ (1,0) [0|0] "" Vector__XXX
 SG_ VCFRONT_a615_heaterCurrent m615 : 16|9@1- (0.25,0) [0|0] "" Vector__XXX
 SG_ VCFRONT_a618_ambientTemp m618 : 16|6@1+ (1,0) [0|0] "" Vector__XXX
 SG_ VCFRONT_a619_switch1State m619 : 16|2@1+ (1,0) [0|0] "" Vector__XXX
 SG_ VCFRONT_a623_DI_gear m623 : 16|3@1+ (1,0) [0|0] "" Vector__XXX
 SG_ VCFRONT_a626_dcrMilliOhms m626 : 16|8@1+ (0.2,0) [0|0] "" Vector__XXX
 SG_ VCFRONT_a627_cell1Voltage m627 : 16|9@1+ (0.01,0) [0|0] "" Vector__XXX
 SG_ VCFRONT_a628_thermistorId m628 : 16|3@1+ (1,1) [0|0] "" Vector__XXX
 SG_ VCFRONT_a630_faultBitfield m630 : 16|32@1+ (1,0) [0|0] "" Vector__XXX
 SG_ VCFRONT_a631_faultBitfield m631 : 16|32@1+ (1,0) [0|0] "" Vector__XXX
 SG_ VCFRONT_a634_ajar1OpeningDeltaV m634 : 16|10@1- (0.01,0) [0|0] "" Vector__XXX
 SG_ VCFRONT_a635_sleepRequest m635 : 16|1@1+ (1,0) [0|0] "" Vector__XXX
 SG_ VCFRONT_a643_inFactoryMode m643 : 16|1@1+ (1,0) [0|0] "" Vector__XXX
 SG_ VCFRONT_a644_washPumpChannel m644 : 16|4@1+ (1,0) [0|0] "" Vector__XXX
 SG_ VCFRONT_a645_washPumpChannel m645 : 16|4@1+ (1,0) [0|0] "" Vector__XXX
 SG_ VCFRONT_a646_washPumpChannel m646 : 16|4@1+ (1,0) [0|0] "" Vector__XXX
 SG_ VCFRONT_a649_vehicleLoadShedding m649 : 16|1@1+ (1,0) [0|0] "" Vector__XXX
 SG_ VCFRONT_a661_headlampCurrentFilt m661 : 16|10@1+ (0.027,0) [0|0] "" Vector__XXX
 SG_ VCFRONT_a662_headlampCurrentFilt m662 : 16|10@1+ (0.027,0) [0|0] "" Vector__XXX
 SG_ VCFRONT_a663_hcmlUartDmaQueueHig m663 : 16|5@1+ (3.225806451612903,0) [0|0] "" Vector__XXX
 SG_ VCFRONT_a664_hcmrUartDmaQueueHig m664 : 16|5@1+ (3.225806451612903,0) [0|0] "" Vector__XXX
 SG_ VCFRONT_a665_retryChannel m665 : 16|4@1+ (1,0) [0|0] "" Vector__XXX
 SG_ VCFRONT_a666_retryChannel m666 : 16|4@1+ (1,0) [0|0] "" Vector__XXX
 SG_ VCFRONT_a667_hcmRegionAndSide m667 : 16|3@1+ (1,0) [0|0] "" Vector__XXX
 SG_ VCFRONT_a668_hcmRegionAndSide m668 : 16|3@1+ (1,0) [0|0] "" Vector__XXX
 SG_ VCFRONT_a669_isEnforced m669 : 16|1@1+ (1,0) [0|0] "" Vector__XXX
 SG_ VCFRONT_a670_packVoltage m670 : 16|10@1+ (0.05,0) [0|0] "" Vector__XXX
 SG_ VCFRONT_a697_isGlobalHeadlamps m697 : 16|1@1+ (1,0) [0|0] "" Vector__XXX
 SG_ VCFRONT_a698_isGlobalHeadlamps m698 : 16|1@1+ (1,0) [0|0] "" Vector__XXX
 SG_ VCFRONT_alertState : 15|1@1+ (1,0) [0|0] "" Vector__XXX
 SG_ VCFRONT_alertID M : 0|10@1+ (1,0) [0|0] "" Vector__XXX

BO_ 1334 FC_evseBilling2: 8 Vector__XXX
 SG_ FC_evseBillingEnergyHighRes m0 : 8|24@1+ (0.0001,0) [0|0] "" Vector__XXX
 SG_ FC_evsePpuEnabled m0 : 4|1@1+ (1,0) [0|0] "" Vector__XXX
 SG_ FC_evseBilling2DataSelect M : 0|4@1+ (1,0) [0|0] "" Vector__XXX

VAL_ 1332 VCFRONT_a611_tempAmbientRaw 0 "SNA" ;
VAL_ 1332 VCFRONT_a476_serviceMode 0 "DISABLED" 1 "ENABLED" ;
VAL_ 1332 VCFRONT_a548_hvState 0 "DOWN" 1 "COMING_UP" 2 "GOING_DOWN" 3 "UP_FOR_DRIVE" 4 "UP_FOR_CHARGE" 5 "UP_FOR_DC_CHARGE" 6 "UP" ;
VAL_ 1332 VCFRONT_a171_PM 4095 "SNA" ;
VAL_ 1332 VCFRONT_a195_serviceMode 0 "DISABLED" 1 "ENABLED" ;
VAL_ 1332 VCFRONT_a248_IBSVoltage 4095 "SNA" ;
VAL_ 1332 VCFRONT_a476_factoryMode 0 "DISABLED" 1 "ENABLED" ;
VAL_ 1332 VCFRONT_a479_vehiclePowerState 0 "OFF" 1 "CONDITIONING" 2 "ACCESSORY" 3 "DRIVE" ;
VAL_ 1332 VCFRONT_a587_LVBMS_packCurrent 4294934528 "SNA" ;
VAL_ 1332 VCFRONT_a595_LVBMS_packVoltage 65535 "SNA" ;
VAL_ 1332 VCFRONT_a600_LVBMS_packCurrent 4294934528 "SNA" ;
VAL_ 1332 VCFRONT_a104_PARTY_status 0 "DISABLED" 1 "ENABLED" 2 "TEMPORARY_FAILURE" 3 "SNA" ;
VAL_ 1332 VCFRONT_a110_CH_airbagCutoffStat 0 "RCM_PASSENGER_AIRBAG_ENABLED" 1 "RCM_PASSENGER_AIRBAG_DISABLED" 3 "SNA" ;
VAL_ 1332 VCFRONT_a111_CH_status 0 "DISABLED" 1 "ENABLED" 2 "TEMPORARY_FAILURE" 3 "SNA" ;
VAL_ 1332 VCFRONT_a120_PT_systemStatus 0 "UNKNOWN" 1 "RELEASED" 2 "PARKED" 3 "DYNAMIC" 4 "PARKING" 5 "RELEASING" 6 "FAULT" 7 "FAULT_SECURE" 8 "MISMATCH" ;
VAL_ 1332 VCFRONT_a182_transportMode 0 "DISABLED" 1 "ENABLED" ;
VAL_ 1332 VCFRONT_a183_transportMode 0 "DISABLED" 1 "ENABLED" ;
VAL_ 1332 VCFRONT_a525_serviceMode 0 "DISABLED" 1 "ENABLED" ;
VAL_ 1332 VCFRONT_a599_serviceMode 0 "DISABLED" 1 "ENABLED" ;
VAL_ 1332 VCFRONT_a104_CH_status 0 "DISABLED" 1 "ENABLED" 2 "TEMPORARY_FAILURE" 3 "SNA" ;
VAL_ 1332 VCFRONT_a109_BDY_status 0 "DISABLED" 1 "ENABLED" 2 "TEMPORARY_FAILURE" 3 "SNA" ;
VAL_ 1332 VCFRONT_a111_PARTY_status 0 "DISABLED" 1 "ENABLED" 2 "TEMPORARY_FAILURE" 3 "SNA" ;
VAL_ 1332 VCFRONT_a112_CH_status 0 "DISABLED" 1 "ENABLED" 2 "TEMPORARY_FAILURE" 3 "SNA" ;
VAL_ 1332 VCFRONT_a182_serviceMode 0 "DISABLED" 1 "ENABLED" ;
VAL_ 1332 VCFRONT_a183_serviceMode 0 "DISABLED" 1 "ENABLED" ;
VAL_ 1332 VCFRONT_a249_tempCoolantPTInlet 2047 "SNA" ;
VAL_ 1332 VCFRONT_a527_cell2Voltage 65535 "SNA" ;
VAL_ 1332 VCFRONT_a555_cell2Voltage 65535 "SNA" ;
VAL_ 1332 VCFRONT_a112_PARTY_status 0 "DISABLED" 1 "ENABLED" 2 "TEMPORARY_FAILURE" 3 "SNA" ;
VAL_ 1332 VCFRONT_a118_VEH_systemStatus 0 "UNKNOWN" 1 "RELEASED" 2 "PARKED" 3 "DYNAMIC" 4 "PARKING" 5 "RELEASING" 6 "FAULT" 7 "FAULT_SECURE" 8 "MISMATCH" ;
VAL_ 1332 VCFRONT_a120_PARTY_status 0 "DISABLED" 1 "ENABLED" 2 "TEMPORARY_FAILURE" 3 "SNA" ;
VAL_ 1332 VCFRONT_a182_factoryMode 0 "DISABLED" 1 "ENABLED" ;
VAL_ 1332 VCFRONT_a183_factoryMode 0 "DISABLED" 1 "ENABLED" ;
VAL_ 1332 VCFRONT_a191_IBSVoltage 4095 "SNA" ;
VAL_ 1332 VCFRONT_a477_cell2Voltage 65535 "SNA" ;
VAL_ 1332 VCFRONT_a627_cell2Voltage 65535 "SNA" ;
VAL_ 1332 VCFRONT_a196_batterySMState 0 "INIT" 1 "CHARGE" 2 "DISCHARGE" 3 "STANDBY" 4 "RESISTANCE_ESTIMATION" 5 "OTA_STANDBY" 6 "DISCONNECTED_BATTERY_TEST" 7 "SHORTED_CELL_TEST" 8 "FAULT" 9 "RECOVERY" ;
VAL_ 1332 VCFRONT_a402_batterySMState 0 "INIT" 1 "CHARGE" 2 "DISCHARGE" 3 "STANDBY" 4 "RESISTANCE_ESTIMATION" 5 "OTA_STANDBY" 6 "DISCONNECTED_BATTERY_TEST" 7 "SHORTED_CELL_TEST" 8 "FAULT" 9 "RECOVERY" ;
VAL_ 1332 VCFRONT_a407_dcr12VThreshold 0 "OFF" 1 "40_MILLIOHMS" 2 "35_MILLIOHMS" 3 "30_MILLIOHMS" 4 "27_MILLIOHMS" 5 "24_MILLIOHMS" 6 "22_MILLIOHMS" 7 "20_MILLIOHMS" ;
VAL_ 1332 VCFRONT_a478_batterySMState 0 "INIT" 1 "CHARGE" 2 "DISCHARGE" 3 "STANDBY" 4 "RESISTANCE_ESTIMATION" 5 "OTA_STANDBY" 6 "DISCONNECTED_BATTERY_TEST" 7 "SHORTED_CELL_TEST" 8 "FAULT" 9 "RECOVERY" ;
VAL_ 1332 VCFRONT_a479_frunkLatchStatus 0 "SNA" 1 "OPENED" 2 "CLOSED" 3 "CLOSING" 4 "OPENING" 5 "AJAR" 6 "TIMEOUT" 7 "DEFAULT" 8 "FAULT" ;
VAL_ 1332 VCFRONT_a483_headlampTemperature 31 "SNA" ;
VAL_ 1332 VCFRONT_a484_rearRideHeight 4294967168 "SNA" ;
VAL_ 1332 VCFRONT_a488_headlampTemperature 31 "SNA" ;
VAL_ 1332 VCFRONT_a495_serviceMode 0 "DISABLED" 1 "ENABLED" ;
VAL_ 1332 VCFRONT_a497_SOC 127 "SNA" ;
VAL_ 1332 VCFRONT_a510_packVoltage 65535 "SNA" ;
VAL_ 1332 VCFRONT_a518_IBSVoltage 4095 "SNA" ;
VAL_ 1332 VCFRONT_a587_batterySMState 0 "INIT" 1 "CHARGE" 2 "DISCHARGE" 3 "STANDBY" 4 "RESISTANCE_ESTIMATION" 5 "OTA_STANDBY" 6 "DISCONNECTED_BATTERY_TEST" 7 "SHORTED_CELL_TEST" 8 "FAULT" 9 "RECOVERY" ;
VAL_ 1332 VCFRONT_a595_batterySMState 0 "INIT" 1 "CHARGE" 2 "DISCHARGE" 3 "STANDBY" 4 "RESISTANCE_ESTIMATION" 5 "OTA_STANDBY" 6 "DISCONNECTED_BATTERY_TEST" 7 "SHORTED_CELL_TEST" 8 "FAULT" 9 "RECOVERY" ;
VAL_ 1332 VCFRONT_a600_batterySMState 0 "INIT" 1 "CHARGE" 2 "DISCHARGE" 3 "STANDBY" 4 "RESISTANCE_ESTIMATION" 5 "OTA_STANDBY" 6 "DISCONNECTED_BATTERY_TEST" 7 "SHORTED_CELL_TEST" 8 "FAULT" 9 "RECOVERY" ;
VAL_ 1332 VCFRONT_a107_PT_status 0 "DISABLED" 1 "ENABLED" 2 "TEMPORARY_FAILURE" 3 "SNA" ;
VAL_ 1332 VCFRONT_a514_cell2Voltage 65535 "SNA" ;
VAL_ 1332 VCFRONT_a515_cell2Voltage 65535 "SNA" ;
VAL_ 1332 VCFRONT_a669_hvState 0 "DOWN" 1 "COMING_UP" 2 "GOING_DOWN" 3 "UP_FOR_DRIVE" 4 "UP_FOR_CHARGE" 5 "UP_FOR_DC_CHARGE" 6 "UP" ;
VAL_ 1332 VCFRONT_a086_VEH_systemStatus 0 "UNKNOWN" 1 "RELEASED" 2 "PARKED" 3 "DYNAMIC" 4 "PARKING" 5 "RELEASING" 6 "FAULT" 7 "FAULT_SECURE" 8 "MISMATCH" ;
VAL_ 1332 VCFRONT_a098_PARTY_status 0 "DISABLED" 1 "ENABLED" 2 "TEMPORARY_FAILURE" 3 "SNA" ;
VAL_ 1332 VCFRONT_a108_PARTY_status 0 "DISABLED" 1 "ENABLED" 2 "TEMPORARY_FAILURE" 3 "SNA" ;
VAL_ 1332 VCFRONT_a114_VEH_status 0 "DISABLED" 1 "ENABLED" 2 "TEMPORARY_FAILURE" 3 "SNA" ;
VAL_ 1332 VCFRONT_a545_serviceMode 0 "DISABLED" 1 "ENABLED" ;
VAL_ 1332 VCFRONT_a087_PARTY_status 0 "DISABLED" 1 "ENABLED" 2 "TEMPORARY_FAILURE" 3 "SNA" ;
VAL_ 1332 VCFRONT_a088_PARTY_status 0 "DISABLED" 1 "ENABLED" 2 "TEMPORARY_FAILURE" 3 "SNA" ;
VAL_ 1332 VCFRONT_a089_CH_status 0 "DISABLED" 1 "ENABLED" 2 "TEMPORARY_FAILURE" 3 "SNA" ;
VAL_ 1332 VCFRONT_a478_vehiclePowerState 0 "OFF" 1 "CONDITIONING" 2 "ACCESSORY" 3 "DRIVE" ;
VAL_ 1332 VCFRONT_a479_transportMode 0 "DISABLED" 1 "ENABLED" ;
VAL_ 1332 VCFRONT_a548_DI_gear 0 "INVALID" 1 "P" 2 "R" 3 "N" 4 "D" 7 "SNA" ;
VAL_ 1332 VCFRONT_a561_packTemperature 511 "SNA" ;
VAL_ 1332 VCFRONT_a562_packTemperature 511 "SNA" ;
VAL_ 1332 VCFRONT_a587_vehiclePowerState 0 "OFF" 1 "CONDITIONING" 2 "ACCESSORY" 3 "DRIVE" ;
VAL_ 1332 VCFRONT_a669_vehiclePowerState 0 "OFF" 1 "CONDITIONING" 2 "ACCESSORY" 3 "DRIVE" ;
VAL_ 1332 VCFRONT_a089_BDY_status 0 "DISABLED" 1 "ENABLED" 2 "TEMPORARY_FAILURE" 3 "SNA" ;
VAL_ 1332 VCFRONT_a103_PT_status 0 "DISABLED" 1 "ENABLED" 2 "TEMPORARY_FAILURE" 3 "SNA" ;
VAL_ 1332 VCFRONT_a108_VEH_status 0 "DISABLED" 1 "ENABLED" 2 "TEMPORARY_FAILURE" 3 "SNA" ;
VAL_ 1332 VCFRONT_a109_VEH_status 0 "DISABLED" 1 "ENABLED" 2 "TEMPORARY_FAILURE" 3 "SNA" ;
VAL_ 1332 VCFRONT_a196_vehiclePowerState 0 "OFF" 1 "CONDITIONING" 2 "ACCESSORY" 3 "DRIVE" ;
VAL_ 1332 VCFRONT_a479_serviceMode 0 "DISABLED" 1 "ENABLED" ;
VAL_ 1332 VCFRONT_a496_serviceMode 0 "DISABLED" 1 "ENABLED" ;
VAL_ 1332 VCFRONT_a556_vehiclePowerState 0 "OFF" 1 "CONDITIONING" 2 "ACCESSORY" 3 "DRIVE" ;
VAL_ 1332 VCFRONT_a595_vehiclePowerState 0 "OFF" 1 "CONDITIONING" 2 "ACCESSORY" 3 "DRIVE" ;
VAL_ 1332 VCFRONT_a600_vehiclePowerState 0 "OFF" 1 "CONDITIONING" 2 "ACCESSORY" 3 "DRIVE" ;
VAL_ 1332 VCFRONT_a612_vehicleSpeed 8191 "SNA" ;
VAL_ 1332 VCFRONT_a623_vehicleSpeed 8191 "SNA" ;
VAL_ 1332 VCFRONT_a087_VEH_status 0 "DISABLED" 1 "ENABLED" 2 "TEMPORARY_FAILURE" 3 "SNA" ;
VAL_ 1332 VCFRONT_a088_VEH_status 0 "DISABLED" 1 "ENABLED" 2 "TEMPORARY_FAILURE" 3 "SNA" ;
VAL_ 1332 VCFRONT_a118_VEH_status 0 "DISABLED" 1 "ENABLED" 2 "TEMPORARY_FAILURE" 3 "SNA" ;
VAL_ 1332 VCFRONT_a120_PARTY_systemStatus 0 "UNKNOWN" 1 "RELEASED" 2 "PARKED" 3 "DYNAMIC" 4 "PARKING" 5 "RELEASING" 6 "FAULT" 7 "FAULT_SECURE" 8 "MISMATCH" ;
VAL_ 1332 VCFRONT_a178_compressorState 0 "STANDBY" 1 "READY" 2 "RUNNING" 3 "FAULT" ;
VAL_ 1332 VCFRONT_a389_vehicleSpeed 8191 "SNA" ;
VAL_ 1332 VCFRONT_a479_factoryMode 0 "DISABLED" 1 "ENABLED" ;
VAL_ 1332 VCFRONT_a528_serviceMode 0 "DISABLED" 1 "ENABLED" ;
VAL_ 1332 VCFRONT_a032_watchdogState 0 "UNKNOWN" 1 "DEGRADED" 2 "CRITICAL" 3 "HEALTHY" 7 "SNA" ;
VAL_ 1332 VCFRONT_a086_VEH_status 0 "DISABLED" 1 "ENABLED" 2 "TEMPORARY_FAILURE" 3 "SNA" ;
VAL_ 1332 VCFRONT_a089_VEH_status 0 "DISABLED" 1 "ENABLED" 2 "TEMPORARY_FAILURE" 3 "SNA" ;
VAL_ 1332 VCFRONT_a091_VEH_state 0 "STANDBY" 1 "DRIVE" 2 "SUPPORT" 3 "CHARGE" 4 "FEIM" 5 "CLEAR_FAULT" 6 "FAULT" 7 "WELD" 8 "TEST" 9 "SNA" 10 "DIAG" ;
VAL_ 1332 VCFRONT_a098_VEH_status 0 "DISABLED" 1 "ENABLED" 2 "TEMPORARY_FAILURE" 3 "SNA" ;
VAL_ 1332 VCFRONT_a103_VEH_status 0 "DISABLED" 1 "ENABLED" 2 "TEMPORARY_FAILURE" 3 "SNA" ;
VAL_ 1332 VCFRONT_a107_VEH_status 0 "DISABLED" 1 "ENABLED" 2 "TEMPORARY_FAILURE" 3 "SNA" ;
VAL_ 1332 VCFRONT_a163_compressorType 0 "HANON_33CC" 1 "DENSO_41CC_8K" 2 "DENSO_41CC_11K" 3 "SANDEN" 4 "DENSO_11K_COP1_ENABLED" ;
VAL_ 1332 VCFRONT_a180_hvState 0 "DOWN" 1 "COMING_UP" 2 "GOING_DOWN" 3 "UP_FOR_DRIVE" 4 "UP_FOR_CHARGE" 5 "UP_FOR_DC_CHARGE" 6 "UP" ;
VAL_ 1332 VCFRONT_a191_hvState 0 "DOWN" 1 "COMING_UP" 2 "GOING_DOWN" 3 "UP_FOR_DRIVE" 4 "UP_FOR_CHARGE" 5 "UP_FOR_DC_CHARGE" 6 "UP" ;
VAL_ 1332 VCFRONT_a192_hvState 0 "DOWN" 1 "COMING_UP" 2 "GOING_DOWN" 3 "UP_FOR_DRIVE" 4 "UP_FOR_CHARGE" 5 "UP_FOR_DC_CHARGE" 6 "UP" ;
VAL_ 1332 VCFRONT_a196_transportMode 0 "DISABLED" 1 "ENABLED" ;
VAL_ 1332 VCFRONT_a496_MOSState 0 "OPEN" 1 "CLOSED" 2 "INVALID" 3 "SNA" ;
VAL_ 1332 VCFRONT_a556_transportMode 0 "DISABLED" 1 "ENABLED" ;
VAL_ 1332 VCFRONT_a587_transportMode 0 "DISABLED" 1 "ENABLED" ;
VAL_ 1332 VCFRONT_a595_transportMode 0 "DISABLED" 1 "ENABLED" ;
VAL_ 1332 VCFRONT_a600_transportMode 0 "DISABLED" 1 "ENABLED" ;
VAL_ 1332 VCFRONT_a089_PARTY_status 0 "DISABLED" 1 "ENABLED" 2 "TEMPORARY_FAILURE" 3 "SNA" ;
VAL_ 1332 VCFRONT_a090_VEH_state 0 "STANDBY" 1 "DRIVE" 2 "SUPPORT" 3 "CHARGE" 4 "FEIM" 5 "CLEAR_FAULT" 6 "FAULT" 7 "WELD" 8 "TEST" 9 "SNA" 10 "DIAG" ;
VAL_ 1332 VCFRONT_a095_PT_status 0 "DISABLED" 1 "ENABLED" 2 "TEMPORARY_FAILURE" 3 "SNA" ;
VAL_ 1332 VCFRONT_a096_CH_status 0 "DISABLED" 1 "ENABLED" 2 "TEMPORARY_FAILURE" 3 "SNA" ;
VAL_ 1332 VCFRONT_a097_VEH_state 0 "STANDBY" 1 "DRIVE" 2 "SUPPORT" 3 "CHARGE" 4 "FEIM" 5 "CLEAR_FAULT" 6 "FAULT" 7 "WELD" 8 "TEST" 9 "SNA" 10 "DIAG" ;
VAL_ 1332 VCFRONT_a111_VEH_status 0 "DISABLED" 1 "ENABLED" 2 "TEMPORARY_FAILURE" 3 "SNA" ;
VAL_ 1332 VCFRONT_a112_VEH_status 0 "DISABLED" 1 "ENABLED" 2 "TEMPORARY_FAILURE" 3 "SNA" ;
VAL_ 1332 VCFRONT_a120_VEH_systemStatus 0 "UNKNOWN" 1 "RELEASED" 2 "PARKED" 3 "DYNAMIC" 4 "PARKING" 5 "RELEASING" 6 "FAULT" 7 "FAULT_SECURE" 8 "MISMATCH" ;
VAL_ 1332 VCFRONT_a196_serviceMode 0 "DISABLED" 1 "ENABLED" ;
VAL_ 1332 VCFRONT_a216_hvState 0 "DOWN" 1 "COMING_UP" 2 "GOING_DOWN" 3 "UP_FOR_DRIVE" 4 "UP_FOR_CHARGE" 5 "UP_FOR_DC_CHARGE" 6 "UP" ;
VAL_ 1332 VCFRONT_a479_ECPAState 0 "OPEN" 1 "CLOSED" 2 "INVALID" 3 "SNA" ;
VAL_ 1332 VCFRONT_a556_serviceMode 0 "DISABLED" 1 "ENABLED" ;
VAL_ 1332 VCFRONT_a587_serviceMode 0 "DISABLED" 1 "ENABLED" ;
VAL_ 1332 VCFRONT_a595_serviceMode 0 "DISABLED" 1 "ENABLED" ;
VAL_ 1332 VCFRONT_a600_serviceMode 0 "DISABLED" 1 "ENABLED" ;
VAL_ 1332 VCFRONT_a609_vehiclePowerState 0 "OFF" 1 "CONDITIONING" 2 "ACCESSORY" 3 "DRIVE" ;
VAL_ 1332 VCFRONT_a031_uds_bytes_0 0 "0" 1 "1" 2 "2" 3 "3" 4 "4" 5 "5" 6 "6" 7 "7" 8 "8" 9 "9" 10 "10" 11 "11" 12 "12" 13 "13" 14 "14" 15 "15" 16 "16" 17 "17" 18 "18" 19 "19" 20 "20" 21 "21" 22 "22" 23 "23" 24 "24" 25 "25" 26 "26" 27 "27" 28 "28" 29 "29" 30 "30" 31 "31" ;
VAL_ 1332 VCFRONT_a096_VEH_status 0 "DISABLED" 1 "ENABLED" 2 "TEMPORARY_FAILURE" 3 "SNA" ;
VAL_ 1332 VCFRONT_a101_VEH_state 0 "STANDBY" 1 "DRIVE" 2 "SUPPORT" 3 "CHARGE" 4 "FEIM" 5 "CLEAR_FAULT" 6 "FAULT" 7 "WELD" 8 "TEST" 9 "SNA" 10 "DIAG" ;
VAL_ 1332 VCFRONT_a109_PARTY_status 0 "DISABLED" 1 "ENABLED" 2 "TEMPORARY_FAILURE" 3 "SNA" ;
VAL_ 1332 VCFRONT_a110_VEH_status 0 "DISABLED" 1 "ENABLED" 2 "TEMPORARY_FAILURE" 3 "SNA" ;
VAL_ 1332 VCFRONT_a114_PARTY_status 0 "DISABLED" 1 "ENABLED" 2 "TEMPORARY_FAILURE" 3 "SNA" ;
VAL_ 1332 VCFRONT_a180_vehiclePowerState 0 "OFF" 1 "CONDITIONING" 2 "ACCESSORY" 3 "DRIVE" ;
VAL_ 1332 VCFRONT_a191_vehiclePowerState 0 "OFF" 1 "CONDITIONING" 2 "ACCESSORY" 3 "DRIVE" ;
VAL_ 1332 VCFRONT_a192_vehiclePowerState 0 "OFF" 1 "CONDITIONING" 2 "ACCESSORY" 3 "DRIVE" ;
VAL_ 1332 VCFRONT_a195_IBSVoltage 4095 "SNA" ;
VAL_ 1332 VCFRONT_a196_factoryMode 0 "DISABLED" 1 "ENABLED" ;
VAL_ 1332 VCFRONT_a248_AS8510Voltage 4095 "SNA" ;
VAL_ 1332 VCFRONT_a249_tempCoolantBatInlet 1023 "SNA" ;
VAL_ 1332 VCFRONT_a252_IBSVoltage 4095 "SNA" ;
VAL_ 1332 VCFRONT_a259_serviceMode 0 "DISABLED" 1 "ENABLED" ;
VAL_ 1332 VCFRONT_a296_turnIndicatorStalkS 0 "IDLE" 1 "UP_0_5" 2 "UP_1" 3 "UP_1_5" 4 "UP_2" 5 "DOWN_0_5" 6 "DOWN_1" 7 "DOWN_1_5" 8 "DOWN_2" 9 "SNA" ;
VAL_ 1332 VCFRONT_a303_vehicleSpeed 8191 "SNA" ;
VAL_ 1332 VCFRONT_a309_vehicleSpeed 8191 "SNA" ;
VAL_ 1332 VCFRONT_a373_tempSuperheatActual 1023 "SNA" ;
VAL_ 1332 VCFRONT_a477_cell1Voltage 65535 "SNA" ;
VAL_ 1332 VCFRONT_a484_frontRideHeight 4294967168 "SNA" ;
VAL_ 1332 VCFRONT_a490_coolantPumpType 0 "DUAL" 1 "SINGLE_PUMP_BATT" 2 "DUAL_SAN_P4" ;
VAL_ 1332 VCFRONT_a497_serviceMode 0 "DISABLED" 1 "ENABLED" ;
VAL_ 1332 VCFRONT_a506_superManifoldType 0 "TYPE0" 1 "TYPE1" ;
VAL_ 1332 VCFRONT_a510_sumCellVoltage 65534 "INVALID" 65535 "SNA" ;
VAL_ 1332 VCFRONT_a513_packCurrent 4294934528 "SNA" ;
VAL_ 1332 VCFRONT_a514_cell1Voltage 65535 "SNA" ;
VAL_ 1332 VCFRONT_a515_cell1Voltage 65535 "SNA" ;
VAL_ 1332 VCFRONT_a516_IBSVoltage 4095 "SNA" ;
VAL_ 1332 VCFRONT_a517_IBSVoltage 4095 "SNA" ;
VAL_ 1332 VCFRONT_a518_packVoltage 65535 "SNA" ;
VAL_ 1332 VCFRONT_a522_IBSVoltage 4095 "SNA" ;
VAL_ 1332 VCFRONT_a525_GTW_twelveVBatteryT 0 "ATLASBX_B24_FLOODED" 1 "CLARIOS_B24_FLOODED" ;
VAL_ 1332 VCFRONT_a527_cell1Voltage 65535 "SNA" ;
VAL_ 1332 VCFRONT_a529_sumCellVoltage 65534 "INVALID" 65535 "SNA" ;
VAL_ 1332 VCFRONT_a544_serviceMode 0 "DISABLED" 1 "ENABLED" ;
VAL_ 1332 VCFRONT_a545_GTW_twelveVBatteryT 0 "ATLASBX_B24_FLOODED" 1 "CLARIOS_B24_FLOODED" ;
VAL_ 1332 VCFRONT_a547_serviceMode 0 "DISABLED" 1 "ENABLED" ;
VAL_ 1332 VCFRONT_a548_vehiclePowerState 0 "OFF" 1 "CONDITIONING" 2 "ACCESSORY" 3 "DRIVE" ;
VAL_ 1332 VCFRONT_a552_vcrightSelfTestResu 0 "NOT_RUN" 1 "RUNNING" 2 "PASSED" 3 "FAILED_RAILS_UNSTABLE" 4 "FAILED_EFUSE_OUTPUT_SHORT" 5 "FAILED_POWER_FET_STUCK_ON" 6 "FAILED_ENABLE_LOW_MALFUNCTION" 7 "FAILED_POWER_FET_CHANNEL_OPEN" 8 "FAILED_ENABLE_HIGH_MALFUNCTION" 9 "FAILED_TURN_OFF_PATH_TOO_SLOW" 10 "FAILED_NOT_LATCHED" 11 "SKIPPED" ;
VAL_ 1332 VCFRONT_a555_cell1Voltage 65535 "SNA" ;
VAL_ 1332 VCFRONT_a556_factoryMode 0 "DISABLED" 1 "ENABLED" ;
VAL_ 1332 VCFRONT_a559_SOC 127 "SNA" ;
VAL_ 1332 VCFRONT_a582_batterySMState 0 "INIT" 1 "CHARGE" 2 "DISCHARGE" 3 "STANDBY" 4 "RESISTANCE_ESTIMATION" 5 "OTA_STANDBY" 6 "DISCONNECTED_BATTERY_TEST" 7 "SHORTED_CELL_TEST" 8 "FAULT" 9 "RECOVERY" ;
VAL_ 1332 VCFRONT_a587_factoryMode 0 "DISABLED" 1 "ENABLED" ;
VAL_ 1332 VCFRONT_a595_factoryMode 0 "DISABLED" 1 "ENABLED" ;
VAL_ 1332 VCFRONT_a598_vcleftSelfTestResul 0 "NOT_RUN" 1 "RUNNING" 2 "PASSED" 3 "FAILED_RAILS_UNSTABLE" 4 "FAILED_EFUSE_OUTPUT_SHORT" 5 "FAILED_POWER_FET_STUCK_ON" 6 "FAILED_ENABLE_LOW_MALFUNCTION" 7 "FAILED_POWER_FET_CHANNEL_OPEN" 8 "FAILED_ENABLE_HIGH_MALFUNCTION" 9 "FAILED_TURN_OFF_PATH_TOO_SLOW" 10 "FAILED_NOT_LATCHED" 11 "SKIPPED" ;
VAL_ 1332 VCFRONT_a599_GTW_twelveVBatteryT 0 "ATLASBX_B24_FLOODED" 1 "CLARIOS_B24_FLOODED" ;
VAL_ 1332 VCFRONT_a600_factoryMode 0 "DISABLED" 1 "ENABLED" ;
VAL_ 1332 VCFRONT_a612_DI_gear 0 "INVALID" 1 "P" 2 "R" 3 "N" 4 "D" 7 "SNA" ;
VAL_ 1332 VCFRONT_a618_ambientTemp 4294966273 "SNA" ;
VAL_ 1332 VCFRONT_a623_DI_gear 0 "INVALID" 1 "P" 2 "R" 3 "N" 4 "D" 7 "SNA" ;
VAL_ 1332 VCFRONT_a627_cell1Voltage 65535 "SNA" ;
VAL_ 1332 VCFRONT_a670_packVoltage 65535 "SNA" ;
VAL_ 1332 VCFRONT_alertState 0 "CLEARED" 1 "SET" ;
VAL_ 1332 VCFRONT_alertID 0 "ALERT_DO_NOT_USE_ZERO" 1 "a001_DriverDoorOpen" 2 "a002_DoorOpen" 3 "a003_TrunkOpen" 4 "a004_FrunkOpen" 5 "a005_HeadlightsOnDoorOpen" 6 "a006_RemoteServiceAlert" 7 "a007_SoftPackConfigMismatch" 8 "a008_TouchScreenError" 9 "a009_SquashfsError" 10 "a010_MapsMissing" 11 "a011_IncorrectMap" 12 "a012_NotOnPrivateProperty" 13 "a013_TPMSHardWarning" 14 "a014_TPMSSoftWarning" 15 "a015_TPMSOverPressureWarning" 16 "a016_TPMSTemperatureWarning" 17 "a017_TPMSSystemFault" 18 "a018_SlipStartOn" 19 "a019_ParkBrakeFault" 20 "a020_SteeringReduced" 21 "a021_RearSeatbeltUnbuckled" 22 "a022_ApeFusesEtc" 23 "a023_CellInternetCheckFailed" 24 "a024_WifiInternetCheckFailed" 25 "a025_WifiOnlineCheckFailed" 26 "a026_ModemResetLoopDetected" 27 "a027_AutoSteerMIA" 28 "a028_FrontTrunkPopupClosed" 29 "a029_ModemMIA" 30 "a030_ModemVMCrash" 31 "a031_BrakeFluidLow" 32 "a032_CellModemRecoveryResets" 33 "a033_ApTrialExpired" 34 "a034_WakeupProblem" 35 "a035_AudioWatchdogKernelError" 36 "a036_AudioWatchdogHfpError" 37 "a037_AudioWatchdogXrunStormError" 38 "a038_AudioWatchdogA2bI2cLockupError" 39 "a039_AudioA2bNeedRediscovery" 40 "a040_HomelinkTransmit" 41 "a041_AudioDmesgXrun" 42 "a042_AudioDmesgRtThrottling" 43 "a043_InvalidMapDataOverride" 44 "a044_AudioDmesgDspException" 45 "a045_ECallNeedsService" 46 "a046_BackupCameraStreamError" 47 "a047_CellRoamingDisallowed" 48 "a048_AudioPremiumAmpCheckFailed" 49 "a049_BrakeShiftRequired" 50 "a050_BackupCameraIPUTimeout" 51 "a051_BackupCameraFrameTimeout" 52 "a052_KernelPanicReported" 53 "a053_QtCarExitError" 54 "a054_AudioBoostPowerBad" 55 "a055_ManualECallDisabled" 56 "a056_ManualECallButtonDisconnected" 57 "a057_CellAntennaDisconnected" 58 "a058_GPSAntennaDisconnected" 59 "a059_ECallSpeakerDisconnected" 60 "a060_ECallMicDisconnected" 61 "a061_SIMTestFailed" 62 "a062_ENSTestFailed" 63 "a063_CellularTestFailed" 64 "a064_ModemFirmwareTestFailed" 65 "a065_WiFiRecoveryReset" 66 "a066_GpuHangDetected" 67 "a067_WarnOnI915" 68 "a068_VideoUnexpectedExit" 69 "a069_VideoUDPTimeout" 70 "a070_VideoPipelineWarning" 71 "a071_VideoPipelineError" 72 "a072_ECallAnalogMicFailed" 73 "a073_ECallDigitalMicFailed" 74 "a074_EMMCHangDetected" 75 "a075_BackupCameraInitError" 76 "a076_NumFalseManualECalls" 77 "a077_AudioA2bMicChannelSwap" 78 "a078_DashcamUsbDriveUnmountable" 79 "a079_DashcamUsbDriveFull" 80 "a080_DashcamUsbDriveSlow" 81 "a081_CellModemSearchExpired" 82 "a082_NumModemRebootStuckInECall" 83 "a083_ECallProxyWatchdogTriggered" 84 "a084_SerializerError" 85 "a085_DeserializerError" 86 "a086_TouchEnumerationError" 87 "a087_BmpReset" 88 "a088_CellRemovableSimMissing" 89 "a089_RadioSoftResetError" 90 "a090_RadioPingFailError" 91 "a091_VehicleLinkStall" 92 "a092_updateStarted" 93 "a093_updateEnded" 94 "a094_ModemPowerOnFailure" 95 "a095_CidStorageRunningLow" 96 "a096_VideodPipelineIssueDetected" 97 "a097_AudiodRestarted" 98 "a098_DiskCheckFailure" 99 "a099_eMMCStatusError" 100 "a100_eMMCFTLError" 101 "a101_wifiStackProblem" 102 "a102_A2bDiscoveryFailed" 103 "a103_UsbHubNotEnumerating" 104 "a104_DashcamUsbDriveMissing" 105 "a105_firmwareReinstallRequested" 106 "a106_rebootBackstopTriggered" 107 "a107_DashcamUsbDriveTooBigForVfatFsck" 108 "a108_DashcamUsbDriveGettingFull" 109 "a109_DashcamUsbDriveTooSmall" 110 "a110_DashcamUsbDriveCorrupt" 111 "a111_DashcamUsbDriveWrongPort" 112 "a112_badUSBDevice" 113 "a113_DashcamHasOnboardSentryClips" ;
CM_ BO_ 1334 "ESP32-DualCAN Model3_VEH. Not seen on this car in the logs.";
