VERSION "2021.24.4"

NS_ :

BS_:

BU_: VEH CH Receiver X

BA_DEF_ BO_ "GenMsgSendType" ENUM "Cyclic";
BA_DEF_ BO_ "GenMsgCycleTime" INT 0 10000;

BO_ 1328 VCSEC_alertLog: 8 Vector__XXX
 SG_ VCSEC_a058_faultReason m58 : 63|1@1+ (1,0) [0|0] "" Vector__XXX
 SG_ VCSEC_a211_FleetModeActive m211 : 63|1@1+ (1,0) [0|0] "" Vector__XXX
 SG_ VCSEC_a211_riderKeyConnected m211 : 62|1@1+ (1,0) [0|0] "" Vector__XXX
 SG_ VCSEC_a473_locationPermission m473 : 61|3@1+ (1,0) [0|0] "" Vector__XXX
 SG_ VCSEC_a473_bondingCharDiscovered m473 : 60|1@1+ (1,0) [0|0] "" Vector__XXX
 SG_ VCSEC_a473_bondingServiceDiscove m473 : 59|1@1+ (1,0) [0|0] "" Vector__XXX
 SG_ VCSEC_a474_mobileAppLastCommandA m474 : 59|3@1+ (1,0) [0|0] "" Vector__XXX
 SG_ VCSEC_a479_NIStateFrontRight0 m479 : 59|5@1+ (1,0) [0|0] "" Vector__XXX
 SG_ VCSEC_a480_NIStateFrontRight1 m480 : 59|5@1+ (1,0) [0|0] "" Vector__XXX
 SG_ VCSEC_a481_NIStateFrontRight2 m481 : 59|5@1+ (1,0) [0|0] "" Vector__XXX
 SG_ VCSEC_a495_iOS_appState m495 : 59|2@1+ (1,0) [0|0] "" Vector__XXX
 SG_ VCSEC_a177_keyRole m177 : 58|4@1+ (1,0) [0|0] "" Vector__XXX
 SG_ VCSEC_a178_removedKeyRole m178 : 58|4@1+ (1,0) [0|0] "" Vector__XXX
 SG_ VCSEC_a211_MaximumRSSIAntenna m211 : 58|4@1+ (1,0) [0|0] "" Vector__XXX
 SG_ VCSEC_a473_versionCharDiscovered m473 : 58|1@1+ (1,0) [0|0] "" Vector__XXX
 SG_ VCSEC_a473_fromVehicleCharDiscov m473 : 57|1@1+ (1,0) [0|0] "" Vector__XXX
 SG_ VCSEC_a022_TaskInitError4 m22 : 56|8@1+ (1,0) [0|0] "" Vector__XXX
 SG_ VCSEC_a031_uds_bytes_5 m31 : 56|8@1+ (1,0) [0|0] "" Vector__XXX
 SG_ VCSEC_a041_CPULoadNVMMTask m41 : 56|8@1+ (1,0) [0|0] "" Vector__XXX
 SG_ VCSEC_a042_UsageNVMMTask m42 : 56|8@1+ (1,0) [0|0] "" Vector__XXX
 SG_ VCSEC_a180_signingKeySlot m180 : 56|8@1+ (1,0) [0|0] "" Vector__XXX
 SG_ VCSEC_a257_permissionActiveTime m257 : 56|8@1+ (1,0) [0|0] "" Vector__XXX
 SG_ VCSEC_a258_permissionActiveTime m258 : 56|8@1+ (1,0) [0|0] "" Vector__XXX
 SG_ VCSEC_a473_toVehicleCharDiscover m473 : 56|1@1+ (1,0) [0|0] "" Vector__XXX
 SG_ VCSEC_a474_mobileAppLastCommand_ m474 : 56|3@1+ (1,0) [0|0] "" Vector__XXX
 SG_ VCSEC_a495_iOS_launchReason_time m495 : 56|3@1+ (1,0) [0|0] "" Vector__XXX
 SG_ VCSEC_a521_avgBiasLong m521 : 56|7@1- (1,0) [0|0] "" Vector__XXX
 SG_ VCSEC_a522_avgBiasLong m522 : 56|7@1- (1,0) [0|0] "" Vector__XXX
 SG_ VCSEC_a523_avgBiasLong m523 : 56|7@1- (1,0) [0|0] "" Vector__XXX
 SG_ VCSEC_a524_avgBiasLong m524 : 56|7@1- (1,0) [0|0] "" Vector__XXX
 SG_ VCSEC_a473_PhoneKeyServiceDiscov m473 : 55|1@1+ (1,0) [0|0] "" Vector__XXX
 SG_ VCSEC_a473_remoteStartIssued m473 : 54|1@1+ (1,0) [0|0] "" Vector__XXX
 SG_ VCSEC_a479_NIStateFrontLeft0 m479 : 54|5@1+ (1,0) [0|0] "" Vector__XXX
 SG_ VCSEC_a480_NIStateFrontLeft1 m480 : 54|5@1+ (1,0) [0|0] "" Vector__XXX
 SG_ VCSEC_a481_NIStateFrontLeft2 m481 : 54|5@1+ (1,0) [0|0] "" Vector__XXX
 SG_ VCSEC_a483_warning2_endpoints_gl m483 : 54|10@1+ (1,0) [0|0] "" Vector__XXX
 SG_ VCSEC_a178_removedKeySlot m178 : 53|5@1+ (1,0) [0|0] "" Vector__XXX
 SG_ VCSEC_a472_receivedRemotely m472 : 53|1@1+ (1,0) [0|0] "" Vector__XXX
 SG_ VCSEC_a473_receivedRemotely m473 : 53|1@1+ (1,0) [0|0] "" Vector__XXX
 SG_ VCSEC_a477_receivedRemotely m477 : 53|1@1+ (1,0) [0|0] "" Vector__XXX
 SG_ VCSEC_a474_peripheralState m474 : 52|3@1+ (1,0) [0|0] "" Vector__XXX
 SG_ VCSEC_a058_newREstimate m58 : 51|12@1+ (0.00061,0) [0|0] "" Vector__XXX
 SG_ VCSEC_a495_iOS_launchReason m495 : 51|3@1+ (1,0) [0|0] "" Vector__XXX
 SG_ VCSEC_a113_VEH_odo m113 : 50|1@1+ (1,0) [0|0] "" Vector__XXX
 SG_ VCSEC_a211_MaximumRSSI m211 : 50|8@1- (1,0) [0|0] "" Vector__XXX
 SG_ VCSEC_a113_CH_vehicleControl2 m113 : 49|1@1+ (1,0) [0|0] "" Vector__XXX
 SG_ VCSEC_a211_AuthRequested m211 : 49|1@1+ (1,0) [0|0] "" Vector__XXX
 SG_ VCSEC_a479_NIStateFront0 m479 : 49|5@1+ (1,0) [0|0] "" Vector__XXX
 SG_ VCSEC_a480_NIStateFront1 m480 : 49|5@1+ (1,0) [0|0] "" Vector__XXX
 SG_ VCSEC_a481_NIStateFront2 m481 : 49|5@1+ (1,0) [0|0] "" Vector__XXX
 SG_ VCSEC_a000_alertDataW2 m0 : 48|16@1+ (1,0) [0|0] "" Vector__XXX
 SG_ VCSEC_a003_Data m3 : 48|16@1+ (1,0) [0|0] "" Vector__XXX
 SG_ VCSEC_a022_TaskInitError3 m22 : 48|8@1+ (1,0) [0|0] "" Vector__XXX
 SG_ VCSEC_a031_uds_bytes_4 m31 : 48|8@1+ (1,0) [0|0] "" Vector__XXX
 SG_ VCSEC_a041_CPULoad1000msTask m41 : 48|8@1+ (1,0) [0|0] "" Vector__XXX
 SG_ VCSEC_a042_UsageUDSTask m42 : 48|8@1+ (1,0) [0|0] "" Vector__XXX
 SG_ VCSEC_a113_VEH_driverAssistMapDa m113 : 48|1@1+ (1,0) [0|0] "" Vector__XXX
 SG_ VCSEC_a120_BDY_speed m120 : 48|1@1+ (1,0) [0|0] "" Vector__XXX
 SG_ VCSEC_a166_operationModeChanged m166 : 48|1@1+ (1,0) [0|0] "" Vector__XXX
 SG_ VCSEC_a167_operationModeChanged m167 : 48|1@1+ (1,0) [0|0] "" Vector__XXX
 SG_ VCSEC_a168_operationModeChanged m168 : 48|1@1+ (1,0) [0|0] "" Vector__XXX
 SG_ VCSEC_a169_operationModeChanged m169 : 48|1@1+ (1,0) [0|0] "" Vector__XXX
 SG_ VCSEC_a170_operationModeChanged m170 : 48|1@1+ (1,0) [0|0] "" Vector__XXX
 SG_ VCSEC_a178_signingKeySlot m178 : 48|5@1+ (1,0) [0|0] "" Vector__XXX
 SG_ VCSEC_a180_whitelistSlot m180 : 48|8@1+ (1,0) [0|0] "" Vector__XXX
 SG_ VCSEC_a211_UnknownDevicePresent m211 : 48|1@1+ (1,0) [0|0] "" Vector__XXX
 SG_ VCSEC_a257_keyActiveTime m257 : 48|8@1+ (1,0) [0|0] "" Vector__XXX
 SG_ VCSEC_a258_keyActiveTime m258 : 48|8@1+ (1,0) [0|0] "" Vector__XXX
 SG_ VCSEC_a300_keySlot m300 : 48|8@1+ (1,0) [0|0] "" Vector__XXX
 SG_ VCSEC_a472_wlChannel m472 : 48|5@1+ (1,0) [0|0] "" Vector__XXX
 SG_ VCSEC_a473_wlChannel m473 : 48|5@1+ (1,0) [0|0] "" Vector__XXX
 SG_ VCSEC_a477_wlChannel m477 : 48|5@1+ (1,0) [0|0] "" Vector__XXX
 SG_ VCSEC_a495_CoreBTATTError_timefr m495 : 48|3@1+ (1,0) [0|0] "" Vector__XXX
 SG_ VCSEC_a496_bootReceiver_timefram m496 : 48|3@1+ (1,0) [0|0] "" Vector__XXX
 SG_ VCSEC_a521_avgBiasLat m521 : 48|7@1- (1,0) [0|0] "" Vector__XXX
 SG_ VCSEC_a522_avgBiasLat m522 : 48|7@1- (1,0) [0|0] "" Vector__XXX
 SG_ VCSEC_a523_avgBiasLat m523 : 48|7@1- (1,0) [0|0] "" Vector__XXX
 SG_ VCSEC_a524_avgBiasLat m524 : 48|7@1- (1,0) [0|0] "" Vector__XXX
 SG_ VCSEC_a113_VEH_ambientLightingCt m113 : 47|1@1+ (1,0) [0|0] "" Vector__XXX
 SG_ VCSEC_a120_VEH_motorStatus m120 : 47|1@1+ (1,0) [0|0] "" Vector__XXX
 SG_ VCSEC_a166_uwbMIA m166 : 47|1@1+ (1,0) [0|0] "" Vector__XXX
 SG_ VCSEC_a167_uwbMIA m167 : 47|1@1+ (1,0) [0|0] "" Vector__XXX
 SG_ VCSEC_a168_uwbMIA m168 : 47|1@1+ (1,0) [0|0] "" Vector__XXX
 SG_ VCSEC_a169_uwbMIA m169 : 47|1@1+ (1,0) [0|0] "" Vector__XXX
 SG_ VCSEC_a170_uwbMIA m170 : 47|1@1+ (1,0) [0|0] "" Vector__XXX
 SG_ VCSEC_a104_BDY_bodyControls m104 : 46|1@1+ (1,0) [0|0] "" Vector__XXX
 SG_ VCSEC_a113_VEH_autopilotControl m113 : 46|1@1+ (1,0) [0|0] "" Vector__XXX
 SG_ VCSEC_a120_PARTY_motorStatus m120 : 46|1@1+ (1,0) [0|0] "" Vector__XXX
 SG_ VCSEC_a166_bondingFailure m166 : 46|1@1+ (1,0) [0|0] "" Vector__XXX
 SG_ VCSEC_a167_bondingFailure m167 : 46|1@1+ (1,0) [0|0] "" Vector__XXX
 SG_ VCSEC_a168_bondingFailure m168 : 46|1@1+ (1,0) [0|0] "" Vector__XXX
 SG_ VCSEC_a169_bondingFailure m169 : 46|1@1+ (1,0) [0|0] "" Vector__XXX
 SG_ VCSEC_a170_bondingFailure m170 : 46|1@1+ (1,0) [0|0] "" Vector__XXX
 SG_ VCSEC_a177_keyActiveTime m177 : 46|12@1+ (1,0) [0|0] "" Vector__XXX
 SG_ VCSEC_a211_DevicePresentCount m211 : 46|2@1+ (1,0) [0|0] "" Vector__XXX
 SG_ VCSEC_a254_keyActiveTime m254 : 46|18@1+ (1,0) [0|0] "" Vector__XXX
 SG_ VCSEC_a255_keyActiveTime m255 : 46|18@1+ (1,0) [0|0] "" Vector__XXX
 SG_ VCSEC_a104_VEH_redundantBrakingC m104 : 45|1@1+ (1,0) [0|0] "" Vector__XXX
 SG_ VCSEC_a113_VEH_status2 m113 : 45|1@1+ (1,0) [0|0] "" Vector__XXX
 SG_ VCSEC_a120_VEH_vehicleEstimates m120 : 45|1@1+ (1,0) [0|0] "" Vector__XXX
 SG_ VCSEC_a166_uwbReset m166 : 45|1@1+ (1,0) [0|0] "" Vector__XXX
 SG_ VCSEC_a167_uwbReset m167 : 45|1@1+ (1,0) [0|0] "" Vector__XXX
 SG_ VCSEC_a168_uwbReset m168 : 45|1@1+ (1,0) [0|0] "" Vector__XXX
 SG_ VCSEC_a169_uwbReset m169 : 45|1@1+ (1,0) [0|0] "" Vector__XXX
 SG_ VCSEC_a170_uwbReset m170 : 45|1@1+ (1,0) [0|0] "" Vector__XXX
 SG_ VCSEC_a256_keyActiveTime m256 : 45|18@1+ (1,0) [0|0] "" Vector__XXX
 SG_ VCSEC_a104_VEH_control m104 : 44|1@1+ (1,0) [0|0] "" Vector__XXX
 SG_ VCSEC_a113_VEH_gpsVehicleSpeed m113 : 44|1@1+ (1,0) [0|0] "" Vector__XXX
 SG_ VCSEC_a118_PARTY_VCFRONT_cameraC m118 : 44|1@1+ (1,0) [0|0] "" Vector__XXX
 SG_ VCSEC_a120_VEH_prndControl m120 : 44|1@1+ (1,0) [0|0] "" Vector__XXX
 SG_ VCSEC_a166_linkLayerBreakdown m166 : 44|1@1+ (1,0) [0|0] "" Vector__XXX
 SG_ VCSEC_a167_linkLayerBreakdown m167 : 44|1@1+ (1,0) [0|0] "" Vector__XXX
 SG_ VCSEC_a168_linkLayerBreakdown m168 : 44|1@1+ (1,0) [0|0] "" Vector__XXX
 SG_ VCSEC_a169_linkLayerBreakdown m169 : 44|1@1+ (1,0) [0|0] "" Vector__XXX
 SG_ VCSEC_a170_linkLayerBreakdown m170 : 44|1@1+ (1,0) [0|0] "" Vector__XXX
 SG_ VCSEC_a479_NIStateRearBumper0 m479 : 44|5@1+ (1,0) [0|0] "" Vector__XXX
 SG_ VCSEC_a480_NIStateRearBumper1 m480 : 44|5@1+ (1,0) [0|0] "" Vector__XXX
 SG_ VCSEC_a481_NIStateRearBumper2 m481 : 44|5@1+ (1,0) [0|0] "" Vector__XXX
 SG_ VCSEC_a483_warning1_endpoints_gl m483 : 44|10@1+ (1,0) [0|0] "" Vector__XXX
 SG_ VCSEC_a063_faulted m63 : 43|1@1+ (1,0) [0|0] "" Vector__XXX
 SG_ VCSEC_a104_VEH_wirelessChargingS m104 : 43|1@1+ (1,0) [0|0] "" Vector__XXX
 SG_ VCSEC_a113_VEH_gpsTime m113 : 43|1@1+ (1,0) [0|0] "" Vector__XXX
 SG_ VCSEC_a118_BDY_AP_vehicleState1H m118 : 43|1@1+ (1,0) [0|0] "" Vector__XXX
 SG_ VCSEC_a120_VEH_locStatus2 m120 : 43|1@1+ (1,0) [0|0] "" Vector__XXX
 SG_ VCSEC_a166_heapUsageTooHigh m166 : 43|1@1+ (1,0) [0|0] "" Vector__XXX
 SG_ VCSEC_a167_heapUsageTooHigh m167 : 43|1@1+ (1,0) [0|0] "" Vector__XXX
 SG_ VCSEC_a168_heapUsageTooHigh m168 : 43|1@1+ (1,0) [0|0] "" Vector__XXX
 SG_ VCSEC_a169_heapUsageTooHigh m169 : 43|1@1+ (1,0) [0|0] "" Vector__XXX
 SG_ VCSEC_a170_heapUsageTooHigh m170 : 43|1@1+ (1,0) [0|0] "" Vector__XXX
 SG_ VCSEC_a238_newLocationSensor3 m238 : 43|3@1+ (1,0) [0|0] "" Vector__XXX
 SG_ VCSEC_a495_CoreBTATTError m495 : 43|5@1+ (1,0) [0|0] "" Vector__XXX
 SG_ VCSEC_a496_screenOn_timeframe m496 : 43|3@1+ (1,0) [0|0] "" Vector__XXX
 SG_ VCSEC_a063_stuckActive m63 : 42|1@1+ (1,0) [0|0] "" Vector__XXX
 SG_ VCSEC_a104_BDY_autonomyControl m104 : 42|1@1+ (1,0) [0|0] "" Vector__XXX
 SG_ VCSEC_a113_VEH_locationStatus m113 : 42|1@1+ (1,0) [0|0] "" Vector__XXX
 SG_ VCSEC_a118_PARTY_AP_vehicleState m118 : 42|1@1+ (1,0) [0|0] "" Vector__XXX
 SG_ VCSEC_a120_VEH_locStatus m120 : 42|1@1+ (1,0) [0|0] "" Vector__XXX
 SG_ VCSEC_a166_TPMSRepeatedlyDisconn m166 : 42|1@1+ (1,0) [0|0] "" Vector__XXX
 SG_ VCSEC_a167_TPMSRepeatedlyDisconn m167 : 42|1@1+ (1,0) [0|0] "" Vector__XXX
 SG_ VCSEC_a168_TPMSRepeatedlyDisconn m168 : 42|1@1+ (1,0) [0|0] "" Vector__XXX
 SG_ VCSEC_a169_TPMSRepeatedlyDisconn m169 : 42|1@1+ (1,0) [0|0] "" Vector__XXX
 SG_ VCSEC_a170_TPMSRepeatedlyDisconn m170 : 42|1@1+ (1,0) [0|0] "" Vector__XXX
 SG_ VCSEC_a063_indeterminate m63 : 41|1@1+ (1,0) [0|0] "" Vector__XXX
 SG_ VCSEC_a104_CH_autonomyControl m104 : 41|1@1+ (1,0) [0|0] "" Vector__XXX
 SG_ VCSEC_a113_CH_odo m113 : 41|1@1+ (1,0) [0|0] "" Vector__XXX
 SG_ VCSEC_a118_BDY_vehicleTime m118 : 41|1@1+ (1,0) [0|0] "" Vector__XXX
 SG_ VCSEC_a120_CH_locStatus2 m120 : 41|1@1+ (1,0) [0|0] "" Vector__XXX
 SG_ VCSEC_a166_TPMSConnectionRequest m166 : 41|1@1+ (1,0) [0|0] "" Vector__XXX
 SG_ VCSEC_a167_TPMSConnectionRequest m167 : 41|1@1+ (1,0) [0|0] "" Vector__XXX
 SG_ VCSEC_a168_TPMSConnectionRequest m168 : 41|1@1+ (1,0) [0|0] "" Vector__XXX
 SG_ VCSEC_a169_TPMSConnectionRequest m169 : 41|1@1+ (1,0) [0|0] "" Vector__XXX
 SG_ VCSEC_a170_TPMSConnectionRequest m170 : 41|1@1+ (1,0) [0|0] "" Vector__XXX
 SG_ VCSEC_a255_signingKeySlot m255 : 41|5@1+ (1,0) [0|0] "" Vector__XXX
 SG_ VCSEC_a022_TaskInitError2 m22 : 40|8@1+ (1,0) [0|0] "" Vector__XXX
 SG_ VCSEC_a031_uds_bytes_3 m31 : 40|8@1+ (1,0) [0|0] "" Vector__XXX
 SG_ VCSEC_a041_CPULoad100msTask m41 : 40|8@1+ (1,0) [0|0] "" Vector__XXX
 SG_ VCSEC_a042_Usage1000msTask m42 : 40|8@1+ (1,0) [0|0] "" Vector__XXX
 SG_ VCSEC_a043_CallTrace1 m43 : 40|24@1+ (1,0) [0|0] "" Vector__XXX
 SG_ VCSEC_a044_CallTrace1 m44 : 40|24@1+ (1,0) [0|0] "" Vector__XXX
 SG_ VCSEC_a045_CallTrace1 m45 : 40|24@1+ (1,0) [0|0] "" Vector__XXX
 SG_ VCSEC_a046_CallTrace1 m46 : 40|24@1+ (1,0) [0|0] "" Vector__XXX
 SG_ VCSEC_a059_current m59 : 40|12@1+ (0.05,0) [0|0] "" Vector__XXX
 SG_ VCSEC_a063_disconnected m63 : 40|1@1+ (1,0) [0|0] "" Vector__XXX
 SG_ VCSEC_a104_VEH_autonomyControl m104 : 40|1@1+ (1,0) [0|0] "" Vector__XXX
 SG_ VCSEC_a113_VEH_vehicleControlThe m113 : 40|1@1+ (1,0) [0|0] "" Vector__XXX
 SG_ VCSEC_a118_BDY_outputPowerStatus m118 : 40|1@1+ (1,0) [0|0] "" Vector__XXX
 SG_ VCSEC_a120_VEH_chassisCntl m120 : 40|1@1+ (1,0) [0|0] "" Vector__XXX
 SG_ VCSEC_a166_memAllocError m166 : 40|1@1+ (1,0) [0|0] "" Vector__XXX
 SG_ VCSEC_a167_memAllocError m167 : 40|1@1+ (1,0) [0|0] "" Vector__XXX
 SG_ VCSEC_a168_memAllocError m168 : 40|1@1+ (1,0) [0|0] "" Vector__XXX
 SG_ VCSEC_a169_memAllocError m169 : 40|1@1+ (1,0) [0|0] "" Vector__XXX
 SG_ VCSEC_a170_memAllocError m170 : 40|1@1+ (1,0) [0|0] "" Vector__XXX
 SG_ VCSEC_a238_newLocationSensor2 m238 : 40|3@1+ (1,0) [0|0] "" Vector__XXX
 SG_ VCSEC_a256_signingKeySlot m256 : 40|5@1+ (1,0) [0|0] "" Vector__XXX
 SG_ VCSEC_a312_modelHash m312 : 40|24@1+ (1,0) [0|0] "" Vector__XXX
 SG_ VCSEC_a495_CoreBTError_timeframe m495 : 40|3@1+ (1,0) [0|0] "" Vector__XXX
 SG_ VCSEC_a496_osStart_timeframe m496 : 40|3@1+ (1,0) [0|0] "" Vector__XXX
 SG_ VCSEC_a521_confidenceRR m521 : 40|7@1+ (1,0) [0|0] "" Vector__XXX
 SG_ VCSEC_a522_confidenceRR m522 : 40|7@1+ (1,0) [0|0] "" Vector__XXX
 SG_ VCSEC_a523_confidenceRR m523 : 40|7@1+ (1,0) [0|0] "" Vector__XXX
 SG_ VCSEC_a524_confidenceRR m524 : 40|7@1+ (1,0) [0|0] "" Vector__XXX
 SG_ VCSEC_a058_prevREstimate m58 : 39|12@1+ (0.00061,0) [0|0] "" Vector__XXX
 SG_ VCSEC_a104_PARTY_autonomyControl m104 : 39|1@1+ (1,0) [0|0] "" Vector__XXX
 SG_ VCSEC_a113_VEH_vehicleControl3 m113 : 39|1@1+ (1,0) [0|0] "" Vector__XXX
 SG_ VCSEC_a117_PARTY_lightingSeconda m117 : 39|1@1+ (1,0) [0|0] "" Vector__XXX
 SG_ VCSEC_a118_CH_alertMatrix m118 : 39|1@1+ (1,0) [0|0] "" Vector__XXX
 SG_ VCSEC_a120_PARTY_locStatus2 m120 : 39|1@1+ (1,0) [0|0] "" Vector__XXX
 SG_ VCSEC_a166_stuckAttemptingToConn m166 : 39|1@1+ (1,0) [0|0] "" Vector__XXX
 SG_ VCSEC_a167_stuckAttemptingToConn m167 : 39|1@1+ (1,0) [0|0] "" Vector__XXX
 SG_ VCSEC_a168_stuckAttemptingToConn m168 : 39|1@1+ (1,0) [0|0] "" Vector__XXX
 SG_ VCSEC_a169_stuckAttemptingToConn m169 : 39|1@1+ (1,0) [0|0] "" Vector__XXX
 SG_ VCSEC_a170_stuckAttemptingToConn m170 : 39|1@1+ (1,0) [0|0] "" Vector__XXX
 SG_ VCSEC_a479_NIStateHeader0 m479 : 39|5@1+ (1,0) [0|0] "" Vector__XXX
 SG_ VCSEC_a480_NIStateHeader1 m480 : 39|5@1+ (1,0) [0|0] "" Vector__XXX
 SG_ VCSEC_a481_NIStateHeader2 m481 : 39|5@1+ (1,0) [0|0] "" Vector__XXX
 SG_ VCSEC_a104_BDY_status m104 : 38|1@1+ (1,0) [0|0] "" Vector__XXX
 SG_ VCSEC_a113_VEH_tripPlanning m113 : 38|1@1+ (1,0) [0|0] "" Vector__XXX
 SG_ VCSEC_a117_PARTY_prndStatus m117 : 38|1@1+ (1,0) [0|0] "" Vector__XXX
 SG_ VCSEC_a118_CH_LVBMS_statusHigh m118 : 38|1@1+ (1,0) [0|0] "" Vector__XXX
 SG_ VCSEC_a120_PARTY_prndControl m120 : 38|1@1+ (1,0) [0|0] "" Vector__XXX
 SG_ VCSEC_a166_connectionWithoutChan m166 : 38|1@1+ (1,0) [0|0] "" Vector__XXX
 SG_ VCSEC_a167_connectionWithoutChan m167 : 38|1@1+ (1,0) [0|0] "" Vector__XXX
 SG_ VCSEC_a168_connectionWithoutChan m168 : 38|1@1+ (1,0) [0|0] "" Vector__XXX
 SG_ VCSEC_a169_connectionWithoutChan m169 : 38|1@1+ (1,0) [0|0] "" Vector__XXX
 SG_ VCSEC_a170_connectionWithoutChan m170 : 38|1@1+ (1,0) [0|0] "" Vector__XXX
 SG_ VCSEC_a016_NVMMWriteFailed m16 : 37|1@1+ (1,0) [0|0] "" Vector__XXX
 SG_ VCSEC_a104_BDY_control m104 : 37|1@1+ (1,0) [0|0] "" Vector__XXX
 SG_ VCSEC_a113_CH_powertrainControl m113 : 37|1@1+ (1,0) [0|0] "" Vector__XXX
 SG_ VCSEC_a116_BDY_switchStatus m116 : 37|1@1+ (1,0) [0|0] "" Vector__XXX
 SG_ VCSEC_a117_VEH_status m117 : 37|1@1+ (1,0) [0|0] "" Vector__XXX
 SG_ VCSEC_a118_CH_12VBatteryStatus m118 : 37|1@1+ (1,0) [0|0] "" Vector__XXX
 SG_ VCSEC_a120_VEH_estimatedBrakeTem m120 : 37|1@1+ (1,0) [0|0] "" Vector__XXX
 SG_ VCSEC_a166_CMStateMismatch m166 : 37|1@1+ (1,0) [0|0] "" Vector__XXX
 SG_ VCSEC_a167_CMStateMismatch m167 : 37|1@1+ (1,0) [0|0] "" Vector__XXX
 SG_ VCSEC_a168_CMStateMismatch m168 : 37|1@1+ (1,0) [0|0] "" Vector__XXX
 SG_ VCSEC_a169_CMStateMismatch m169 : 37|1@1+ (1,0) [0|0] "" Vector__XXX
 SG_ VCSEC_a170_CMStateMismatch m170 : 37|1@1+ (1,0) [0|0] "" Vector__XXX
 SG_ VCSEC_a005_faults1 m5 : 36|12@1+ (1,0) [0|0] "" Vector__XXX
 SG_ VCSEC_a016_NVMMMemOverflow m16 : 36|1@1+ (1,0) [0|0] "" Vector__XXX
 SG_ VCSEC_a104_BDY_gpsAccuracies m104 : 36|1@1+ (1,0) [0|0] "" Vector__XXX
 SG_ VCSEC_a113_CH_chassisControl m113 : 36|1@1+ (1,0) [0|0] "" Vector__XXX
 SG_ VCSEC_a116_BDY_restraintStatus m116 : 36|1@1+ (1,0) [0|0] "" Vector__XXX
 SG_ VCSEC_a117_PARTY_doorStatus m117 : 36|1@1+ (1,0) [0|0] "" Vector__XXX
 SG_ VCSEC_a118_PARTY_vehNm m118 : 36|1@1+ (1,0) [0|0] "" Vector__XXX
 SG_ VCSEC_a120_CH_speed m120 : 36|1@1+ (1,0) [0|0] "" Vector__XXX
 SG_ VCSEC_a166_transportModeWake m166 : 36|1@1+ (1,0) [0|0] "" Vector__XXX
 SG_ VCSEC_a167_transportModeWake m167 : 36|1@1+ (1,0) [0|0] "" Vector__XXX
 SG_ VCSEC_a168_transportModeWake m168 : 36|1@1+ (1,0) [0|0] "" Vector__XXX
 SG_ VCSEC_a169_transportModeWake m169 : 36|1@1+ (1,0) [0|0] "" Vector__XXX
 SG_ VCSEC_a170_transportModeWake m170 : 36|1@1+ (1,0) [0|0] "" Vector__XXX
 SG_ VCSEC_a235_isOnlyTrackingNN m235 : 36|1@1+ (1,0) [0|0] "" Vector__XXX
 SG_ VCSEC_a255_whitelistSlot m255 : 36|5@1+ (1,0) [0|0] "" Vector__XXX
 SG_ VCSEC_a496_processStart_timefram m496 : 36|3@1+ (1,0) [0|0] "" Vector__XXX
 SG_ VCSEC_a016_NVMMRecordUpgraded m16 : 35|1@1+ (1,0) [0|0] "" Vector__XXX
 SG_ VCSEC_a104_CH_pscControl m104 : 35|1@1+ (1,0) [0|0] "" Vector__XXX
 SG_ VCSEC_a113_VEH_LVControl m113 : 35|1@1+ (1,0) [0|0] "" Vector__XXX
 SG_ VCSEC_a114_CH_status m114 : 35|1@1+ (1,0) [0|0] "" Vector__XXX
 SG_ VCSEC_a116_BDY_epbmStatus m116 : 35|1@1+ (1,0) [0|0] "" Vector__XXX
 SG_ VCSEC_a117_VEH_thermalStatus m117 : 35|1@1+ (1,0) [0|0] "" Vector__XXX
 SG_ VCSEC_a118_VEH_lightStatus m118 : 35|1@1+ (1,0) [0|0] "" Vector__XXX
 SG_ VCSEC_a120_PARTY_stalklessInterf m120 : 35|1@1+ (1,0) [0|0] "" Vector__XXX
 SG_ VCSEC_a166_unexpectedWakeState m166 : 35|1@1+ (1,0) [0|0] "" Vector__XXX
 SG_ VCSEC_a167_unexpectedWakeState m167 : 35|1@1+ (1,0) [0|0] "" Vector__XXX
 SG_ VCSEC_a168_unexpectedWakeState m168 : 35|1@1+ (1,0) [0|0] "" Vector__XXX
 SG_ VCSEC_a169_unexpectedWakeState m169 : 35|1@1+ (1,0) [0|0] "" Vector__XXX
 SG_ VCSEC_a170_unexpectedWakeState m170 : 35|1@1+ (1,0) [0|0] "" Vector__XXX
 SG_ VCSEC_a238_newLocationSensor1 m238 : 35|3@1+ (1,0) [0|0] "" Vector__XXX
 SG_ VCSEC_a495_CoreBTError m495 : 35|5@1+ (1,0) [0|0] "" Vector__XXX
 SG_ VCSEC_a016_NVMMVersionMismatch m16 : 34|1@1+ (1,0) [0|0] "" Vector__XXX
 SG_ VCSEC_a104_VEH_status m104 : 34|1@1+ (1,0) [0|0] "" Vector__XXX
 SG_ VCSEC_a113_VEH_elevationStatus m113 : 34|1@1+ (1,0) [0|0] "" Vector__XXX
 SG_ VCSEC_a114_CH_party3 m114 : 34|1@1+ (1,0) [0|0] "" Vector__XXX
 SG_ VCSEC_a116_PARTY_doorStatus m116 : 34|1@1+ (1,0) [0|0] "" Vector__XXX
 SG_ VCSEC_a117_PARTY_restraintStatus m117 : 34|1@1+ (1,0) [0|0] "" Vector__XXX
 SG_ VCSEC_a118_CH_lighting m118 : 34|1@1+ (1,0) [0|0] "" Vector__XXX
 SG_ VCSEC_a120_PT_systemPower m120 : 34|1@1+ (1,0) [0|0] "" Vector__XXX
 SG_ VCSEC_a166_gattAtrbtWrongState m166 : 34|1@1+ (1,0) [0|0] "" Vector__XXX
 SG_ VCSEC_a167_gattAtrbtWrongState m167 : 34|1@1+ (1,0) [0|0] "" Vector__XXX
 SG_ VCSEC_a168_gattAtrbtWrongState m168 : 34|1@1+ (1,0) [0|0] "" Vector__XXX
 SG_ VCSEC_a169_gattAtrbtWrongState m169 : 34|1@1+ (1,0) [0|0] "" Vector__XXX
 SG_ VCSEC_a170_gattAtrbtWrongState m170 : 34|1@1+ (1,0) [0|0] "" Vector__XXX
 SG_ VCSEC_a474_timeSinceAppLaunchInS m474 : 34|18@1- (1,0) [0|0] "" Vector__XXX
 SG_ VCSEC_a475_timeSinceConnectInSec m475 : 34|18@1- (1,0) [0|0] "" Vector__XXX
 SG_ VCSEC_a476_timeSinceBackgroundIn m476 : 34|18@1- (1,0) [0|0] "" Vector__XXX
 SG_ VCSEC_a479_NIStateRearRight0 m479 : 34|5@1+ (1,0) [0|0] "" Vector__XXX
 SG_ VCSEC_a480_NIStateRearRight1 m480 : 34|5@1+ (1,0) [0|0] "" Vector__XXX
 SG_ VCSEC_a481_NIStateRearRight2 m481 : 34|5@1+ (1,0) [0|0] "" Vector__XXX
 SG_ VCSEC_a016_NVMMCRCMismatch m16 : 33|1@1+ (1,0) [0|0] "" Vector__XXX
 SG_ VCSEC_a104_VEH_summonCommand m104 : 33|1@1+ (1,0) [0|0] "" Vector__XXX
 SG_ VCSEC_a113_VEH_status m113 : 33|1@1+ (1,0) [0|0] "" Vector__XXX
 SG_ VCSEC_a114_CH_party1 m114 : 33|1@1+ (1,0) [0|0] "" Vector__XXX
 SG_ VCSEC_a116_PARTY_restraintStatus m116 : 33|1@1+ (1,0) [0|0] "" Vector__XXX
 SG_ VCSEC_a117_VEH_seatStatus2 m117 : 33|1@1+ (1,0) [0|0] "" Vector__XXX
 SG_ VCSEC_a118_VEH_interNodeResistan m118 : 33|1@1+ (1,0) [0|0] "" Vector__XXX
 SG_ VCSEC_a120_VEH_autonomyHealth m120 : 33|1@1+ (1,0) [0|0] "" Vector__XXX
 SG_ VCSEC_a166_assertFailure m166 : 33|1@1+ (1,0) [0|0] "" Vector__XXX
 SG_ VCSEC_a167_assertFailure m167 : 33|1@1+ (1,0) [0|0] "" Vector__XXX
 SG_ VCSEC_a168_assertFailure m168 : 33|1@1+ (1,0) [0|0] "" Vector__XXX
 SG_ VCSEC_a169_assertFailure m169 : 33|1@1+ (1,0) [0|0] "" Vector__XXX
 SG_ VCSEC_a170_assertFailure m170 : 33|1@1+ (1,0) [0|0] "" Vector__XXX
 SG_ VCSEC_a000_alertDataW1 m0 : 32|16@1+ (1,0) [0|0] "" Vector__XXX
 SG_ VCSEC_a003_LineNumber m3 : 32|16@1+ (1,0) [0|0] "" Vector__XXX
 SG_ VCSEC_a005_busID1 m5 : 32|4@1+ (1,0) [0|0] "" Vector__XXX
 SG_ VCSEC_a006_messageID m6 : 32|29@1+ (1,0) [0|0] "" Vector__XXX
 SG_ VCSEC_a016_NVMMRecordNotFound m16 : 32|1@1+ (1,0) [0|0] "" Vector__XXX
 SG_ VCSEC_a022_TaskInitError1 m22 : 32|8@1+ (1,0) [0|0] "" Vector__XXX
 SG_ VCSEC_a031_uds_bytes_2 m31 : 32|8@1+ (1,0) [0|0] "" Vector__XXX
 SG_ VCSEC_a041_CPULoad10msTask m41 : 32|8@1+ (1,0) [0|0] "" Vector__XXX
 SG_ VCSEC_a042_Usage100msTask m42 : 32|8@1+ (1,0) [0|0] "" Vector__XXX
 SG_ VCSEC_a063_ADCVoltage m63 : 32|8@1+ (0.025,0) [0|0] "" Vector__XXX
 SG_ VCSEC_a104_VEH_matrixHighBeamReq m104 : 32|1@1+ (1,0) [0|0] "" Vector__XXX
 SG_ VCSEC_a110_PARTY_carConfig m110 : 32|1@1+ (1,0) [0|0] "" Vector__XXX
 SG_ VCSEC_a113_VEH_debugECU m113 : 32|1@1+ (1,0) [0|0] "" Vector__XXX
 SG_ VCSEC_a114_BDY_wheelSpeeds m114 : 32|1@1+ (1,0) [0|0] "" Vector__XXX
 SG_ VCSEC_a116_VEH_windowStatus m116 : 32|1@1+ (1,0) [0|0] "" Vector__XXX
 SG_ VCSEC_a117_VEH_liftgateStatus m117 : 32|1@1+ (1,0) [0|0] "" Vector__XXX
 SG_ VCSEC_a118_CH_sensors m118 : 32|1@1+ (1,0) [0|0] "" Vector__XXX
 SG_ VCSEC_a120_PARTY_autonomyHealth m120 : 32|1@1+ (1,0) [0|0] "" Vector__XXX
 SG_ VCSEC_a166_advNotScheduled m166 : 32|1@1+ (1,0) [0|0] "" Vector__XXX
 SG_ VCSEC_a167_advNotScheduled m167 : 32|1@1+ (1,0) [0|0] "" Vector__XXX
 SG_ VCSEC_a168_advNotScheduled m168 : 32|1@1+ (1,0) [0|0] "" Vector__XXX
 SG_ VCSEC_a169_advNotScheduled m169 : 32|1@1+ (1,0) [0|0] "" Vector__XXX
 SG_ VCSEC_a170_advNotScheduled m170 : 32|1@1+ (1,0) [0|0] "" Vector__XXX
 SG_ VCSEC_a206_assertFailCount m206 : 32|8@1+ (1,0) [0|0] "" Vector__XXX
 SG_ VCSEC_a207_assertFailCount m207 : 32|8@1+ (1,0) [0|0] "" Vector__XXX
 SG_ VCSEC_a208_assertFailCount m208 : 32|8@1+ (1,0) [0|0] "" Vector__XXX
 SG_ VCSEC_a209_assertFailCount m209 : 32|8@1+ (1,0) [0|0] "" Vector__XXX
 SG_ VCSEC_a221_homologationRegion m221 : 32|2@1+ (1,0) [0|0] "" Vector__XXX
 SG_ VCSEC_a235_FPCountNN m235 : 32|4@1+ (1,0) [0|0] "" Vector__XXX
 SG_ VCSEC_a238_newLocationSensor0 m238 : 32|3@1+ (1,0) [0|0] "" Vector__XXX
 SG_ VCSEC_a256_whitelistSlot m256 : 32|5@1+ (1,0) [0|0] "" Vector__XXX
 SG_ VCSEC_a264_messageType m264 : 32|8@1+ (1,0) [0|0] "" Vector__XXX
 SG_ VCSEC_a305_connectionChannel m305 : 32|8@1+ (1,0) [0|0] "" Vector__XXX
 SG_ VCSEC_a312_disconnectionReason m312 : 32|8@1+ (1,0) [0|0] "" Vector__XXX
 SG_ VCSEC_a436_countryCode m436 : 32|16@1+ (1,0) [0|0] "" Vector__XXX
 SG_ VCSEC_a495_CBManagerAuthori_0000 m495 : 32|3@1+ (1,0) [0|0] "" Vector__XXX
 SG_ VCSEC_a496_serviceStartReason m496 : 32|4@1+ (1,0) [0|0] "" Vector__XXX
 SG_ VCSEC_a499_assertSubreason m499 : 32|8@1+ (1,0) [0|0] "" Vector__XXX
 SG_ VCSEC_a500_assertSubreason m500 : 32|8@1+ (1,0) [0|0] "" Vector__XXX
 SG_ VCSEC_a501_assertSubreason m501 : 32|8@1+ (1,0) [0|0] "" Vector__XXX
 SG_ VCSEC_a502_assertSubreason m502 : 32|8@1+ (1,0) [0|0] "" Vector__XXX
 SG_ VCSEC_a521_confidenceRL m521 : 32|7@1+ (1,0) [0|0] "" Vector__XXX
 SG_ VCSEC_a522_confidenceRL m522 : 32|7@1+ (1,0) [0|0] "" Vector__XXX
 SG_ VCSEC_a523_confidenceRL m523 : 32|7@1+ (1,0) [0|0] "" Vector__XXX
 SG_ VCSEC_a524_confidenceRL m524 : 32|7@1+ (1,0) [0|0] "" Vector__XXX
 SG_ VCSEC_a104_PARTY_matrixBendAngle m104 : 31|1@1+ (1,0) [0|0] "" Vector__XXX
 SG_ VCSEC_a109_CH_status m109 : 31|1@1+ (1,0) [0|0] "" Vector__XXX
 SG_ VCSEC_a110_CH_epochTimeGtw m110 : 31|1@1+ (1,0) [0|0] "" Vector__XXX
 SG_ VCSEC_a113_VEH_ventCntlReg m113 : 31|1@1+ (1,0) [0|0] "" Vector__XXX
 SG_ VCSEC_a114_BDY_wheelRotation m114 : 31|1@1+ (1,0) [0|0] "" Vector__XXX
 SG_ VCSEC_a116_VEH_thermalCommand m116 : 31|1@1+ (1,0) [0|0] "" Vector__XXX
 SG_ VCSEC_a117_VEH_intrusionSensorSt m117 : 31|1@1+ (1,0) [0|0] "" Vector__XXX
 SG_ VCSEC_a118_PARTY_sensors m118 : 31|1@1+ (1,0) [0|0] "" Vector__XXX
 SG_ VCSEC_a120_VEH_systemPower m120 : 31|1@1+ (1,0) [0|0] "" Vector__XXX
 SG_ VCSEC_a166_macIDChanged m166 : 31|1@1+ (1,0) [0|0] "" Vector__XXX
 SG_ VCSEC_a167_macIDChanged m167 : 31|1@1+ (1,0) [0|0] "" Vector__XXX
 SG_ VCSEC_a168_macIDChanged m168 : 31|1@1+ (1,0) [0|0] "" Vector__XXX
 SG_ VCSEC_a169_macIDChanged m169 : 31|1@1+ (1,0) [0|0] "" Vector__XXX
 SG_ VCSEC_a170_macIDChanged m170 : 31|1@1+ (1,0) [0|0] "" Vector__XXX
 SG_ VCSEC_a104_PARTY_integratedSafet m104 : 30|1@1+ (1,0) [0|0] "" Vector__XXX
 SG_ VCSEC_a109_CH_inertial2 m109 : 30|1@1+ (1,0) [0|0] "" Vector__XXX
 SG_ VCSEC_a110_CH_chNm m110 : 30|1@1+ (1,0) [0|0] "" Vector__XXX
 SG_ VCSEC_a113_VEH_driverProfil_0000 m113 : 30|1@1+ (1,0) [0|0] "" Vector__XXX
 SG_ VCSEC_a114_BDY_status m114 : 30|1@1+ (1,0) [0|0] "" Vector__XXX
 SG_ VCSEC_a116_VEH_status m116 : 30|1@1+ (1,0) [0|0] "" Vector__XXX
 SG_ VCSEC_a117_VEH_switchStatus m117 : 30|1@1+ (1,0) [0|0] "" Vector__XXX
 SG_ VCSEC_a118_CH_LVPowerState m118 : 30|1@1+ (1,0) [0|0] "" Vector__XXX
 SG_ VCSEC_a120_PARTY_aggregatedAxleS m120 : 30|1@1+ (1,0) [0|0] "" Vector__XXX
 SG_ VCSEC_a166_radioNotOn m166 : 30|1@1+ (1,0) [0|0] "" Vector__XXX
 SG_ VCSEC_a167_radioNotOn m167 : 30|1@1+ (1,0) [0|0] "" Vector__XXX
 SG_ VCSEC_a168_radioNotOn m168 : 30|1@1+ (1,0) [0|0] "" Vector__XXX
 SG_ VCSEC_a169_radioNotOn m169 : 30|1@1+ (1,0) [0|0] "" Vector__XXX
 SG_ VCSEC_a170_radioNotOn m170 : 30|1@1+ (1,0) [0|0] "" Vector__XXX
 SG_ VCSEC_a483_initialTripStdDev m483 : 30|14@1- (0.01,0) [0|0] "" Vector__XXX
 SG_ VCSEC_a098_VEH_motorStatus m98 : 29|1@1+ (1,0) [0|0] "" Vector__XXX
 SG_ VCSEC_a104_VEH_steeringControl m104 : 29|1@1+ (1,0) [0|0] "" Vector__XXX
 SG_ VCSEC_a107_VEH_chargeInfo m107 : 29|1@1+ (1,0) [0|0] "" Vector__XXX
 SG_ VCSEC_a108_CH_torque m108 : 29|1@1+ (1,0) [0|0] "" Vector__XXX
 SG_ VCSEC_a109_CH_inertial1 m109 : 29|1@1+ (1,0) [0|0] "" Vector__XXX
 SG_ VCSEC_a110_CH_vin m110 : 29|1@1+ (1,0) [0|0] "" Vector__XXX
 SG_ VCSEC_a113_VEH_driverProfileReca m113 : 29|1@1+ (1,0) [0|0] "" Vector__XXX
 SG_ VCSEC_a114_BDY_party3 m114 : 29|1@1+ (1,0) [0|0] "" Vector__XXX
 SG_ VCSEC_a116_VEH_seatStatus2 m116 : 29|1@1+ (1,0) [0|0] "" Vector__XXX
 SG_ VCSEC_a117_VEH_windowStatus m117 : 29|1@1+ (1,0) [0|0] "" Vector__XXX
 SG_ VCSEC_a118_VEH_thermalCommand m118 : 29|1@1+ (1,0) [0|0] "" Vector__XXX
 SG_ VCSEC_a120_VEH_aggregatedAxleSpe m120 : 29|1@1+ (1,0) [0|0] "" Vector__XXX
 SG_ VCSEC_a166_externalRequest m166 : 29|1@1+ (1,0) [0|0] "" Vector__XXX
 SG_ VCSEC_a167_externalRequest m167 : 29|1@1+ (1,0) [0|0] "" Vector__XXX
 SG_ VCSEC_a168_externalRequest m168 : 29|1@1+ (1,0) [0|0] "" Vector__XXX
 SG_ VCSEC_a169_externalRequest m169 : 29|1@1+ (1,0) [0|0] "" Vector__XXX
 SG_ VCSEC_a170_externalRequest m170 : 29|1@1+ (1,0) [0|0] "" Vector__XXX
 SG_ VCSEC_a479_NIStateRearLeft0 m479 : 29|5@1+ (1,0) [0|0] "" Vector__XXX
 SG_ VCSEC_a480_NIStateRearLeft1 m480 : 29|5@1+ (1,0) [0|0] "" Vector__XXX
 SG_ VCSEC_a481_NIStateRearLeft2 m481 : 29|5@1+ (1,0) [0|0] "" Vector__XXX
 SG_ VCSEC_a058_current m58 : 28|11@1+ (0.1,0) [0|0] "" Vector__XXX
 SG_ VCSEC_a059_resistanceEstimate m59 : 28|12@1+ (0.00244,0) [0|0] "" Vector__XXX
 SG_ VCSEC_a098_PARTY_motorStatus m98 : 28|1@1+ (1,0) [0|0] "" Vector__XXX
 SG_ VCSEC_a104_CH_steeringControl m104 : 28|1@1+ (1,0) [0|0] "" Vector__XXX
 SG_ VCSEC_a107_VEH_energyStatus m107 : 28|1@1+ (1,0) [0|0] "" Vector__XXX
 SG_ VCSEC_a108_VEH_motorStatus m108 : 28|1@1+ (1,0) [0|0] "" Vector__XXX
 SG_ VCSEC_a109_VEH_inertial2 m109 : 28|1@1+ (1,0) [0|0] "" Vector__XXX
 SG_ VCSEC_a110_CH_carState m110 : 28|1@1+ (1,0) [0|0] "" Vector__XXX
 SG_ VCSEC_a113_VEH_vehicleModes m113 : 28|1@1+ (1,0) [0|0] "" Vector__XXX
 SG_ VCSEC_a114_BDY_offsets m114 : 28|1@1+ (1,0) [0|0] "" Vector__XXX
 SG_ VCSEC_a116_VEH_logging1Hz m116 : 28|1@1+ (1,0) [0|0] "" Vector__XXX
 SG_ VCSEC_a117_VEH_doorStatus2 m117 : 28|1@1+ (1,0) [0|0] "" Vector__XXX
 SG_ VCSEC_a118_PARTY_vehicleTime m118 : 28|1@1+ (1,0) [0|0] "" Vector__XXX
 SG_ VCSEC_a120_PARTY_vehicleEstimate m120 : 28|1@1+ (1,0) [0|0] "" Vector__XXX
 SG_ VCSEC_a158_transErr_stuckLow m158 : 28|1@1+ (1,0) [0|0] "" Vector__XXX
 SG_ VCSEC_a159_transErr_stuckLow m159 : 28|1@1+ (1,0) [0|0] "" Vector__XXX
 SG_ VCSEC_a161_transErr_stuckLow m161 : 28|1@1+ (1,0) [0|0] "" Vector__XXX
 SG_ VCSEC_a162_transErr_stuckLow m162 : 28|1@1+ (1,0) [0|0] "" Vector__XXX
 SG_ VCSEC_a166_gattAtrbtMissing m166 : 28|1@1+ (1,0) [0|0] "" Vector__XXX
 SG_ VCSEC_a167_gattAtrbtMissing m167 : 28|1@1+ (1,0) [0|0] "" Vector__XXX
 SG_ VCSEC_a168_gattAtrbtMissing m168 : 28|1@1+ (1,0) [0|0] "" Vector__XXX
 SG_ VCSEC_a169_gattAtrbtMissing m169 : 28|1@1+ (1,0) [0|0] "" Vector__XXX
 SG_ VCSEC_a170_gattAtrbtMissing m170 : 28|1@1+ (1,0) [0|0] "" Vector__XXX
 SG_ VCSEC_a212_snifferMIAFrontRight m212 : 28|1@1+ (1,0) [0|0] "" Vector__XXX
 SG_ VCSEC_a235_FPCountHighThreshRear m235 : 28|4@1+ (1,0) [0|0] "" Vector__XXX
 SG_ VCSEC_a487_unrecognizedTag m487 : 28|10@1+ (1,0) [0|0] "" Vector__XXX
 SG_ VCSEC_a021_Task1000msMissed m21 : 27|1@1+ (1,0) [0|0] "" Vector__XXX
 SG_ VCSEC_a098_PT_temperature m98 : 27|1@1+ (1,0) [0|0] "" Vector__XXX
 SG_ VCSEC_a104_PARTY_steeringControl m104 : 27|1@1+ (1,0) [0|0] "" Vector__XXX
 SG_ VCSEC_a107_VEH_packConfig m107 : 27|1@1+ (1,0) [0|0] "" Vector__XXX
 SG_ VCSEC_a108_PARTY_motorStatus m108 : 27|1@1+ (1,0) [0|0] "" Vector__XXX
 SG_ VCSEC_a109_VEH_inertial1 m109 : 27|1@1+ (1,0) [0|0] "" Vector__XXX
 SG_ VCSEC_a110_CH_carConfig m110 : 27|1@1+ (1,0) [0|0] "" Vector__XXX
 SG_ VCSEC_a111_CH_status m111 : 27|1@1+ (1,0) [0|0] "" Vector__XXX
 SG_ VCSEC_a113_VEH_powertrainControl m113 : 27|1@1+ (1,0) [0|0] "" Vector__XXX
 SG_ VCSEC_a114_PARTY_offsets m114 : 27|1@1+ (1,0) [0|0] "" Vector__XXX
 SG_ VCSEC_a116_VEH_switchStatus m116 : 27|1@1+ (1,0) [0|0] "" Vector__XXX
 SG_ VCSEC_a117_VEH_doorStatus m117 : 27|1@1+ (1,0) [0|0] "" Vector__XXX
 SG_ VCSEC_a118_PARTY_outputPowerStat m118 : 27|1@1+ (1,0) [0|0] "" Vector__XXX
 SG_ VCSEC_a120_PT_systemStatus m120 : 27|1@1+ (1,0) [0|0] "" Vector__XXX
 SG_ VCSEC_a158_transErr_framing m158 : 27|1@1+ (1,0) [0|0] "" Vector__XXX
 SG_ VCSEC_a159_transErr_framing m159 : 27|1@1+ (1,0) [0|0] "" Vector__XXX
 SG_ VCSEC_a161_transErr_framing m161 : 27|1@1+ (1,0) [0|0] "" Vector__XXX
 SG_ VCSEC_a162_transErr_framing m162 : 27|1@1+ (1,0) [0|0] "" Vector__XXX
 SG_ VCSEC_a166_gattSrvcCmdTimeout m166 : 27|1@1+ (1,0) [0|0] "" Vector__XXX
 SG_ VCSEC_a167_gattSrvcCmdTimeout m167 : 27|1@1+ (1,0) [0|0] "" Vector__XXX
 SG_ VCSEC_a168_gattSrvcCmdTimeout m168 : 27|1@1+ (1,0) [0|0] "" Vector__XXX
 SG_ VCSEC_a169_gattSrvcCmdTimeout m169 : 27|1@1+ (1,0) [0|0] "" Vector__XXX
 SG_ VCSEC_a170_gattSrvcCmdTimeout m170 : 27|1@1+ (1,0) [0|0] "" Vector__XXX
 SG_ VCSEC_a212_snifferMIAFrontLeft m212 : 27|1@1+ (1,0) [0|0] "" Vector__XXX
 SG_ VCSEC_a238_prevLocationSensor3 m238 : 27|3@1+ (1,0) [0|0] "" Vector__XXX
 SG_ VCSEC_a239_connectionReason_0002 m239 : 27|3@1+ (1,0) [0|0] "" Vector__XXX
 SG_ VCSEC_a495_CBManagerAuthorizatio m495 : 27|3@1+ (1,0) [0|0] "" Vector__XXX
 SG_ VCSEC_a021_Task1000msStarved m21 : 26|1@1+ (1,0) [0|0] "" Vector__XXX
 SG_ VCSEC_a098_PT_thermalControl m98 : 26|1@1+ (1,0) [0|0] "" Vector__XXX
 SG_ VCSEC_a104_PARTY_status m104 : 26|1@1+ (1,0) [0|0] "" Vector__XXX
 SG_ VCSEC_a107_VEH_socStatus m107 : 26|1@1+ (1,0) [0|0] "" Vector__XXX
 SG_ VCSEC_a108_PT_thermalControl m108 : 26|1@1+ (1,0) [0|0] "" Vector__XXX
 SG_ VCSEC_a109_BDY_status m109 : 26|1@1+ (1,0) [0|0] "" Vector__XXX
 SG_ VCSEC_a110_CH_airbagCutoffStatus m110 : 26|1@1+ (1,0) [0|0] "" Vector__XXX
 SG_ VCSEC_a111_PARTY_status m111 : 26|1@1+ (1,0) [0|0] "" Vector__XXX
 SG_ VCSEC_a112_CH_status m112 : 26|1@1+ (1,0) [0|0] "" Vector__XXX
 SG_ VCSEC_a113_VEH_trackModeSettings m113 : 26|1@1+ (1,0) [0|0] "" Vector__XXX
 SG_ VCSEC_a114_PARTY_brakeTorque m114 : 26|1@1+ (1,0) [0|0] "" Vector__XXX
 SG_ VCSEC_a116_VEH_restraintStatus m116 : 26|1@1+ (1,0) [0|0] "" Vector__XXX
 SG_ VCSEC_a117_BDY_falconSwitchStatu m117 : 26|1@1+ (1,0) [0|0] "" Vector__XXX
 SG_ VCSEC_a118_PARTY_LVPowerState m118 : 26|1@1+ (1,0) [0|0] "" Vector__XXX
 SG_ VCSEC_a120_PT_speed m120 : 26|1@1+ (1,0) [0|0] "" Vector__XXX
 SG_ VCSEC_a158_transErr_parity m158 : 26|1@1+ (1,0) [0|0] "" Vector__XXX
 SG_ VCSEC_a159_transErr_parity m159 : 26|1@1+ (1,0) [0|0] "" Vector__XXX
 SG_ VCSEC_a161_transErr_parity m161 : 26|1@1+ (1,0) [0|0] "" Vector__XXX
 SG_ VCSEC_a162_transErr_parity m162 : 26|1@1+ (1,0) [0|0] "" Vector__XXX
 SG_ VCSEC_a166_gapPeripCmdTimeout m166 : 26|1@1+ (1,0) [0|0] "" Vector__XXX
 SG_ VCSEC_a167_gapPeripCmdTimeout m167 : 26|1@1+ (1,0) [0|0] "" Vector__XXX
 SG_ VCSEC_a168_gapPeripCmdTimeout m168 : 26|1@1+ (1,0) [0|0] "" Vector__XXX
 SG_ VCSEC_a169_gapPeripCmdTimeout m169 : 26|1@1+ (1,0) [0|0] "" Vector__XXX
 SG_ VCSEC_a170_gapPeripCmdTimeout m170 : 26|1@1+ (1,0) [0|0] "" Vector__XXX
 SG_ VCSEC_a177_newKeyPublicKey m177 : 26|20@1+ (1,0) [0|0] "" Vector__XXX
 SG_ VCSEC_a212_snifferMIARearRight m212 : 26|1@1+ (1,0) [0|0] "" Vector__XXX
 SG_ VCSEC_a254_updatedKeyPublicKey m254 : 26|20@1+ (1,0) [0|0] "" Vector__XXX
 SG_ VCSEC_a496_runningState_timefram m496 : 26|3@1+ (1,0) [0|0] "" Vector__XXX
 SG_ VCSEC_a021_Task1000msLate m21 : 25|1@1+ (1,0) [0|0] "" Vector__XXX
 SG_ VCSEC_a089_VEH_party3 m89 : 25|1@1+ (1,0) [0|0] "" Vector__XXX
 SG_ VCSEC_a098_PARTY_torque m98 : 25|1@1+ (1,0) [0|0] "" Vector__XXX
 SG_ VCSEC_a104_CH_status m104 : 25|1@1+ (1,0) [0|0] "" Vector__XXX
 SG_ VCSEC_a107_PT_socStatus m107 : 25|1@1+ (1,0) [0|0] "" Vector__XXX
 SG_ VCSEC_a108_PT_temperature m108 : 25|1@1+ (1,0) [0|0] "" Vector__XXX
 SG_ VCSEC_a109_BDY_inertial2 m109 : 25|1@1+ (1,0) [0|0] "" Vector__XXX
 SG_ VCSEC_a110_VEH_canLogAvailabilit m110 : 25|1@1+ (1,0) [0|0] "" Vector__XXX
 SG_ VCSEC_a111_VEH_seatStatus m111 : 25|1@1+ (1,0) [0|0] "" Vector__XXX
 SG_ VCSEC_a112_PARTY_status m112 : 25|1@1+ (1,0) [0|0] "" Vector__XXX
 SG_ VCSEC_a113_VEH_chassisControl m113 : 25|1@1+ (1,0) [0|0] "" Vector__XXX
 SG_ VCSEC_a114_VEH_wheelRotation m114 : 25|1@1+ (1,0) [0|0] "" Vector__XXX
 SG_ VCSEC_a116_VEH_seatHeatStatus m116 : 25|1@1+ (1,0) [0|0] "" Vector__XXX
 SG_ VCSEC_a117_VEH_seatStatus m117 : 25|1@1+ (1,0) [0|0] "" Vector__XXX
 SG_ VCSEC_a118_VEH_systemStatus m118 : 25|1@1+ (1,0) [0|0] "" Vector__XXX
 SG_ VCSEC_a120_PARTY_status m120 : 25|1@1+ (1,0) [0|0] "" Vector__XXX
 SG_ VCSEC_a158_transErr_dropped m158 : 25|1@1+ (1,0) [0|0] "" Vector__XXX
 SG_ VCSEC_a159_transErr_dropped m159 : 25|1@1+ (1,0) [0|0] "" Vector__XXX
 SG_ VCSEC_a161_transErr_dropped m161 : 25|1@1+ (1,0) [0|0] "" Vector__XXX
 SG_ VCSEC_a162_transErr_dropped m162 : 25|1@1+ (1,0) [0|0] "" Vector__XXX
 SG_ VCSEC_a166_gapCommandTimeout m166 : 25|1@1+ (1,0) [0|0] "" Vector__XXX
 SG_ VCSEC_a167_gapCommandTimeout m167 : 25|1@1+ (1,0) [0|0] "" Vector__XXX
 SG_ VCSEC_a168_gapCommandTimeout m168 : 25|1@1+ (1,0) [0|0] "" Vector__XXX
 SG_ VCSEC_a169_gapCommandTimeout m169 : 25|1@1+ (1,0) [0|0] "" Vector__XXX
 SG_ VCSEC_a170_gapCommandTimeout m170 : 25|1@1+ (1,0) [0|0] "" Vector__XXX
 SG_ VCSEC_a212_snifferMIARearLeft m212 : 25|1@1+ (1,0) [0|0] "" Vector__XXX
 SG_ VCSEC_a006_mailboxID m6 : 24|8@1+ (1,0) [0|0] "" Vector__XXX
 SG_ VCSEC_a021_Task100msMissed m21 : 24|1@1+ (1,0) [0|0] "" Vector__XXX
 SG_ VCSEC_a022_TaskInitError0 m22 : 24|8@1+ (1,0) [0|0] "" Vector__XXX
 SG_ VCSEC_a031_uds_bytes_1 m31 : 24|8@1+ (1,0) [0|0] "" Vector__XXX
 SG_ VCSEC_a041_CPULoad1msTask m41 : 24|8@1+ (1,0) [0|0] "" Vector__XXX
 SG_ VCSEC_a042_Usage10msTask m42 : 24|8@1+ (1,0) [0|0] "" Vector__XXX
 SG_ VCSEC_a063_switchType m63 : 24|8@1+ (1,0) [0|0] "" Vector__XXX
 SG_ VCSEC_a086_VEH_vehNm m86 : 24|1@1+ (1,0) [0|0] "" Vector__XXX
 SG_ VCSEC_a087_VEH_motorStatus m87 : 24|1@1+ (1,0) [0|0] "" Vector__XXX
 SG_ VCSEC_a088_VEH_motorStatus m88 : 24|1@1+ (1,0) [0|0] "" Vector__XXX
 SG_ VCSEC_a089_VEH_party1 m89 : 24|1@1+ (1,0) [0|0] "" Vector__XXX
 SG_ VCSEC_a098_PARTY_thermalControl m98 : 24|1@1+ (1,0) [0|0] "" Vector__XXX
 SG_ VCSEC_a104_PARTY_gpsAccuracies m104 : 24|1@1+ (1,0) [0|0] "" Vector__XXX
 SG_ VCSEC_a107_PT_thermalStatus m107 : 24|1@1+ (1,0) [0|0] "" Vector__XXX
 SG_ VCSEC_a108_PARTY_thermalControl m108 : 24|1@1+ (1,0) [0|0] "" Vector__XXX
 SG_ VCSEC_a109_BDY_inertial1 m109 : 24|1@1+ (1,0) [0|0] "" Vector__XXX
 SG_ VCSEC_a110_VEH_gearControl m110 : 24|1@1+ (1,0) [0|0] "" Vector__XXX
 SG_ VCSEC_a111_VEH_LVPowerState m111 : 24|1@1+ (1,0) [0|0] "" Vector__XXX
 SG_ VCSEC_a112_VEH_LVPowerState m112 : 24|1@1+ (1,0) [0|0] "" Vector__XXX
 SG_ VCSEC_a113_VEH_ventCntlReq m113 : 24|1@1+ (1,0) [0|0] "" Vector__XXX
 SG_ VCSEC_a114_CH_wheelRotation m114 : 24|1@1+ (1,0) [0|0] "" Vector__XXX
 SG_ VCSEC_a116_VEH_doorStatus m116 : 24|1@1+ (1,0) [0|0] "" Vector__XXX
 SG_ VCSEC_a117_VEH_lightStatus m117 : 24|1@1+ (1,0) [0|0] "" Vector__XXX
 SG_ VCSEC_a118_VEH_12VBatteryStatus m118 : 24|1@1+ (1,0) [0|0] "" Vector__XXX
 SG_ VCSEC_a120_VEH_speed m120 : 24|1@1+ (1,0) [0|0] "" Vector__XXX
 SG_ VCSEC_a140_multipleTriesToAuth m140 : 24|1@1+ (1,0) [0|0] "" Vector__XXX
 SG_ VCSEC_a158_transErr_noise m158 : 24|1@1+ (1,0) [0|0] "" Vector__XXX
 SG_ VCSEC_a159_transErr_noise m159 : 24|1@1+ (1,0) [0|0] "" Vector__XXX
 SG_ VCSEC_a161_transErr_noise m161 : 24|1@1+ (1,0) [0|0] "" Vector__XXX
 SG_ VCSEC_a162_transErr_noise m162 : 24|1@1+ (1,0) [0|0] "" Vector__XXX
 SG_ VCSEC_a166_reasonMIA m166 : 24|1@1+ (1,0) [0|0] "" Vector__XXX
 SG_ VCSEC_a167_reasonMIA m167 : 24|1@1+ (1,0) [0|0] "" Vector__XXX
 SG_ VCSEC_a168_reasonMIA m168 : 24|1@1+ (1,0) [0|0] "" Vector__XXX
 SG_ VCSEC_a169_reasonMIA m169 : 24|1@1+ (1,0) [0|0] "" Vector__XXX
 SG_ VCSEC_a170_reasonMIA m170 : 24|1@1+ (1,0) [0|0] "" Vector__XXX
 SG_ VCSEC_a181_fault m181 : 24|5@1+ (1,0) [0|0] "" Vector__XXX
 SG_ VCSEC_a197_errorInconfrmtn m197 : 24|8@1+ (1,0) [0|0] "" Vector__XXX
 SG_ VCSEC_a206_assertSubcause m206 : 24|8@1+ (1,0) [0|0] "" Vector__XXX
 SG_ VCSEC_a207_assertSubcause m207 : 24|8@1+ (1,0) [0|0] "" Vector__XXX
 SG_ VCSEC_a208_assertSubcause m208 : 24|8@1+ (1,0) [0|0] "" Vector__XXX
 SG_ VCSEC_a209_assertSubcause m209 : 24|8@1+ (1,0) [0|0] "" Vector__XXX
 SG_ VCSEC_a212_snifferMIACradle m212 : 24|1@1+ (1,0) [0|0] "" Vector__XXX
 SG_ VCSEC_a215_BLEDisconnectReason m215 : 24|8@1+ (1,0) [0|0] "" Vector__XXX
 SG_ VCSEC_a216_BLEDisconnectReason m216 : 24|8@1+ (1,0) [0|0] "" Vector__XXX
 SG_ VCSEC_a217_BLEDisconnectReason m217 : 24|8@1+ (1,0) [0|0] "" Vector__XXX
 SG_ VCSEC_a218_BLEDisconnectReason m218 : 24|8@1+ (1,0) [0|0] "" Vector__XXX
 SG_ VCSEC_a235_FPCountHighThreshCent m235 : 24|4@1+ (1,0) [0|0] "" Vector__XXX
 SG_ VCSEC_a238_prevLocationSensor2 m238 : 24|3@1+ (1,0) [0|0] "" Vector__XXX
 SG_ VCSEC_a239_connectionReason_0001 m239 : 24|3@1+ (1,0) [0|0] "" Vector__XXX
 SG_ VCSEC_a245_currentCRC m245 : 24|32@1+ (1,0) [0|0] "" Vector__XXX
 SG_ VCSEC_a246_currentCRC m246 : 24|32@1+ (1,0) [0|0] "" Vector__XXX
 SG_ VCSEC_a247_currentCRC m247 : 24|32@1+ (1,0) [0|0] "" Vector__XXX
 SG_ VCSEC_a248_currentCRC m248 : 24|32@1+ (1,0) [0|0] "" Vector__XXX
 SG_ VCSEC_a256_failureReason m256 : 24|6@1+ (1,0) [0|0] "" Vector__XXX
 SG_ VCSEC_a257_keyID m257 : 24|24@1+ (1,0) [0|0] "" Vector__XXX
 SG_ VCSEC_a258_keyID m258 : 24|24@1+ (1,0) [0|0] "" Vector__XXX
 SG_ VCSEC_a264_dispatcherChannel m264 : 24|8@1+ (1,0) [0|0] "" Vector__XXX
 SG_ VCSEC_a303_whitelistChannel m303 : 24|5@1+ (1,0) [0|0] "" Vector__XXX
 SG_ VCSEC_a305_pendingOpcode m305 : 24|8@1+ (1,0) [0|0] "" Vector__XXX
 SG_ VCSEC_a309_whichProtobuf m309 : 24|8@1+ (1,0) [0|0] "" Vector__XXX
 SG_ VCSEC_a310_filteredFalsePos_0000 m310 : 24|1@1+ (1,0) [0|0] "" Vector__XXX
 SG_ VCSEC_a312_RSSI m312 : 24|8@1- (1,0) [0|0] "" Vector__XXX
 SG_ VCSEC_a315_connection m315 : 24|5@1+ (1,0) [0|0] "" Vector__XXX
 SG_ VCSEC_a436_expectedUHFHardware m436 : 24|8@1+ (1,0) [0|0] "" Vector__XXX
 SG_ VCSEC_a478_numUWBsample m478 : 24|32@1+ (1,0) [0|0] "" Vector__XXX
 SG_ VCSEC_a479_NIStateRight0 m479 : 24|5@1+ (1,0) [0|0] "" Vector__XXX
 SG_ VCSEC_a480_NIStateRight1 m480 : 24|5@1+ (1,0) [0|0] "" Vector__XXX
 SG_ VCSEC_a481_NIStateRight2 m481 : 24|5@1+ (1,0) [0|0] "" Vector__XXX
 SG_ VCSEC_a487_protoChannel m487 : 24|4@1+ (1,0) [0|0] "" Vector__XXX
 SG_ VCSEC_a495_CBManagerState_timefr m495 : 24|3@1+ (1,0) [0|0] "" Vector__XXX
 SG_ VCSEC_a496_runningState m496 : 24|2@1+ (1,0) [0|0] "" Vector__XXX
 SG_ VCSEC_a499_assertReason m499 : 24|8@1+ (1,0) [0|0] "" Vector__XXX
 SG_ VCSEC_a500_assertReason m500 : 24|8@1+ (1,0) [0|0] "" Vector__XXX
 SG_ VCSEC_a501_assertReason m501 : 24|8@1+ (1,0) [0|0] "" Vector__XXX
 SG_ VCSEC_a502_assertReason m502 : 24|8@1+ (1,0) [0|0] "" Vector__XXX
 SG_ VCSEC_a521_confidenceFR m521 : 24|7@1+ (1,0) [0|0] "" Vector__XXX
 SG_ VCSEC_a522_confidenceFR m522 : 24|7@1+ (1,0) [0|0] "" Vector__XXX
 SG_ VCSEC_a523_confidenceFR m523 : 24|7@1+ (1,0) [0|0] "" Vector__XXX
 SG_ VCSEC_a524_confidenceFR m524 : 24|7@1+ (1,0) [0|0] "" Vector__XXX
 SG_ VCSEC_a021_Task100msStarved m21 : 23|1@1+ (1,0) [0|0] "" Vector__XXX
 SG_ VCSEC_a086_VEH_thermalStatus m86 : 23|1@1+ (1,0) [0|0] "" Vector__XXX
 SG_ VCSEC_a087_PARTY_thermalControl m87 : 23|1@1+ (1,0) [0|0] "" Vector__XXX
 SG_ VCSEC_a088_PARTY_thermalControl m88 : 23|1@1+ (1,0) [0|0] "" Vector__XXX
 SG_ VCSEC_a089_CH_party3 m89 : 23|1@1+ (1,0) [0|0] "" Vector__XXX
 SG_ VCSEC_a098_PARTY_temperature m98 : 23|1@1+ (1,0) [0|0] "" Vector__XXX
 SG_ VCSEC_a104_PARTY_bodyControls m104 : 23|1@1+ (1,0) [0|0] "" Vector__XXX
 SG_ VCSEC_a107_PT_status m107 : 23|1@1+ (1,0) [0|0] "" Vector__XXX
 SG_ VCSEC_a108_PARTY_temperature m108 : 23|1@1+ (1,0) [0|0] "" Vector__XXX
 SG_ VCSEC_a109_BDY_imuOffsets m109 : 23|1@1+ (1,0) [0|0] "" Vector__XXX
 SG_ VCSEC_a110_VEH_bmpDebug m110 : 23|1@1+ (1,0) [0|0] "" Vector__XXX
 SG_ VCSEC_a111_RIPC_switchStatus m111 : 23|1@1+ (1,0) [0|0] "" Vector__XXX
 SG_ VCSEC_a112_LIPC_switchStatus m112 : 23|1@1+ (1,0) [0|0] "" Vector__XXX
 SG_ VCSEC_a113_VEH_solarData m113 : 23|1@1+ (1,0) [0|0] "" Vector__XXX
 SG_ VCSEC_a114_PARTY_wheelRotation m114 : 23|1@1+ (1,0) [0|0] "" Vector__XXX
 SG_ VCSEC_a115_CH_TPMSDisplay m115 : 23|1@1+ (1,0) [0|0] "" Vector__XXX
 SG_ VCSEC_a116_VEH_thsStatus m116 : 23|1@1+ (1,0) [0|0] "" Vector__XXX
 SG_ VCSEC_a117_VEH_restraintStatus m117 : 23|1@1+ (1,0) [0|0] "" Vector__XXX
 SG_ VCSEC_a118_VEH_vehicleStatus m118 : 23|1@1+ (1,0) [0|0] "" Vector__XXX
 SG_ VCSEC_a120_PARTY_speed m120 : 23|1@1+ (1,0) [0|0] "" Vector__XXX
 SG_ VCSEC_a140_cardRmvdB4RecvingID m140 : 23|1@1+ (1,0) [0|0] "" Vector__XXX
 SG_ VCSEC_a158_transmitTimeout m158 : 23|1@1+ (1,0) [0|0] "" Vector__XXX
 SG_ VCSEC_a159_transmitTimeout m159 : 23|1@1+ (1,0) [0|0] "" Vector__XXX
 SG_ VCSEC_a161_transmitTimeout m161 : 23|1@1+ (1,0) [0|0] "" Vector__XXX
 SG_ VCSEC_a162_transmitTimeout m162 : 23|1@1+ (1,0) [0|0] "" Vector__XXX
 SG_ VCSEC_a212_snifferMIASecondary m212 : 23|1@1+ (1,0) [0|0] "" Vector__XXX
 SG_ VCSEC_a496_hasIMUSupportEnabled m496 : 23|1@1+ (1,0) [0|0] "" Vector__XXX
 SG_ VCSEC_a021_Task100msLate m21 : 22|1@1+ (1,0) [0|0] "" Vector__XXX
 SG_ VCSEC_a086_VEH_systemStatus m86 : 22|1@1+ (1,0) [0|0] "" Vector__XXX
 SG_ VCSEC_a087_PARTY_temperature m87 : 22|1@1+ (1,0) [0|0] "" Vector__XXX
 SG_ VCSEC_a088_PARTY_temperature m88 : 22|1@1+ (1,0) [0|0] "" Vector__XXX
 SG_ VCSEC_a089_CH_party1 m89 : 22|1@1+ (1,0) [0|0] "" Vector__XXX
 SG_ VCSEC_a098_PARTY_status m98 : 22|1@1+ (1,0) [0|0] "" Vector__XXX
 SG_ VCSEC_a104_PARTY_control m104 : 22|1@1+ (1,0) [0|0] "" Vector__XXX
 SG_ VCSEC_a107_PT_ptNm m107 : 22|1@1+ (1,0) [0|0] "" Vector__XXX
 SG_ VCSEC_a108_PARTY_status m108 : 22|1@1+ (1,0) [0|0] "" Vector__XXX
 SG_ VCSEC_a109_PARTY_inertial1 m109 : 22|1@1+ (1,0) [0|0] "" Vector__XXX
 SG_ VCSEC_a110_VEH_vin m110 : 22|1@1+ (1,0) [0|0] "" Vector__XXX
 SG_ VCSEC_a111_RIPC_remoteADC m111 : 22|1@1+ (1,0) [0|0] "" Vector__XXX
 SG_ VCSEC_a112_LIPC_remoteADC m112 : 22|1@1+ (1,0) [0|0] "" Vector__XXX
 SG_ VCSEC_a113_VEH_corianderVehicleC m113 : 22|1@1+ (1,0) [0|0] "" Vector__XXX
 SG_ VCSEC_a114_VEH_status m114 : 22|1@1+ (1,0) [0|0] "" Vector__XXX
 SG_ VCSEC_a115_UI_corianderVehicleCo m115 : 22|1@1+ (1,0) [0|0] "" Vector__XXX
 SG_ VCSEC_a116_VEH_seatStatus m116 : 22|1@1+ (1,0) [0|0] "" Vector__XXX
 SG_ VCSEC_a117_VEH_LVPowerState m117 : 22|1@1+ (1,0) [0|0] "" Vector__XXX
 SG_ VCSEC_a118_VEH_coolant m118 : 22|1@1+ (1,0) [0|0] "" Vector__XXX
 SG_ VCSEC_a120_PARTY_locStatus m120 : 22|1@1+ (1,0) [0|0] "" Vector__XXX
 SG_ VCSEC_a140_cardRmvdB4SndingReqID m140 : 22|1@1+ (1,0) [0|0] "" Vector__XXX
 SG_ VCSEC_a158_endpointNotAcking m158 : 22|1@1+ (1,0) [0|0] "" Vector__XXX
 SG_ VCSEC_a159_endpointNotAcking m159 : 22|1@1+ (1,0) [0|0] "" Vector__XXX
 SG_ VCSEC_a161_endpointNotAcking m161 : 22|1@1+ (1,0) [0|0] "" Vector__XXX
 SG_ VCSEC_a162_endpointNotAcking m162 : 22|1@1+ (1,0) [0|0] "" Vector__XXX
 SG_ VCSEC_a211_RSSIValidMatrix m211 : 22|24@1+ (1,0) [0|0] "" Vector__XXX
 SG_ VCSEC_a212_snifferMIAFront m212 : 22|1@1+ (1,0) [0|0] "" Vector__XXX
 SG_ VCSEC_a496_hasBatteryOptimizatio m496 : 22|1@1+ (1,0) [0|0] "" Vector__XXX
 SG_ VCSEC_a529_sensor3Rotation m529 : 22|2@1+ (1,0) [0|0] "" Vector__XXX
 SG_ VCSEC_a012_ExternalReset m12 : 21|1@1+ (1,0) [0|0] "" Vector__XXX
 SG_ VCSEC_a021_Task10msMissed m21 : 21|1@1+ (1,0) [0|0] "" Vector__XXX
 SG_ VCSEC_a086_VEH_lightStatus m86 : 21|1@1+ (1,0) [0|0] "" Vector__XXX
 SG_ VCSEC_a087_PARTY_status m87 : 21|1@1+ (1,0) [0|0] "" Vector__XXX
 SG_ VCSEC_a088_PARTY_status m88 : 21|1@1+ (1,0) [0|0] "" Vector__XXX
 SG_ VCSEC_a089_CH_status m89 : 21|1@1+ (1,0) [0|0] "" Vector__XXX
 SG_ VCSEC_a098_VEH_torque m98 : 21|1@1+ (1,0) [0|0] "" Vector__XXX
 SG_ VCSEC_a103_VEH_evseStatus m103 : 21|1@1+ (1,0) [0|0] "" Vector__XXX
 SG_ VCSEC_a104_CH_control m104 : 21|1@1+ (1,0) [0|0] "" Vector__XXX
 SG_ VCSEC_a107_VEH_powerAvailable m107 : 21|1@1+ (1,0) [0|0] "" Vector__XXX
 SG_ VCSEC_a108_PARTY_torque m108 : 21|1@1+ (1,0) [0|0] "" Vector__XXX
 SG_ VCSEC_a109_VEH_imuOffsets m109 : 21|1@1+ (1,0) [0|0] "" Vector__XXX
 SG_ VCSEC_a110_VEH_mismatchFault m110 : 21|1@1+ (1,0) [0|0] "" Vector__XXX
 SG_ VCSEC_a111_RIPC_railStatus m111 : 21|1@1+ (1,0) [0|0] "" Vector__XXX
 SG_ VCSEC_a112_LIPC_railStatus m112 : 21|1@1+ (1,0) [0|0] "" Vector__XXX
 SG_ VCSEC_a113_VEH_peripheralPowerRe m113 : 21|1@1+ (1,0) [0|0] "" Vector__XXX
 SG_ VCSEC_a114_VEH_party3 m114 : 21|1@1+ (1,0) [0|0] "" Vector__XXX
 SG_ VCSEC_a115_REM_authentication m115 : 21|1@1+ (1,0) [0|0] "" Vector__XXX
 SG_ VCSEC_a116_VEH_lightStatus m116 : 21|1@1+ (1,0) [0|0] "" Vector__XXX
 SG_ VCSEC_a117_VEH_hvacBlowerFdb m117 : 21|1@1+ (1,0) [0|0] "" Vector__XXX
 SG_ VCSEC_a118_VEH_LVPowerState m118 : 21|1@1+ (1,0) [0|0] "" Vector__XXX
 SG_ VCSEC_a119_PARTY_steerAngle m119 : 21|1@1+ (1,0) [0|0] "" Vector__XXX
 SG_ VCSEC_a120_VEH_torque m120 : 21|1@1+ (1,0) [0|0] "" Vector__XXX
 SG_ VCSEC_a140_cardRmvdB4SndingChaln m140 : 21|1@1+ (1,0) [0|0] "" Vector__XXX
 SG_ VCSEC_a158_endpointStuckRepeatin m158 : 21|1@1+ (1,0) [0|0] "" Vector__XXX
 SG_ VCSEC_a159_endpointStuckRepeatin m159 : 21|1@1+ (1,0) [0|0] "" Vector__XXX
 SG_ VCSEC_a161_endpointStuckRepeatin m161 : 21|1@1+ (1,0) [0|0] "" Vector__XXX
 SG_ VCSEC_a162_endpointStuckRepeatin m162 : 21|1@1+ (1,0) [0|0] "" Vector__XXX
 SG_ VCSEC_a177_signingKeySlot m177 : 21|5@1+ (1,0) [0|0] "" Vector__XXX
 SG_ VCSEC_a197_confrmtnTimeout m197 : 21|1@1+ (1,0) [0|0] "" Vector__XXX
 SG_ VCSEC_a212_accessAddressInvalid m212 : 21|1@1+ (1,0) [0|0] "" Vector__XXX
 SG_ VCSEC_a254_signingKeySlot m254 : 21|5@1+ (1,0) [0|0] "" Vector__XXX
 SG_ VCSEC_a312_isKeyfob m312 : 21|1@1+ (1,0) [0|0] "" Vector__XXX
 SG_ VCSEC_a495_CBManagerState m495 : 21|3@1+ (1,0) [0|0] "" Vector__XXX
 SG_ VCSEC_a496_hasUWBRangingPermissi m496 : 21|1@1+ (1,0) [0|0] "" Vector__XXX
 SG_ VCSEC_a005_faults0 m5 : 20|12@1+ (1,0) [0|0] "" Vector__XXX
 SG_ VCSEC_a006_fault m6 : 20|4@1+ (1,0) [0|0] "" Vector__XXX
 SG_ VCSEC_a012_DebugReset m12 : 20|1@1+ (1,0) [0|0] "" Vector__XXX
 SG_ VCSEC_a021_Task10msStarved m21 : 20|1@1+ (1,0) [0|0] "" Vector__XXX
 SG_ VCSEC_a086_VEH_LVPowerState m86 : 20|1@1+ (1,0) [0|0] "" Vector__XXX
 SG_ VCSEC_a087_PARTY_torque m87 : 20|1@1+ (1,0) [0|0] "" Vector__XXX
 SG_ VCSEC_a088_PARTY_torque m88 : 20|1@1+ (1,0) [0|0] "" Vector__XXX
 SG_ VCSEC_a089_BDY_status m89 : 20|1@1+ (1,0) [0|0] "" Vector__XXX
 SG_ VCSEC_a098_VEH_temperature m98 : 20|1@1+ (1,0) [0|0] "" Vector__XXX
 SG_ VCSEC_a100_OBD m100 : 20|1@1+ (1,0) [0|0] "" Vector__XXX
 SG_ VCSEC_a101_BDY_locState m101 : 20|1@1+ (1,0) [0|0] "" Vector__XXX
 SG_ VCSEC_a103_PT_status m103 : 20|1@1+ (1,0) [0|0] "" Vector__XXX
 SG_ VCSEC_a104_VEH_thermalStatus m104 : 20|1@1+ (1,0) [0|0] "" Vector__XXX
 SG_ VCSEC_a106_CH_alertMatrix m106 : 20|1@1+ (1,0) [0|0] "" Vector__XXX
 SG_ VCSEC_a107_VEH_bmbMinMax m107 : 20|1@1+ (1,0) [0|0] "" Vector__XXX
 SG_ VCSEC_a108_VEH_status m108 : 20|1@1+ (1,0) [0|0] "" Vector__XXX
 SG_ VCSEC_a109_VEH_status m109 : 20|1@1+ (1,0) [0|0] "" Vector__XXX
 SG_ VCSEC_a110_VEH_vehNm m110 : 20|1@1+ (1,0) [0|0] "" Vector__XXX
 SG_ VCSEC_a111_RIPC_epbPrivateState m111 : 20|1@1+ (1,0) [0|0] "" Vector__XXX
 SG_ VCSEC_a112_LIPC_epbPrivateState m112 : 20|1@1+ (1,0) [0|0] "" Vector__XXX
 SG_ VCSEC_a113_VEH_vehicleControl2 m113 : 20|1@1+ (1,0) [0|0] "" Vector__XXX
 SG_ VCSEC_a114_PARTY_party3 m114 : 20|1@1+ (1,0) [0|0] "" Vector__XXX
 SG_ VCSEC_a115_VEH_requests2 m115 : 20|1@1+ (1,0) [0|0] "" Vector__XXX
 SG_ VCSEC_a116_VEH_LVPowerState m116 : 20|1@1+ (1,0) [0|0] "" Vector__XXX
 SG_ VCSEC_a117_VEH_vehNm m117 : 20|1@1+ (1,0) [0|0] "" Vector__XXX
 SG_ VCSEC_a118_VEH_okToUseHighPwr m118 : 20|1@1+ (1,0) [0|0] "" Vector__XXX
 SG_ VCSEC_a119_CH_steerAngle m119 : 20|1@1+ (1,0) [0|0] "" Vector__XXX
 SG_ VCSEC_a120_PARTY_torque m120 : 20|1@1+ (1,0) [0|0] "" Vector__XXX
 SG_ VCSEC_a140_cardRmvdB4AuthComplet m140 : 20|1@1+ (1,0) [0|0] "" Vector__XXX
 SG_ VCSEC_a142_endDiscoCmdStatus m142 : 20|1@1+ (1,0) [0|0] "" Vector__XXX
 SG_ VCSEC_a143_endDiscoCmdStatus m143 : 20|1@1+ (1,0) [0|0] "" Vector__XXX
 SG_ VCSEC_a144_endDiscoCmdStatus m144 : 20|1@1+ (1,0) [0|0] "" Vector__XXX
 SG_ VCSEC_a145_endDiscoCmdStatus m145 : 20|1@1+ (1,0) [0|0] "" Vector__XXX
 SG_ VCSEC_a158_packetTooShort m158 : 20|1@1+ (1,0) [0|0] "" Vector__XXX
 SG_ VCSEC_a159_packetTooShort m159 : 20|1@1+ (1,0) [0|0] "" Vector__XXX
 SG_ VCSEC_a161_packetTooShort m161 : 20|1@1+ (1,0) [0|0] "" Vector__XXX
 SG_ VCSEC_a162_packetTooShort m162 : 20|1@1+ (1,0) [0|0] "" Vector__XXX
 SG_ VCSEC_a197_connHandleMismatch m197 : 20|1@1+ (1,0) [0|0] "" Vector__XXX
 SG_ VCSEC_a211_connectionCount m211 : 20|2@1+ (1,0) [0|0] "" Vector__XXX
 SG_ VCSEC_a212_snifferMIARear m212 : 20|1@1+ (1,0) [0|0] "" Vector__XXX
 SG_ VCSEC_a235_FPCountHighThreshRigh m235 : 20|4@1+ (1,0) [0|0] "" Vector__XXX
 SG_ VCSEC_a245_TPMSReason m245 : 20|3@1+ (1,0) [0|0] "" Vector__XXX
 SG_ VCSEC_a246_TPMSReason m246 : 20|3@1+ (1,0) [0|0] "" Vector__XXX
 SG_ VCSEC_a247_TPMSReason m247 : 20|3@1+ (1,0) [0|0] "" Vector__XXX
 SG_ VCSEC_a248_TPMSReason m248 : 20|3@1+ (1,0) [0|0] "" Vector__XXX
 SG_ VCSEC_a274_advPeriod m274 : 20|11@1+ (1,0) [0|0] "" Vector__XXX
 SG_ VCSEC_a496_hasLegacyBluetoothAdm m496 : 20|1@1+ (1,0) [0|0] "" Vector__XXX
 SG_ VCSEC_a529_sensor2Rotation m529 : 20|2@1+ (1,0) [0|0] "" Vector__XXX
 SG_ VCSEC_a012_CheckstopReset m12 : 19|1@1+ (1,0) [0|0] "" Vector__XXX
 SG_ VCSEC_a021_Task10msLate m21 : 19|1@1+ (1,0) [0|0] "" Vector__XXX
 SG_ VCSEC_a082_RIPC_remoteMux m82 : 19|1@1+ (1,0) [0|0] "" Vector__XXX
 SG_ VCSEC_a083_LIPC_HSDFaults m83 : 19|1@1+ (1,0) [0|0] "" Vector__XXX
 SG_ VCSEC_a086_VEH_12VBatteryStatus m86 : 19|1@1+ (1,0) [0|0] "" Vector__XXX
 SG_ VCSEC_a087_VEH_status m87 : 19|1@1+ (1,0) [0|0] "" Vector__XXX
 SG_ VCSEC_a088_VEH_status m88 : 19|1@1+ (1,0) [0|0] "" Vector__XXX
 SG_ VCSEC_a089_BDY_party1 m89 : 19|1@1+ (1,0) [0|0] "" Vector__XXX
 SG_ VCSEC_a090_CH_eacMonitor m90 : 19|1@1+ (1,0) [0|0] "" Vector__XXX
 SG_ VCSEC_a092_VEH_vehNm m92 : 19|1@1+ (1,0) [0|0] "" Vector__XXX
 SG_ VCSEC_a093_VEH_vehNm m93 : 19|1@1+ (1,0) [0|0] "" Vector__XXX
 SG_ VCSEC_a098_VEH_thermalControl m98 : 19|1@1+ (1,0) [0|0] "" Vector__XXX
 SG_ VCSEC_a100_CH m100 : 19|1@1+ (1,0) [0|0] "" Vector__XXX
 SG_ VCSEC_a101_VEH_locState m101 : 19|1@1+ (1,0) [0|0] "" Vector__XXX
 SG_ VCSEC_a102_VEH_rods m102 : 19|1@1+ (1,0) [0|0] "" Vector__XXX
 SG_ VCSEC_a103_PT_ptNm m103 : 19|1@1+ (1,0) [0|0] "" Vector__XXX
 SG_ VCSEC_a104_BDY_bodyControls3 m104 : 19|1@1+ (1,0) [0|0] "" Vector__XXX
 SG_ VCSEC_a106_CH_dcdcRailStatus m106 : 19|1@1+ (1,0) [0|0] "" Vector__XXX
 SG_ VCSEC_a107_VEH_thermalStatus m107 : 19|1@1+ (1,0) [0|0] "" Vector__XXX
 SG_ VCSEC_a108_VEH_torque m108 : 19|1@1+ (1,0) [0|0] "" Vector__XXX
 SG_ VCSEC_a109_PARTY_collision m109 : 19|1@1+ (1,0) [0|0] "" Vector__XXX
 SG_ VCSEC_a110_VEH_updateStatus m110 : 19|1@1+ (1,0) [0|0] "" Vector__XXX
 SG_ VCSEC_a111_RIPC_LVPowerState m111 : 19|1@1+ (1,0) [0|0] "" Vector__XXX
 SG_ VCSEC_a112_LIPC_LVPowerState m112 : 19|1@1+ (1,0) [0|0] "" Vector__XXX
 SG_ VCSEC_a113_VEH_vehicleControl m113 : 19|1@1+ (1,0) [0|0] "" Vector__XXX
 SG_ VCSEC_a114_CH_wheelSpeeds m114 : 19|1@1+ (1,0) [0|0] "" Vector__XXX
 SG_ VCSEC_a115_VEH_requests m115 : 19|1@1+ (1,0) [0|0] "" Vector__XXX
 SG_ VCSEC_a116_VEH_hvacStatus m116 : 19|1@1+ (1,0) [0|0] "" Vector__XXX
 SG_ VCSEC_a117_PARTY_epbmStatus m117 : 19|1@1+ (1,0) [0|0] "" Vector__XXX
 SG_ VCSEC_a118_VEH_status m118 : 19|1@1+ (1,0) [0|0] "" Vector__XXX
 SG_ VCSEC_a119_PARTY_rightStalk m119 : 19|1@1+ (1,0) [0|0] "" Vector__XXX
 SG_ VCSEC_a120_PARTY_systemStatus m120 : 19|1@1+ (1,0) [0|0] "" Vector__XXX
 SG_ VCSEC_a140_authenticationTimeout m140 : 19|1@1+ (1,0) [0|0] "" Vector__XXX
 SG_ VCSEC_a142_discoDoneEventError m142 : 19|1@1+ (1,0) [0|0] "" Vector__XXX
 SG_ VCSEC_a143_discoDoneEventError m143 : 19|1@1+ (1,0) [0|0] "" Vector__XXX
 SG_ VCSEC_a144_discoDoneEventError m144 : 19|1@1+ (1,0) [0|0] "" Vector__XXX
 SG_ VCSEC_a145_discoDoneEventError m145 : 19|1@1+ (1,0) [0|0] "" Vector__XXX
 SG_ VCSEC_a158_packetTooLong m158 : 19|1@1+ (1,0) [0|0] "" Vector__XXX
 SG_ VCSEC_a159_packetTooLong m159 : 19|1@1+ (1,0) [0|0] "" Vector__XXX
 SG_ VCSEC_a161_packetTooLong m161 : 19|1@1+ (1,0) [0|0] "" Vector__XXX
 SG_ VCSEC_a162_packetTooLong m162 : 19|1@1+ (1,0) [0|0] "" Vector__XXX
 SG_ VCSEC_a212_snifferMIARight m212 : 19|1@1+ (1,0) [0|0] "" Vector__XXX
 SG_ VCSEC_a219_pairingRemovedSensor3 m219 : 19|1@1+ (1,0) [0|0] "" Vector__XXX
 SG_ VCSEC_a238_prevLocationSensor1 m238 : 19|3@1+ (1,0) [0|0] "" Vector__XXX
 SG_ VCSEC_a239_connectionReason_0000 m239 : 19|3@1+ (1,0) [0|0] "" Vector__XXX
 SG_ VCSEC_a274_highThreshRearPresent m274 : 19|1@1+ (1,0) [0|0] "" Vector__XXX
 SG_ VCSEC_a459_detailedAuthenticatio m459 : 19|4@1+ (1,0) [0|0] "" Vector__XXX
 SG_ VCSEC_a460_detailedAuthenticatio m460 : 19|4@1+ (1,0) [0|0] "" Vector__XXX
 SG_ VCSEC_a461_detailedAuthenticatio m461 : 19|4@1+ (1,0) [0|0] "" Vector__XXX
 SG_ VCSEC_a462_detailedAuthenticatio m462 : 19|4@1+ (1,0) [0|0] "" Vector__XXX
 SG_ VCSEC_a487_parsedAs m487 : 19|3@1+ (1,0) [0|0] "" Vector__XXX
 SG_ VCSEC_a496_hasLegacyBluetoothPer m496 : 19|1@1+ (1,0) [0|0] "" Vector__XXX
 SG_ VCSEC_a525_sensor3 m525 : 19|1@1+ (1,0) [0|0] "" Vector__XXX
 SG_ VCSEC_a526_sensor3 m526 : 19|1@1+ (1,0) [0|0] "" Vector__XXX
 SG_ VCSEC_a527_sensor3 m527 : 19|1@1+ (1,0) [0|0] "" Vector__XXX
 SG_ VCSEC_a528_sensor3 m528 : 19|1@1+ (1,0) [0|0] "" Vector__XXX
 SG_ VCSEC_a012_SoftwareReset m12 : 18|1@1+ (1,0) [0|0] "" Vector__XXX
 SG_ VCSEC_a015_NVMMRecordIDError m15 : 18|1@1+ (1,0) [0|0] "" Vector__XXX
 SG_ VCSEC_a021_Task1msMissed m21 : 18|1@1+ (1,0) [0|0] "" Vector__XXX
 SG_ VCSEC_a082_RIPC_railStatus m82 : 18|1@1+ (1,0) [0|0] "" Vector__XXX
 SG_ VCSEC_a083_LIPC_railStatus m83 : 18|1@1+ (1,0) [0|0] "" Vector__XXX
 SG_ VCSEC_a086_VEH_status m86 : 18|1@1+ (1,0) [0|0] "" Vector__XXX
 SG_ VCSEC_a087_VEH_torque m87 : 18|1@1+ (1,0) [0|0] "" Vector__XXX
 SG_ VCSEC_a088_VEH_torque m88 : 18|1@1+ (1,0) [0|0] "" Vector__XXX
 SG_ VCSEC_a089_VEH_status m89 : 18|1@1+ (1,0) [0|0] "" Vector__XXX
 SG_ VCSEC_a090_PARTY_eacMonitor m90 : 18|1@1+ (1,0) [0|0] "" Vector__XXX
 SG_ VCSEC_a091_VEH_state m91 : 18|1@1+ (1,0) [0|0] "" Vector__XXX
 SG_ VCSEC_a092_VEH_seatStatus2 m92 : 18|1@1+ (1,0) [0|0] "" Vector__XXX
 SG_ VCSEC_a093_VEH_seatStatus2 m93 : 18|1@1+ (1,0) [0|0] "" Vector__XXX
 SG_ VCSEC_a098_VEH_status m98 : 18|1@1+ (1,0) [0|0] "" Vector__XXX
 SG_ VCSEC_a100_PT m100 : 18|1@1+ (1,0) [0|0] "" Vector__XXX
 SG_ VCSEC_a101_LIPC_externalWatchdog m101 : 18|1@1+ (1,0) [0|0] "" Vector__XXX
 SG_ VCSEC_a102_VEH_sensorStatus m102 : 18|1@1+ (1,0) [0|0] "" Vector__XXX
 SG_ VCSEC_a103_VEH_status m103 : 18|1@1+ (1,0) [0|0] "" Vector__XXX
 SG_ VCSEC_a104_VEH_bodyControls3 m104 : 18|1@1+ (1,0) [0|0] "" Vector__XXX
 SG_ VCSEC_a105_VEH_dampingStates m105 : 18|1@1+ (1,0) [0|0] "" Vector__XXX
 SG_ VCSEC_a106_VEH_dcdcRailStatus m106 : 18|1@1+ (1,0) [0|0] "" Vector__XXX
 SG_ VCSEC_a107_VEH_status m107 : 18|1@1+ (1,0) [0|0] "" Vector__XXX
 SG_ VCSEC_a108_VEH_thermalControl m108 : 18|1@1+ (1,0) [0|0] "" Vector__XXX
 SG_ VCSEC_a109_PARTY_nearDeploy m109 : 18|1@1+ (1,0) [0|0] "" Vector__XXX
 SG_ VCSEC_a110_VEH_time m110 : 18|1@1+ (1,0) [0|0] "" Vector__XXX
 SG_ VCSEC_a111_VEH_vehNm m111 : 18|1@1+ (1,0) [0|0] "" Vector__XXX
 SG_ VCSEC_a112_VEH_vehNm m112 : 18|1@1+ (1,0) [0|0] "" Vector__XXX
 SG_ VCSEC_a113_VEH_chargeRequest m113 : 18|1@1+ (1,0) [0|0] "" Vector__XXX
 SG_ VCSEC_a114_VEH_wheelSpeeds m114 : 18|1@1+ (1,0) [0|0] "" Vector__XXX
 SG_ VCSEC_a115_VEH_BLEResetRequest m115 : 18|1@1+ (1,0) [0|0] "" Vector__XXX
 SG_ VCSEC_a116_VEH_hvacRequest m116 : 18|1@1+ (1,0) [0|0] "" Vector__XXX
 SG_ VCSEC_a117_VEH_prndStatus m117 : 18|1@1+ (1,0) [0|0] "" Vector__XXX
 SG_ VCSEC_a118_VEH_sensors m118 : 18|1@1+ (1,0) [0|0] "" Vector__XXX
 SG_ VCSEC_a119_VEH_rightStalk m119 : 18|1@1+ (1,0) [0|0] "" Vector__XXX
 SG_ VCSEC_a120_CH_chassisCntl m120 : 18|1@1+ (1,0) [0|0] "" Vector__XXX
 SG_ VCSEC_a140_authenticationFailed m140 : 18|1@1+ (1,0) [0|0] "" Vector__XXX
 SG_ VCSEC_a142_discoCmdStatus m142 : 18|1@1+ (1,0) [0|0] "" Vector__XXX
 SG_ VCSEC_a143_discoCmdStatus m143 : 18|1@1+ (1,0) [0|0] "" Vector__XXX
 SG_ VCSEC_a144_discoCmdStatus m144 : 18|1@1+ (1,0) [0|0] "" Vector__XXX
 SG_ VCSEC_a145_discoCmdStatus m145 : 18|1@1+ (1,0) [0|0] "" Vector__XXX
 SG_ VCSEC_a158_unknownHCICode m158 : 18|1@1+ (1,0) [0|0] "" Vector__XXX
 SG_ VCSEC_a159_unknownHCICode m159 : 18|1@1+ (1,0) [0|0] "" Vector__XXX
 SG_ VCSEC_a161_unknownHCICode m161 : 18|1@1+ (1,0) [0|0] "" Vector__XXX
 SG_ VCSEC_a162_unknownHCICode m162 : 18|1@1+ (1,0) [0|0] "" Vector__XXX
 SG_ VCSEC_a191_failedToSendWlist m191 : 18|1@1+ (1,0) [0|0] "" Vector__XXX
 SG_ VCSEC_a192_failedToSendWlist m192 : 18|1@1+ (1,0) [0|0] "" Vector__XXX
 SG_ VCSEC_a193_failedToSendWlist m193 : 18|1@1+ (1,0) [0|0] "" Vector__XXX
 SG_ VCSEC_a194_failedToSendWlist m194 : 18|1@1+ (1,0) [0|0] "" Vector__XXX
 SG_ VCSEC_a212_snifferMIALeft m212 : 18|1@1+ (1,0) [0|0] "" Vector__XXX
 SG_ VCSEC_a219_pairingRemovedSensor2 m219 : 18|1@1+ (1,0) [0|0] "" Vector__XXX
 SG_ VCSEC_a274_highThreshCenterPrese m274 : 18|1@1+ (1,0) [0|0] "" Vector__XXX
 SG_ VCSEC_a309_signedCommandsHardloc m309 : 18|1@1+ (1,0) [0|0] "" Vector__XXX
 SG_ VCSEC_a478_isDev2Bonded m478 : 18|1@1+ (1,0) [0|0] "" Vector__XXX
 SG_ VCSEC_a487_routable m487 : 18|1@1+ (1,0) [0|0] "" Vector__XXX
 SG_ VCSEC_a495_iBeaconState_timefram m495 : 18|3@1+ (1,0) [0|0] "" Vector__XXX
 SG_ VCSEC_a496_hasAccessFineLocation m496 : 18|1@1+ (1,0) [0|0] "" Vector__XXX
 SG_ VCSEC_a525_sensor2 m525 : 18|1@1+ (1,0) [0|0] "" Vector__XXX
 SG_ VCSEC_a526_sensor2 m526 : 18|1@1+ (1,0) [0|0] "" Vector__XXX
 SG_ VCSEC_a527_sensor2 m527 : 18|1@1+ (1,0) [0|0] "" Vector__XXX
 SG_ VCSEC_a528_sensor2 m528 : 18|1@1+ (1,0) [0|0] "" Vector__XXX
 SG_ VCSEC_a529_sensor1Rotation m529 : 18|2@1+ (1,0) [0|0] "" Vector__XXX
 SG_ VCSEC_a002_PowerOnReset m2 : 17|1@1+ (1,0) [0|0] "" Vector__XXX
 SG_ VCSEC_a010_UnderVoltageTimeout m10 : 17|1@1+ (1,0) [0|0] "" Vector__XXX
 SG_ VCSEC_a012_FlashError m12 : 17|1@1+ (1,0) [0|0] "" Vector__XXX
 SG_ VCSEC_a013_ClearQueueFull m13 : 17|1@1+ (1,0) [0|0] "" Vector__XXX
 SG_ VCSEC_a015_NVMMFilesystemError m15 : 17|1@1+ (1,0) [0|0] "" Vector__XXX
 SG_ VCSEC_a021_Task1msStarved m21 : 17|1@1+ (1,0) [0|0] "" Vector__XXX
 SG_ VCSEC_a060_resetUnlocked m60 : 17|1@1+ (1,0) [0|0] "" Vector__XXX
 SG_ VCSEC_a082_RIPC_remoteHSD m82 : 17|1@1+ (1,0) [0|0] "" Vector__XXX
 SG_ VCSEC_a083_LIPC_remoteHSD m83 : 17|1@1+ (1,0) [0|0] "" Vector__XXX
 SG_ VCSEC_a086_VEH_LVBMS_statusLow m86 : 17|1@1+ (1,0) [0|0] "" Vector__XXX
 SG_ VCSEC_a087_VEH_thermalControl m87 : 17|1@1+ (1,0) [0|0] "" Vector__XXX
 SG_ VCSEC_a088_VEH_thermalControl m88 : 17|1@1+ (1,0) [0|0] "" Vector__XXX
 SG_ VCSEC_a089_PARTY_status m89 : 17|1@1+ (1,0) [0|0] "" Vector__XXX
 SG_ VCSEC_a090_VEH_state m90 : 17|1@1+ (1,0) [0|0] "" Vector__XXX
 SG_ VCSEC_a091_VEH_info m91 : 17|1@1+ (1,0) [0|0] "" Vector__XXX
 SG_ VCSEC_a092_VEH_switchStatus m92 : 17|1@1+ (1,0) [0|0] "" Vector__XXX
 SG_ VCSEC_a093_VEH_switchStatus m93 : 17|1@1+ (1,0) [0|0] "" Vector__XXX
 SG_ VCSEC_a094_PARTY_sysStatus m94 : 17|1@1+ (1,0) [0|0] "" Vector__XXX
 SG_ VCSEC_a095_PT_status m95 : 17|1@1+ (1,0) [0|0] "" Vector__XXX
 SG_ VCSEC_a096_CH_status m96 : 17|1@1+ (1,0) [0|0] "" Vector__XXX
 SG_ VCSEC_a097_VEH_state m97 : 17|1@1+ (1,0) [0|0] "" Vector__XXX
 SG_ VCSEC_a098_VEH_hvStatus m98 : 17|1@1+ (1,0) [0|0] "" Vector__XXX
 SG_ VCSEC_a100_PARTY m100 : 17|1@1+ (1,0) [0|0] "" Vector__XXX
 SG_ VCSEC_a101_PARTY_locState m101 : 17|1@1+ (1,0) [0|0] "" Vector__XXX
 SG_ VCSEC_a102_VEH_feedbackStatus m102 : 17|1@1+ (1,0) [0|0] "" Vector__XXX
 SG_ VCSEC_a103_VEH_vehNm m103 : 17|1@1+ (1,0) [0|0] "" Vector__XXX
 SG_ VCSEC_a104_VEH_bodyControls m104 : 17|1@1+ (1,0) [0|0] "" Vector__XXX
 SG_ VCSEC_a105_VEH_chNm m105 : 17|1@1+ (1,0) [0|0] "" Vector__XXX
 SG_ VCSEC_a106_VEH_thermalControl m106 : 17|1@1+ (1,0) [0|0] "" Vector__XXX
 SG_ VCSEC_a107_VEH_vehNm m107 : 17|1@1+ (1,0) [0|0] "" Vector__XXX
 SG_ VCSEC_a108_VEH_temperature m108 : 17|1@1+ (1,0) [0|0] "" Vector__XXX
 SG_ VCSEC_a109_PARTY_inertial2 m109 : 17|1@1+ (1,0) [0|0] "" Vector__XXX
 SG_ VCSEC_a110_VEH_carConfig m110 : 17|1@1+ (1,0) [0|0] "" Vector__XXX
 SG_ VCSEC_a111_VEH_status m111 : 17|1@1+ (1,0) [0|0] "" Vector__XXX
 SG_ VCSEC_a112_VEH_status m112 : 17|1@1+ (1,0) [0|0] "" Vector__XXX
 SG_ VCSEC_a113_VEH_hvacRequest m113 : 17|1@1+ (1,0) [0|0] "" Vector__XXX
 SG_ VCSEC_a114_PARTY_wheelSpeeds m114 : 17|1@1+ (1,0) [0|0] "" Vector__XXX
 SG_ VCSEC_a115_VEH_authentication m115 : 17|1@1+ (1,0) [0|0] "" Vector__XXX
 SG_ VCSEC_a116_VEH_vehNm m116 : 17|1@1+ (1,0) [0|0] "" Vector__XXX
 SG_ VCSEC_a117_BDY_restraintStatus m117 : 17|1@1+ (1,0) [0|0] "" Vector__XXX
 SG_ VCSEC_a118_VEH_lighting m118 : 17|1@1+ (1,0) [0|0] "" Vector__XXX
 SG_ VCSEC_a119_VEH_leftStalk m119 : 17|1@1+ (1,0) [0|0] "" Vector__XXX
 SG_ VCSEC_a120_VEH_systemStatus m120 : 17|1@1+ (1,0) [0|0] "" Vector__XXX
 SG_ VCSEC_a121_VEH_occupancy m121 : 17|1@1+ (1,0) [0|0] "" Vector__XXX
 SG_ VCSEC_a140_keyNotPairedToTheCar m140 : 17|1@1+ (1,0) [0|0] "" Vector__XXX
 SG_ VCSEC_a142_discoDoneEvent m142 : 17|1@1+ (1,0) [0|0] "" Vector__XXX
 SG_ VCSEC_a143_discoDoneEvent m143 : 17|1@1+ (1,0) [0|0] "" Vector__XXX
 SG_ VCSEC_a144_discoDoneEvent m144 : 17|1@1+ (1,0) [0|0] "" Vector__XXX
 SG_ VCSEC_a145_discoDoneEvent m145 : 17|1@1+ (1,0) [0|0] "" Vector__XXX
 SG_ VCSEC_a158_incompleteHeader m158 : 17|1@1+ (1,0) [0|0] "" Vector__XXX
 SG_ VCSEC_a159_incompleteHeader m159 : 17|1@1+ (1,0) [0|0] "" Vector__XXX
 SG_ VCSEC_a161_incompleteHeader m161 : 17|1@1+ (1,0) [0|0] "" Vector__XXX
 SG_ VCSEC_a162_incompleteHeader m162 : 17|1@1+ (1,0) [0|0] "" Vector__XXX
 SG_ VCSEC_a191_WlistingDevice m191 : 17|1@1+ (1,0) [0|0] "" Vector__XXX
 SG_ VCSEC_a192_WlistingDevice m192 : 17|1@1+ (1,0) [0|0] "" Vector__XXX
 SG_ VCSEC_a193_WlistingDevice m193 : 17|1@1+ (1,0) [0|0] "" Vector__XXX
 SG_ VCSEC_a194_WlistingDevice m194 : 17|1@1+ (1,0) [0|0] "" Vector__XXX
 SG_ VCSEC_a219_pairingRemovedSensor1 m219 : 17|1@1+ (1,0) [0|0] "" Vector__XXX
 SG_ VCSEC_a274_highThreshRightPresen m274 : 17|1@1+ (1,0) [0|0] "" Vector__XXX
 SG_ VCSEC_a309_inFactoryMode m309 : 17|1@1+ (1,0) [0|0] "" Vector__XXX
 SG_ VCSEC_a435_NFCAndPhoneOnRightSid m435 : 17|1@1+ (1,0) [0|0] "" Vector__XXX
 SG_ VCSEC_a478_isDev1Bonded m478 : 17|1@1+ (1,0) [0|0] "" Vector__XXX
 SG_ VCSEC_a487_failedProtoParse m487 : 17|1@1+ (1,0) [0|0] "" Vector__XXX
 SG_ VCSEC_a496_hasBluetoothConnectPe m496 : 17|1@1+ (1,0) [0|0] "" Vector__XXX
 SG_ VCSEC_a525_sensor1 m525 : 17|1@1+ (1,0) [0|0] "" Vector__XXX
 SG_ VCSEC_a526_sensor1 m526 : 17|1@1+ (1,0) [0|0] "" Vector__XXX
 SG_ VCSEC_a527_sensor1 m527 : 17|1@1+ (1,0) [0|0] "" Vector__XXX
 SG_ VCSEC_a528_sensor1 m528 : 17|1@1+ (1,0) [0|0] "" Vector__XXX
 SG_ VCSEC_a000_alertDataW0 m0 : 16|16@1+ (1,0) [0|0] "" Vector__XXX
 SG_ VCSEC_a001_InternalWatchdog m1 : 16|1@1+ (1,0) [0|0] "" Vector__XXX
 SG_ VCSEC_a002_CPUUndervoltage m2 : 16|1@1+ (1,0) [0|0] "" Vector__XXX
 SG_ VCSEC_a003_AssertID m3 : 16|16@1+ (1,0) [0|0] "" Vector__XXX
 SG_ VCSEC_a005_busID0 m5 : 16|4@1+ (1,0) [0|0] "" Vector__XXX
 SG_ VCSEC_a006_busID m6 : 16|4@1+ (1,0) [0|0] "" Vector__XXX
 SG_ VCSEC_a010_UnderVoltageDetected m10 : 16|1@1+ (1,0) [0|0] "" Vector__XXX
 SG_ VCSEC_a012_ClockError m12 : 16|1@1+ (1,0) [0|0] "" Vector__XXX
 SG_ VCSEC_a013_LogQueueFull m13 : 16|1@1+ (1,0) [0|0] "" Vector__XXX
 SG_ VCSEC_a015_NVMMMemOverflow m15 : 16|1@1+ (1,0) [0|0] "" Vector__XXX
 SG_ VCSEC_a016_NVMMRecordID m16 : 16|16@1+ (1,0) [0|0] "" Vector__XXX
 SG_ VCSEC_a017_NVMMLifetimeEraseCycl m17 : 16|32@1+ (1,0) [0|0] "" Vector__XXX
 SG_ VCSEC_a021_Task1msLate m21 : 16|1@1+ (1,0) [0|0] "" Vector__XXX
 SG_ VCSEC_a022_TaskInitErrorCount m22 : 16|8@1+ (1,0) [0|0] "" Vector__XXX
 SG_ VCSEC_a030_logId m30 : 16|4@1+ (1,0) [0|0] "" Vector__XXX
 SG_ VCSEC_a031_uds_bytes_0 m31 : 16|8@1+ (1,0) [0|0] "" Vector__XXX
 SG_ VCSEC_a041_CPULoadTotal m41 : 16|8@1+ (1,0) [0|0] "" Vector__XXX
 SG_ VCSEC_a042_Usage1msTask m42 : 16|8@1+ (1,0) [0|0] "" Vector__XXX
 SG_ VCSEC_a043_CallTrace0 m43 : 16|24@1+ (1,0) [0|0] "" Vector__XXX
 SG_ VCSEC_a044_CallTrace0 m44 : 16|24@1+ (1,0) [0|0] "" Vector__XXX
 SG_ VCSEC_a045_CallTrace0 m45 : 16|24@1+ (1,0) [0|0] "" Vector__XXX
 SG_ VCSEC_a046_CallTrace0 m46 : 16|24@1+ (1,0) [0|0] "" Vector__XXX
 SG_ VCSEC_a057_VEH_cpControl m57 : 16|1@1+ (1,0) [0|0] "" Vector__XXX
 SG_ VCSEC_a058_voltageDrop m58 : 16|12@1+ (0.005443676098,0) [0|0] "" Vector__XXX
 SG_ VCSEC_a059_voltageDrop m59 : 16|12@1+ (0.005443676098,0) [0|0] "" Vector__XXX
 SG_ VCSEC_a060_lockoutDisabled m60 : 16|1@1+ (1,0) [0|0] "" Vector__XXX
 SG_ VCSEC_a063_switchChannel m63 : 16|8@1+ (1,0) [0|0] "" Vector__XXX
 SG_ VCSEC_a064_busBitField m64 : 16|8@1+ (1,0) [0|0] "" Vector__XXX
 SG_ VCSEC_a082_RIPC_epbPrivateState m82 : 16|1@1+ (1,0) [0|0] "" Vector__XXX
 SG_ VCSEC_a083_LIPC_epbPrivateState m83 : 16|1@1+ (1,0) [0|0] "" Vector__XXX
 SG_ VCSEC_a084_CH_StatusC m84 : 16|1@1+ (1,0) [0|0] "" Vector__XXX
 SG_ VCSEC_a085_PARTY_buttonStatus m85 : 16|1@1+ (1,0) [0|0] "" Vector__XXX
 SG_ VCSEC_a086_VEH_LVBMS_statusHigh m86 : 16|1@1+ (1,0) [0|0] "" Vector__XXX
 SG_ VCSEC_a087_VEH_temperature m87 : 16|1@1+ (1,0) [0|0] "" Vector__XXX
 SG_ VCSEC_a088_VEH_temperature m88 : 16|1@1+ (1,0) [0|0] "" Vector__XXX
 SG_ VCSEC_a089_PARTY_party1 m89 : 16|1@1+ (1,0) [0|0] "" Vector__XXX
 SG_ VCSEC_a090_VEH_chNm m90 : 16|1@1+ (1,0) [0|0] "" Vector__XXX
 SG_ VCSEC_a091_VEH_faultsAndExtras m91 : 16|1@1+ (1,0) [0|0] "" Vector__XXX
 SG_ VCSEC_a092_VEH_restraintStatus m92 : 16|1@1+ (1,0) [0|0] "" Vector__XXX
 SG_ VCSEC_a093_VEH_restraintStatus m93 : 16|1@1+ (1,0) [0|0] "" Vector__XXX
 SG_ VCSEC_a094_VEH_sysStatus m94 : 16|1@1+ (1,0) [0|0] "" Vector__XXX
 SG_ VCSEC_a095_PT_ptNm m95 : 16|1@1+ (1,0) [0|0] "" Vector__XXX
 SG_ VCSEC_a096_VEH_status m96 : 16|1@1+ (1,0) [0|0] "" Vector__XXX
 SG_ VCSEC_a097_VEH_HVStatus m97 : 16|1@1+ (1,0) [0|0] "" Vector__XXX
 SG_ VCSEC_a098_CH_torque m98 : 16|1@1+ (1,0) [0|0] "" Vector__XXX
 SG_ VCSEC_a099_VEH_oocStatus m99 : 16|1@1+ (1,0) [0|0] "" Vector__XXX
 SG_ VCSEC_a100_VEH m100 : 16|1@1+ (1,0) [0|0] "" Vector__XXX
 SG_ VCSEC_a101_VEH_state m101 : 16|1@1+ (1,0) [0|0] "" Vector__XXX
 SG_ VCSEC_a102_VEH_faultsAndExtras m102 : 16|1@1+ (1,0) [0|0] "" Vector__XXX
 SG_ VCSEC_a103_VEH_hvsNm m103 : 16|1@1+ (1,0) [0|0] "" Vector__XXX
 SG_ VCSEC_a104_VEH_chNm m104 : 16|1@1+ (1,0) [0|0] "" Vector__XXX
 SG_ VCSEC_a105_VEH_states m105 : 16|1@1+ (1,0) [0|0] "" Vector__XXX
 SG_ VCSEC_a106_VEH_dcdcStatus m106 : 16|1@1+ (1,0) [0|0] "" Vector__XXX
 SG_ VCSEC_a107_VEH_hvsNm m107 : 16|1@1+ (1,0) [0|0] "" Vector__XXX
 SG_ VCSEC_a108_VEH_hvStatus m108 : 16|1@1+ (1,0) [0|0] "" Vector__XXX
 SG_ VCSEC_a109_PARTY_status m109 : 16|1@1+ (1,0) [0|0] "" Vector__XXX
 SG_ VCSEC_a110_VEH_carState m110 : 16|1@1+ (1,0) [0|0] "" Vector__XXX
 SG_ VCSEC_a111_VEH_internalStatus m111 : 16|1@1+ (1,0) [0|0] "" Vector__XXX
 SG_ VCSEC_a112_VEH_internalStatus m112 : 16|1@1+ (1,0) [0|0] "" Vector__XXX
 SG_ VCSEC_a113_VEH_ethNm m113 : 16|1@1+ (1,0) [0|0] "" Vector__XXX
 SG_ VCSEC_a114_PARTY_status m114 : 16|1@1+ (1,0) [0|0] "" Vector__XXX
 SG_ VCSEC_a115_VEH_vehNm m115 : 16|1@1+ (1,0) [0|0] "" Vector__XXX
 SG_ VCSEC_a116_PARTY_epbmStatus m116 : 16|1@1+ (1,0) [0|0] "" Vector__XXX
 SG_ VCSEC_a117_BDY_epbmStatus m117 : 16|1@1+ (1,0) [0|0] "" Vector__XXX
 SG_ VCSEC_a118_VEH_vehNm m118 : 16|1@1+ (1,0) [0|0] "" Vector__XXX
 SG_ VCSEC_a119_VEH_steerAngle m119 : 16|1@1+ (1,0) [0|0] "" Vector__XXX
 SG_ VCSEC_a120_PARTY_chassisCntl m120 : 16|1@1+ (1,0) [0|0] "" Vector__XXX
 SG_ VCSEC_a121_VEH_status m121 : 16|1@1+ (1,0) [0|0] "" Vector__XXX
 SG_ VCSEC_a133_alarmTriggerReason m133 : 16|4@1+ (1,0) [0|0] "" Vector__XXX
 SG_ VCSEC_a140_keyDidNotIdentify m140 : 16|1@1+ (1,0) [0|0] "" Vector__XXX
 SG_ VCSEC_a142_endDiscoverable m142 : 16|1@1+ (1,0) [0|0] "" Vector__XXX
 SG_ VCSEC_a143_endDiscoverable m143 : 16|1@1+ (1,0) [0|0] "" Vector__XXX
 SG_ VCSEC_a144_endDiscoverable m144 : 16|1@1+ (1,0) [0|0] "" Vector__XXX
 SG_ VCSEC_a145_endDiscoverable m145 : 16|1@1+ (1,0) [0|0] "" Vector__XXX
 SG_ VCSEC_a158_transportError m158 : 16|1@1+ (1,0) [0|0] "" Vector__XXX
 SG_ VCSEC_a159_transportError m159 : 16|1@1+ (1,0) [0|0] "" Vector__XXX
 SG_ VCSEC_a161_transportError m161 : 16|1@1+ (1,0) [0|0] "" Vector__XXX
 SG_ VCSEC_a162_transportError m162 : 16|1@1+ (1,0) [0|0] "" Vector__XXX
 SG_ VCSEC_a166_resetCount m166 : 16|8@1+ (1,0) [0|0] "" Vector__XXX
 SG_ VCSEC_a167_resetCount m167 : 16|8@1+ (1,0) [0|0] "" Vector__XXX
 SG_ VCSEC_a168_resetCount m168 : 16|8@1+ (1,0) [0|0] "" Vector__XXX
 SG_ VCSEC_a169_resetCount m169 : 16|8@1+ (1,0) [0|0] "" Vector__XXX
 SG_ VCSEC_a170_resetCount m170 : 16|8@1+ (1,0) [0|0] "" Vector__XXX
 SG_ VCSEC_a172_resetSource m172 : 16|4@1+ (1,0) [0|0] "" Vector__XXX
 SG_ VCSEC_a173_resetSource m173 : 16|4@1+ (1,0) [0|0] "" Vector__XXX
 SG_ VCSEC_a174_resetSource m174 : 16|4@1+ (1,0) [0|0] "" Vector__XXX
 SG_ VCSEC_a175_resetSource m175 : 16|4@1+ (1,0) [0|0] "" Vector__XXX
 SG_ VCSEC_a177_newWhitelistSlot m177 : 16|5@1+ (1,0) [0|0] "" Vector__XXX
 SG_ VCSEC_a178_publicKey m178 : 16|32@1+ (1,0) [0|0] "" Vector__XXX
 SG_ VCSEC_a180_permission m180 : 16|32@1+ (1,0) [0|0] "" Vector__XXX
 SG_ VCSEC_a181_channel m181 : 16|8@1+ (1,0) [0|0] "" Vector__XXX
 SG_ VCSEC_a182_cryptoTaskStackUsage m182 : 16|8@1+ (1,0) [0|0] "" Vector__XXX
 SG_ VCSEC_a191_clearWlist m191 : 16|1@1+ (1,0) [0|0] "" Vector__XXX
 SG_ VCSEC_a192_clearWlist m192 : 16|1@1+ (1,0) [0|0] "" Vector__XXX
 SG_ VCSEC_a193_clearWlist m193 : 16|1@1+ (1,0) [0|0] "" Vector__XXX
 SG_ VCSEC_a194_clearWlist m194 : 16|1@1+ (1,0) [0|0] "" Vector__XXX
 SG_ VCSEC_a197_connectionChannel m197 : 16|4@1+ (1,0) [0|0] "" Vector__XXX
 SG_ VCSEC_a205_connectionChannel m205 : 16|4@1+ (1,0) [0|0] "" Vector__XXX
 SG_ VCSEC_a206_assertCause m206 : 16|4@1+ (1,0) [0|0] "" Vector__XXX
 SG_ VCSEC_a207_assertCause m207 : 16|4@1+ (1,0) [0|0] "" Vector__XXX
 SG_ VCSEC_a208_assertCause m208 : 16|4@1+ (1,0) [0|0] "" Vector__XXX
 SG_ VCSEC_a209_assertCause m209 : 16|4@1+ (1,0) [0|0] "" Vector__XXX
 SG_ VCSEC_a210_whiteListChannel m210 : 16|5@1+ (1,0) [0|0] "" Vector__XXX
 SG_ VCSEC_a211_handlePulled m211 : 16|4@1+ (1,0) [0|0] "" Vector__XXX
 SG_ VCSEC_a212_snifferChannelMissing m212 : 16|2@1+ (1,0) [0|0] "" Vector__XXX
 SG_ VCSEC_a215_taskDisconnectReason m215 : 16|3@1+ (1,0) [0|0] "" Vector__XXX
 SG_ VCSEC_a216_taskDisconnectReason m216 : 16|3@1+ (1,0) [0|0] "" Vector__XXX
 SG_ VCSEC_a217_taskDisconnectReason m217 : 16|3@1+ (1,0) [0|0] "" Vector__XXX
 SG_ VCSEC_a218_taskDisconnectReason m218 : 16|3@1+ (1,0) [0|0] "" Vector__XXX
 SG_ VCSEC_a219_pairingRemovedSensor0 m219 : 16|1@1+ (1,0) [0|0] "" Vector__XXX
 SG_ VCSEC_a221_countryCode m221 : 16|16@1+ (1,0) [0|0] "" Vector__XXX
 SG_ VCSEC_a235_FPCountHighThreshLeft m235 : 16|4@1+ (1,0) [0|0] "" Vector__XXX
 SG_ VCSEC_a236_connectionChannel m236 : 16|4@1+ (1,0) [0|0] "" Vector__XXX
 SG_ VCSEC_a237_connectionChannel m237 : 16|4@1+ (1,0) [0|0] "" Vector__XXX
 SG_ VCSEC_a238_prevLocationSensor0 m238 : 16|3@1+ (1,0) [0|0] "" Vector__XXX
 SG_ VCSEC_a239_connectionReasonSenso m239 : 16|3@1+ (1,0) [0|0] "" Vector__XXX
 SG_ VCSEC_a241_currentCRC m241 : 16|32@1+ (1,0) [0|0] "" Vector__XXX
 SG_ VCSEC_a242_currentCRC m242 : 16|32@1+ (1,0) [0|0] "" Vector__XXX
 SG_ VCSEC_a243_currentCRC m243 : 16|32@1+ (1,0) [0|0] "" Vector__XXX
 SG_ VCSEC_a244_currentCRC m244 : 16|32@1+ (1,0) [0|0] "" Vector__XXX
 SG_ VCSEC_a245_reason m245 : 16|4@1+ (1,0) [0|0] "" Vector__XXX
 SG_ VCSEC_a246_reason m246 : 16|4@1+ (1,0) [0|0] "" Vector__XXX
 SG_ VCSEC_a247_reason m247 : 16|4@1+ (1,0) [0|0] "" Vector__XXX
 SG_ VCSEC_a248_reason m248 : 16|4@1+ (1,0) [0|0] "" Vector__XXX
 SG_ VCSEC_a249_currentCRC m249 : 16|32@1+ (1,0) [0|0] "" Vector__XXX
 SG_ VCSEC_a250_currentCRC m250 : 16|32@1+ (1,0) [0|0] "" Vector__XXX
 SG_ VCSEC_a251_currentCRC m251 : 16|32@1+ (1,0) [0|0] "" Vector__XXX
 SG_ VCSEC_a252_currentCRC m252 : 16|32@1+ (1,0) [0|0] "" Vector__XXX
 SG_ VCSEC_a254_updatedWhitelistSlot m254 : 16|5@1+ (1,0) [0|0] "" Vector__XXX
 SG_ VCSEC_a255_permission m255 : 16|20@1+ (1,0) [0|0] "" Vector__XXX
 SG_ VCSEC_a256_whitelistOperation m256 : 16|4@1+ (1,0) [0|0] "" Vector__XXX
 SG_ VCSEC_a257_whitelistSlot m257 : 16|5@1+ (1,0) [0|0] "" Vector__XXX
 SG_ VCSEC_a258_whitelistSlot m258 : 16|5@1+ (1,0) [0|0] "" Vector__XXX
 SG_ VCSEC_a261_factoryLearnState m261 : 16|3@1+ (1,0) [0|0] "" Vector__XXX
 SG_ VCSEC_a262_channel m262 : 16|5@1+ (1,0) [0|0] "" Vector__XXX
 SG_ VCSEC_a264_channel m264 : 16|8@1+ (1,0) [0|0] "" Vector__XXX
 SG_ VCSEC_a265_channel m265 : 16|8@1+ (1,0) [0|0] "" Vector__XXX
 SG_ VCSEC_a266_pressure m266 : 16|8@1+ (0.025,0) [0|0] "" Vector__XXX
 SG_ VCSEC_a267_pressure m267 : 16|8@1+ (0.025,0) [0|0] "" Vector__XXX
 SG_ VCSEC_a268_pressure m268 : 16|8@1+ (0.025,0) [0|0] "" Vector__XXX
 SG_ VCSEC_a269_pressure m269 : 16|8@1+ (0.025,0) [0|0] "" Vector__XXX
 SG_ VCSEC_a270_pressure m270 : 16|8@1+ (0.025,0) [0|0] "" Vector__XXX
 SG_ VCSEC_a271_pressure m271 : 16|8@1+ (0.025,0) [0|0] "" Vector__XXX
 SG_ VCSEC_a272_pressure m272 : 16|8@1+ (0.025,0) [0|0] "" Vector__XXX
 SG_ VCSEC_a273_pressure m273 : 16|8@1+ (0.025,0) [0|0] "" Vector__XXX
 SG_ VCSEC_a274_highThreshLeftPresent m274 : 16|1@1+ (1,0) [0|0] "" Vector__XXX
 SG_ VCSEC_a300_publicKey m300 : 16|32@1+ (1,0) [0|0] "" Vector__XXX
 SG_ VCSEC_a301_numberOfMessagesHeard m301 : 16|32@1+ (1,0) [0|0] "" Vector__XXX
 SG_ VCSEC_a303_reason m303 : 16|4@1+ (1,0) [0|0] "" Vector__XXX
 SG_ VCSEC_a304_whitelistChannel m304 : 16|5@1+ (1,0) [0|0] "" Vector__XXX
 SG_ VCSEC_a305_opcode m305 : 16|8@1+ (1,0) [0|0] "" Vector__XXX
 SG_ VCSEC_a306_whitelistChannel m306 : 16|5@1+ (1,0) [0|0] "" Vector__XXX
 SG_ VCSEC_a307_connectionChannel m307 : 16|8@1+ (1,0) [0|0] "" Vector__XXX
 SG_ VCSEC_a308_whitelistChannel m308 : 16|5@1+ (1,0) [0|0] "" Vector__XXX
 SG_ VCSEC_a309_inServiceAccessMode m309 : 16|1@1+ (1,0) [0|0] "" Vector__XXX
 SG_ VCSEC_a310_filteredFalsePositive m310 : 16|8@1- (1,0) [0|0] "" Vector__XXX
 SG_ VCSEC_a311_whitelistChannel m311 : 16|5@1+ (1,0) [0|0] "" Vector__XXX
 SG_ VCSEC_a312_wlChannel m312 : 16|5@1+ (1,0) [0|0] "" Vector__XXX
 SG_ VCSEC_a315_event m315 : 16|6@1+ (1,0) [0|0] "" Vector__XXX
 SG_ VCSEC_a316_macAddressType m316 : 16|2@1+ (1,0) [0|0] "" Vector__XXX
 SG_ VCSEC_a435_NFCAndPhoneOnLeftSide m435 : 16|1@1+ (1,0) [0|0] "" Vector__XXX
 SG_ VCSEC_a436_currentUHFHardware m436 : 16|8@1+ (1,0) [0|0] "" Vector__XXX
 SG_ VCSEC_a455_pressure m455 : 16|8@1+ (0.025,0) [0|0] "" Vector__XXX
 SG_ VCSEC_a456_pressure m456 : 16|8@1+ (0.025,0) [0|0] "" Vector__XXX
 SG_ VCSEC_a457_pressure m457 : 16|8@1+ (0.025,0) [0|0] "" Vector__XXX
 SG_ VCSEC_a458_pressure m458 : 16|8@1+ (0.025,0) [0|0] "" Vector__XXX
 SG_ VCSEC_a459_failureReason m459 : 16|3@1+ (1,0) [0|0] "" Vector__XXX
 SG_ VCSEC_a460_failureReason m460 : 16|3@1+ (1,0) [0|0] "" Vector__XXX
 SG_ VCSEC_a461_failureReason m461 : 16|3@1+ (1,0) [0|0] "" Vector__XXX
 SG_ VCSEC_a462_failureReason m462 : 16|3@1+ (1,0) [0|0] "" Vector__XXX
 SG_ VCSEC_a472_unixtimestamp m472 : 16|32@1+ (1,0) [0|0] "" Vector__XXX
 SG_ VCSEC_a473_unixtimestamp m473 : 16|32@1+ (1,0) [0|0] "" Vector__XXX
 SG_ VCSEC_a474_timeSinceBLESwitchEna m474 : 16|18@1- (1,0) [0|0] "" Vector__XXX
 SG_ VCSEC_a475_timeSinceBeaconInSeco m475 : 16|18@1- (1,0) [0|0] "" Vector__XXX
 SG_ VCSEC_a476_timeSinceForegroundIn m476 : 16|18@1- (1,0) [0|0] "" Vector__XXX
 SG_ VCSEC_a477_unixtimestamp m477 : 16|32@1+ (1,0) [0|0] "" Vector__XXX
 SG_ VCSEC_a478_isDev0Bonded m478 : 16|1@1+ (1,0) [0|0] "" Vector__XXX
 SG_ VCSEC_a479_NIStateLeft0 m479 : 16|5@1+ (1,0) [0|0] "" Vector__XXX
 SG_ VCSEC_a480_NIStateLeft1 m480 : 16|5@1+ (1,0) [0|0] "" Vector__XXX
 SG_ VCSEC_a481_NIStateLeft2 m481 : 16|5@1+ (1,0) [0|0] "" Vector__XXX
 SG_ VCSEC_a483_initialTripMean m483 : 16|14@1- (0.01,0) [0|0] "" Vector__XXX
 SG_ VCSEC_a487_identifyTypeFailed m487 : 16|1@1+ (1,0) [0|0] "" Vector__XXX
 SG_ VCSEC_a495_iBeaconState m495 : 16|2@1+ (1,0) [0|0] "" Vector__XXX
 SG_ VCSEC_a496_hasBluetoothScanPermi m496 : 16|1@1+ (1,0) [0|0] "" Vector__XXX
 SG_ VCSEC_a499_assertSource m499 : 16|1@1+ (1,0) [0|0] "" Vector__XXX
 SG_ VCSEC_a500_assertSource m500 : 16|1@1+ (1,0) [0|0] "" Vector__XXX
 SG_ VCSEC_a501_assertSource m501 : 16|1@1+ (1,0) [0|0] "" Vector__XXX
 SG_ VCSEC_a502_assertSource m502 : 16|1@1+ (1,0) [0|0] "" Vector__XXX
 SG_ VCSEC_a517_pressure m517 : 16|9@1+ (0.025,0) [0|0] "" Vector__XXX
 SG_ VCSEC_a518_pressure m518 : 16|9@1+ (0.025,0) [0|0] "" Vector__XXX
 SG_ VCSEC_a519_pressure m519 : 16|9@1+ (0.025,0) [0|0] "" Vector__XXX
 SG_ VCSEC_a520_pressure m520 : 16|9@1+ (0.025,0) [0|0] "" Vector__XXX
 SG_ VCSEC_a521_confidenceFL m521 : 16|7@1+ (1,0) [0|0] "" Vector__XXX
 SG_ VCSEC_a522_confidenceFL m522 : 16|7@1+ (1,0) [0|0] "" Vector__XXX
 SG_ VCSEC_a523_confidenceFL m523 : 16|7@1+ (1,0) [0|0] "" Vector__XXX
 SG_ VCSEC_a524_confidenceFL m524 : 16|7@1+ (1,0) [0|0] "" Vector__XXX
 SG_ VCSEC_a525_sensor0 m525 : 16|1@1+ (1,0) [0|0] "" Vector__XXX
 SG_ VCSEC_a526_sensor0 m526 : 16|1@1+ (1,0) [0|0] "" Vector__XXX
 SG_ VCSEC_a527_sensor0 m527 : 16|1@1+ (1,0) [0|0] "" Vector__XXX
 SG_ VCSEC_a528_sensor0 m528 : 16|1@1+ (1,0) [0|0] "" Vector__XXX
 SG_ VCSEC_a529_sensor0Rotation m529 : 16|2@1+ (1,0) [0|0] "" Vector__XXX
 SG_ VCSEC_alertState : 15|1@1+ (1,0) [0|0] "" Vector__XXX
 SG_ VCSEC_alertID M : 0|10@1+ (1,0) [0|0] "" Vector__XXX

BO_ 1330 EPBR_bootID: 8 Vector__XXX
 SG_ EPBR_bootIdData : 0|64@1+ (1,0) [0|0] "" Vector__XXX

BO_ 1331 EPBL_bootID: 8 Vector__XXX
 SG_ EPBL_bootIdData : 0|64@1+ (1,0) [0|0] "" Vector__XXX

BO_ 1332 VCFRONT_alertLog: 8 Vector__XXX
 SG_ VCFRONT_a058_faultReason m58 : 63|1@1+ (1,0) [0|0] "" Vector__XXX
 SG_ VCFRONT_a172_serviceMode m172 : 63|1@1+ (1,0) [0|0] "" Vector__XXX
 SG_ VCFRONT_a173_serviceMode m173 : 63|1@1+ (1,0) [0|0] "" Vector__XXX
 SG_ VCFRONT_a182_weakShort m182 : 63|1@1+ (1,0) [0|0] "" Vector__XXX
 SG_ VCFRONT_a183_weakShort m183 : 63|1@1+ (1,0) [0|0] "" Vector__XXX
 SG_ VCFRONT_a403_IBSTempShortOrOpen m403 : 63|1@1+ (1,0) [0|0] "" Vector__XXX
 SG_ VCFRONT_a405_voltageDipTrigger m405 : 63|1@1+ (1,0) [0|0] "" Vector__XXX
 SG_ VCFRONT_a406_voltageFloorReached m406 : 63|1@1+ (1,0) [0|0] "" Vector__XXX
 SG_ VCFRONT_a407_opportunisticTest m407 : 63|1@1+ (1,0) [0|0] "" Vector__XXX
 SG_ VCFRONT_a408_IBSTempShortOrOpen m408 : 63|1@1+ (1,0) [0|0] "" Vector__XXX
 SG_ VCFRONT_a412_frunkOpen m412 : 63|1@1+ (1,0) [0|0] "" Vector__XXX
 SG_ VCFRONT_a415_hvcEFuseUnstable m415 : 63|1@1+ (1,0) [0|0] "" Vector__XXX
 SG_ VCFRONT_a446_checkA447Alert m446 : 63|1@1+ (1,0) [0|0] "" Vector__XXX
 SG_ VCFRONT_a559_frunkOpen m559 : 63|1@1+ (1,0) [0|0] "" Vector__XXX
 SG_ VCFRONT_a626_opportunisticTest m626 : 63|1@1+ (1,0) [0|0] "" Vector__XXX
 SG_ VCFRONT_a178_runDueToHpCommissio m178 : 62|1@1+ (1,0) [0|0] "" Vector__XXX
 SG_ VCFRONT_a182_bleedFetTestFailure m182 : 62|1@1+ (1,0) [0|0] "" Vector__XXX
 SG_ VCFRONT_a183_bleedFetTestFailure m183 : 62|1@1+ (1,0) [0|0] "" Vector__XXX
 SG_ VCFRONT_a403_firstChargeOTA m403 : 62|1@1+ (1,0) [0|0] "" Vector__XXX
 SG_ VCFRONT_a405_voltDropOnHighCurre m405 : 62|1@1+ (1,0) [0|0] "" Vector__XXX
 SG_ VCFRONT_a406_maxChargeTimeoutTri m406 : 62|1@1+ (1,0) [0|0] "" Vector__XXX
 SG_ VCFRONT_a407_testingExpended m407 : 62|1@1+ (1,0) [0|0] "" Vector__XXX
 SG_ VCFRONT_a412_serviceMode m412 : 62|1@1+ (1,0) [0|0] "" Vector__XXX
 SG_ VCFRONT_a414_vehiclePowerState m414 : 62|2@1+ (1,0) [0|0] "" Vector__XXX
 SG_ VCFRONT_a415_contactorEFuseUnsta m415 : 62|1@1+ (1,0) [0|0] "" Vector__XXX
 SG_ VCFRONT_a446_recircEXVNotReady m446 : 62|1@1+ (1,0) [0|0] "" Vector__XXX
 SG_ VCFRONT_a477_frunkOpen m477 : 62|1@1+ (1,0) [0|0] "" Vector__XXX
 SG_ VCFRONT_a514_vehiclePowerState m514 : 62|2@1+ (1,0) [0|0] "" Vector__XXX
 SG_ VCFRONT_a515_vehiclePowerState m515 : 62|2@1+ (1,0) [0|0] "" Vector__XXX
 SG_ VCFRONT_a559_hvcEFuseStable m559 : 62|1@1+ (1,0) [0|0] "" Vector__XXX
 SG_ VCFRONT_a561_frunkOpen m561 : 62|1@1+ (1,0) [0|0] "" Vector__XXX
 SG_ VCFRONT_a562_frunkOpen m562 : 62|1@1+ (1,0) [0|0] "" Vector__XXX
 SG_ VCFRONT_a585_rightRailVoltageLow m585 : 62|1@1+ (1,0) [0|0] "" Vector__XXX
 SG_ VCFRONT_a626_testingExpended m626 : 62|1@1+ (1,0) [0|0] "" Vector__XXX
 SG_ VCFRONT_a627_frunkOpen m627 : 62|1@1+ (1,0) [0|0] "" Vector__XXX
 SG_ VCFRONT_a047_IpcWatchdog m47 : 61|1@1+ (1,0) [0|0] "" Vector__XXX
 SG_ VCFRONT_a258_completed m258 : 61|1@1+ (1,0) [0|0] "" Vector__XXX
 SG_ VCFRONT_a363_setFromNvm m363 : 61|1@1+ (1,0) [0|0] "" Vector__XXX
 SG_ VCFRONT_a405_overchargeTrigger m405 : 61|1@1+ (1,0) [0|0] "" Vector__XXX
 SG_ VCFRONT_a406_disconnectedBattery m406 : 61|1@1+ (1,0) [0|0] "" Vector__XXX
 SG_ VCFRONT_a415_vcleftEfuseUnstable m415 : 61|1@1+ (1,0) [0|0] "" Vector__XXX
 SG_ VCFRONT_a446_evapEXVNotReady m446 : 61|1@1+ (1,0) [0|0] "" Vector__XXX
 SG_ VCFRONT_a477_serviceMode m477 : 61|1@1+ (1,0) [0|0] "" Vector__XXX
 SG_ VCFRONT_a514_frunkOpen m514 : 61|1@1+ (1,0) [0|0] "" Vector__XXX
 SG_ VCFRONT_a515_frunkOpen m515 : 61|1@1+ (1,0) [0|0] "" Vector__XXX
 SG_ VCFRONT_a518_vehiclePowerState m518 : 61|2@1+ (1,0) [0|0] "" Vector__XXX
 SG_ VCFRONT_a548_backstopHit m548 : 61|1@1+ (1,0) [0|0] "" Vector__XXX
 SG_ VCFRONT_a559_contactorEFuseStabl m559 : 61|1@1+ (1,0) [0|0] "" Vector__XXX
 SG_ VCFRONT_a561_serviceMode m561 : 61|1@1+ (1,0) [0|0] "" Vector__XXX
 SG_ VCFRONT_a562_serviceMode m562 : 61|1@1+ (1,0) [0|0] "" Vector__XXX
 SG_ VCFRONT_a585_leftRailVoltageLow m585 : 61|1@1+ (1,0) [0|0] "" Vector__XXX
 SG_ VCFRONT_a627_serviceMode m627 : 61|1@1+ (1,0) [0|0] "" Vector__XXX
 SG_ VCFRONT_a047_SingleCoreFailed m47 : 60|1@1+ (1,0) [0|0] "" Vector__XXX
 SG_ VCFRONT_a184_systemAbnormal m184 : 60|1@1+ (1,0) [0|0] "" Vector__XXX
 SG_ VCFRONT_a258_lowCapacity m258 : 60|1@1+ (1,0) [0|0] "" Vector__XXX
 SG_ VCFRONT_a406_opportunisticTest m406 : 60|1@1+ (1,0) [0|0] "" Vector__XXX
 SG_ VCFRONT_a407_testCounter m407 : 60|2@1+ (1,0) [0|0] "" Vector__XXX
 SG_ VCFRONT_a415_vcrightEfuseUnstabl m415 : 60|1@1+ (1,0) [0|0] "" Vector__XXX
 SG_ VCFRONT_a446_LCCEXVNotReady m446 : 60|1@1+ (1,0) [0|0] "" Vector__XXX
 SG_ VCFRONT_a477_deepDischargeFlag m477 : 60|1@1+ (1,0) [0|0] "" Vector__XXX
 SG_ VCFRONT_a513_vehiclePowerState m513 : 60|2@1+ (1,0) [0|0] "" Vector__XXX
 SG_ VCFRONT_a514_serviceMode m514 : 60|1@1+ (1,0) [0|0] "" Vector__XXX
 SG_ VCFRONT_a515_serviceMode m515 : 60|1@1+ (1,0) [0|0] "" Vector__XXX
 SG_ VCFRONT_a518_frunkOpen m518 : 60|1@1+ (1,0) [0|0] "" Vector__XXX
 SG_ VCFRONT_a548_PCSSaturatedTrigger m548 : 60|1@1+ (1,0) [0|0] "" Vector__XXX
 SG_ VCFRONT_a559_vcrightEFuseStable m559 : 60|1@1+ (1,0) [0|0] "" Vector__XXX
 SG_ VCFRONT_a561_factoryMode m561 : 60|1@1+ (1,0) [0|0] "" Vector__XXX
 SG_ VCFRONT_a562_factoryMode m562 : 60|1@1+ (1,0) [0|0] "" Vector__XXX
 SG_ VCFRONT_a585_frunkOpen m585 : 60|1@1+ (1,0) [0|0] "" Vector__XXX
 SG_ VCFRONT_a594_fusionSessionSample m594 : 60|4@1+ (16,0) [0|0] "" Vector__XXX
 SG_ VCFRONT_a626_testCounter m626 : 60|2@1+ (1,0) [0|0] "" Vector__XXX
 SG_ VCFRONT_a627_deepDischargeFlag m627 : 60|1@1+ (1,0) [0|0] "" Vector__XXX
 SG_ VCFRONT_a047_SingleCoreM7_1 m47 : 59|1@1+ (1,0) [0|0] "" Vector__XXX
 SG_ VCFRONT_a127_vcleftEFuseRemainin m127 : 59|4@1+ (1,0) [0|0] "" Vector__XXX
 SG_ VCFRONT_a128_vcrightEFuseRemaini m128 : 59|4@1+ (1,0) [0|0] "" Vector__XXX
 SG_ VCFRONT_a129_pcsEFuseRemainingRe m129 : 59|4@1+ (1,0) [0|0] "" Vector__XXX
 SG_ VCFRONT_a134_vbatFusedEFuseRemai m134 : 59|4@1+ (1,0) [0|0] "" Vector__XXX
 SG_ VCFRONT_a182_batteryType m182 : 59|3@1+ (1,0) [0|0] "" Vector__XXX
 SG_ VCFRONT_a183_batteryType m183 : 59|3@1+ (1,0) [0|0] "" Vector__XXX
 SG_ VCFRONT_a260_bmsState m260 : 59|4@1+ (1,0) [0|0] "" Vector__XXX
 SG_ VCFRONT_a405_testCounter m405 : 59|2@1+ (1,0) [0|0] "" Vector__XXX
 SG_ VCFRONT_a406_testValid m406 : 59|1@1+ (1,0) [0|0] "" Vector__XXX
 SG_ VCFRONT_a415_pcsEFuseUnstable m415 : 59|1@1+ (1,0) [0|0] "" Vector__XXX
 SG_ VCFRONT_a446_CCREXVNotReady m446 : 59|1@1+ (1,0) [0|0] "" Vector__XXX
 SG_ VCFRONT_a474_headlampECURevision m474 : 59|4@1+ (1,0) [0|0] "" Vector__XXX
 SG_ VCFRONT_a475_headlampECURevision m475 : 59|4@1+ (1,0) [0|0] "" Vector__XXX
 SG_ VCFRONT_a481_currentSenseFailure m481 : 59|1@1+ (1,0) [0|0] "" Vector__XXX
 SG_ VCFRONT_a513_frunkOpen m513 : 59|1@1+ (1,0) [0|0] "" Vector__XXX
 SG_ VCFRONT_a518_serviceMode m518 : 59|1@1+ (1,0) [0|0] "" Vector__XXX
 SG_ VCFRONT_a548_PCSMIATrigger m548 : 59|1@1+ (1,0) [0|0] "" Vector__XXX
 SG_ VCFRONT_a559_pcsEFuseStable m559 : 59|1@1+ (1,0) [0|0] "" Vector__XXX
 SG_ VCFRONT_a585_uiMia m585 : 59|1@1+ (1,0) [0|0] "" Vector__XXX
 SG_ VCFRONT_a606_timeInMode m606 : 59|5@1+ (1,0) [0|0] "" Vector__XXX
 SG_ VCFRONT_a663_hcmlValidatedG_0002 m663 : 59|5@1+ (3.225806451612903,0) [0|0] "" Vector__XXX
 SG_ VCFRONT_a664_hcmrValidatedG_0002 m664 : 59|5@1+ (3.225806451612903,0) [0|0] "" Vector__XXX
 SG_ VCFRONT_a669_ambientTempFiltered m669 : 59|5@1+ (3,-40) [0|0] "" Vector__XXX
 SG_ VCFRONT_a047_SingleCoreM4_M7_0 m47 : 58|1@1+ (1,0) [0|0] "" Vector__XXX
 SG_ VCFRONT_a182_impedanceGrowth m182 : 58|1@1+ (1,0) [0|0] "" Vector__XXX
 SG_ VCFRONT_a183_impedanceGrowth m183 : 58|1@1+ (1,0) [0|0] "" Vector__XXX
 SG_ VCFRONT_a253_frunkOpen m253 : 58|1@1+ (1,0) [0|0] "" Vector__XXX
 SG_ VCFRONT_a260_PCSAndVCREFuseStabl m260 : 58|1@1+ (1,0) [0|0] "" Vector__XXX
 SG_ VCFRONT_a359_bmsState m359 : 58|4@1+ (1,0) [0|0] "" Vector__XXX
 SG_ VCFRONT_a379_maxCurrentReached m379 : 58|6@1+ (1,-63) [0|0] "" Vector__XXX
 SG_ VCFRONT_a415_hvUpAnyTrigger m415 : 58|1@1+ (1,0) [0|0] "" Vector__XXX
 SG_ VCFRONT_a446_CCLEXVNotReady m446 : 58|1@1+ (1,0) [0|0] "" Vector__XXX
 SG_ VCFRONT_a481_currentSenseFinishe m481 : 58|1@1+ (1,0) [0|0] "" Vector__XXX
 SG_ VCFRONT_a484_rightHeadlampMigrat m484 : 58|2@1+ (1,0) [0|0] "" Vector__XXX
 SG_ VCFRONT_a513_serviceMode m513 : 58|1@1+ (1,0) [0|0] "" Vector__XXX
 SG_ VCFRONT_a542_isCommissioned m542 : 58|1@1+ (1,0) [0|0] "" Vector__XXX
 SG_ VCFRONT_a548_PCSNotMeetingTarget m548 : 58|1@1+ (1,0) [0|0] "" Vector__XXX
 SG_ VCFRONT_a559_HV_UP m559 : 58|1@1+ (1,0) [0|0] "" Vector__XXX
 SG_ VCFRONT_a585_inTransportMode m585 : 58|1@1+ (1,0) [0|0] "" Vector__XXX
 SG_ VCFRONT_a611_radCoolantToAirUAEs m611 : 58|6@1+ (20,0) [0|0] "" Vector__XXX
 SG_ VCFRONT_a623_serviceMode m623 : 58|1@1+ (1,0) [0|0] "" Vector__XXX
 SG_ VCFRONT_a047_uds m47 : 57|1@1+ (1,0) [0|0] "" Vector__XXX
 SG_ VCFRONT_a162_recircExvFlow m162 : 57|7@1+ (1,0) [0|0] "" Vector__XXX
 SG_ VCFRONT_a178_hpMode m178 : 57|5@1+ (1,0) [0|0] "" Vector__XXX
 SG_ VCFRONT_a182_brickOverDischarged m182 : 57|1@1+ (1,0) [0|0] "" Vector__XXX
 SG_ VCFRONT_a183_brickOverDischarged m183 : 57|1@1+ (1,0) [0|0] "" Vector__XXX
 SG_ VCFRONT_a192_postCrashLoadShedAc m192 : 57|1@1+ (1,0) [0|0] "" Vector__XXX
 SG_ VCFRONT_a253_serviceMode m253 : 57|1@1+ (1,0) [0|0] "" Vector__XXX
 SG_ VCFRONT_a379_testCompleted m379 : 57|1@1+ (1,0) [0|0] "" Vector__XXX
 SG_ VCFRONT_a415_hvUpFirstTrigger m415 : 57|1@1+ (1,0) [0|0] "" Vector__XXX
 SG_ VCFRONT_a429_totalDuration m429 : 57|6@1+ (1,-1) [0|0] "" Vector__XXX
 SG_ VCFRONT_a446_chillerEXVNotReady m446 : 57|1@1+ (1,0) [0|0] "" Vector__XXX
 SG_ VCFRONT_a474_LMMVariant m474 : 57|2@1+ (1,0) [0|0] "" Vector__XXX
 SG_ VCFRONT_a475_LMMVariant m475 : 57|2@1+ (1,0) [0|0] "" Vector__XXX
 SG_ VCFRONT_a482_rangeValid m482 : 57|1@1+ (1,0) [0|0] "" Vector__XXX
 SG_ VCFRONT_a485_rangeValid m485 : 57|1@1+ (1,0) [0|0] "" Vector__XXX
 SG_ VCFRONT_a527_frunkOpen m527 : 57|1@1+ (1,0) [0|0] "" Vector__XXX
 SG_ VCFRONT_a542_inServiceMode m542 : 57|1@1+ (1,0) [0|0] "" Vector__XXX
 SG_ VCFRONT_a548_HVNotConfirmedUpTri m548 : 57|1@1+ (1,0) [0|0] "" Vector__XXX
 SG_ VCFRONT_a559_HVBlockingMismatch m559 : 57|1@1+ (1,0) [0|0] "" Vector__XXX
 SG_ VCFRONT_a585_inServiceMode m585 : 57|1@1+ (1,0) [0|0] "" Vector__XXX
 SG_ VCFRONT_a623_factoryMode m623 : 57|1@1+ (1,0) [0|0] "" Vector__XXX
 SG_ VCFRONT_a009_LCCInletCoolantAtEx m9 : 56|6@1- (1,12) [0|0] "" Vector__XXX
 SG_ VCFRONT_a022_TaskInitError4 m22 : 56|8@1+ (1,0) [0|0] "" Vector__XXX
 SG_ VCFRONT_a031_uds_bytes_5 m31 : 56|8@1+ (1,0) [0|0] "" Vector__XXX
 SG_ VCFRONT_a041_CPULoadNVMMTask m41 : 56|8@1+ (1,0) [0|0] "" Vector__XXX
 SG_ VCFRONT_a042_UsageNVMMTask m42 : 56|8@1+ (1,0) [0|0] "" Vector__XXX
 SG_ VCFRONT_a047_CsvRef m47 : 56|1@1+ (1,0) [0|0] "" Vector__XXX
 SG_ VCFRONT_a154_minVoltageAlignedDc m154 : 56|8@1+ (1,0) [0|0] "" Vector__XXX
 SG_ VCFRONT_a155_minCurrentAlignedDc m155 : 56|8@1+ (1,0) [0|0] "" Vector__XXX
 SG_ VCFRONT_a178_isAmbientAvailable m178 : 56|1@1+ (1,0) [0|0] "" Vector__XXX
 SG_ VCFRONT_a180_targetPCSVoltage m180 : 56|8@1+ (0.1,0) [0|0] "" Vector__XXX
 SG_ VCFRONT_a182_samplingHWError m182 : 56|1@1+ (1,0) [0|0] "" Vector__XXX
 SG_ VCFRONT_a183_samplingHWError m183 : 56|1@1+ (1,0) [0|0] "" Vector__XXX
 SG_ VCFRONT_a191_bmsState m191 : 56|4@1+ (1,0) [0|0] "" Vector__XXX
 SG_ VCFRONT_a192_HVFaultLoadShedActi m192 : 56|1@1+ (1,0) [0|0] "" Vector__XXX
 SG_ VCFRONT_a196_ECPAState m196 : 56|2@1+ (1,0) [0|0] "" Vector__XXX
 SG_ VCFRONT_a197_dcrMilliOhmsFiltere m197 : 56|8@1+ (1,0) [0|0] "" Vector__XXX
 SG_ VCFRONT_a242_vehiclePowerState m242 : 56|2@1+ (1,0) [0|0] "" Vector__XXX
 SG_ VCFRONT_a253_firstChargePOR m253 : 56|1@1+ (1,0) [0|0] "" Vector__XXX
 SG_ VCFRONT_a260_dcdcLVSupportStatus m260 : 56|2@1+ (1,0) [0|0] "" Vector__XXX
 SG_ VCFRONT_a269_vehiclePowerState m269 : 56|2@1+ (1,0) [0|0] "" Vector__XXX
 SG_ VCFRONT_a359_dcdcLVSupportStatus m359 : 56|2@1+ (1,0) [0|0] "" Vector__XXX
 SG_ VCFRONT_a363_minBleedChargeBrick m363 : 56|5@1+ (1,1) [0|0] "" Vector__XXX
 SG_ VCFRONT_a379_testFailed m379 : 56|1@1+ (1,0) [0|0] "" Vector__XXX
 SG_ VCFRONT_a412_pulseCurrentVarianc m412 : 56|6@1+ (0.25,0) [0|0] "" Vector__XXX
 SG_ VCFRONT_a415_HV_UP m415 : 56|1@1+ (1,0) [0|0] "" Vector__XXX
 SG_ VCFRONT_a421_hcmlReadBufferHighW m421 : 56|5@1+ (3.225806451612903,0) [0|0] "" Vector__XXX
 SG_ VCFRONT_a427_cacUpdateError m427 : 56|8@1+ (0.1,0) [0|0] "" Vector__XXX
 SG_ VCFRONT_a429_testType m429 : 56|1@1+ (1,0) [0|0] "" Vector__XXX
 SG_ VCFRONT_a446_refSysLockedOut m446 : 56|1@1+ (1,0) [0|0] "" Vector__XXX
 SG_ VCFRONT_a474_EEPROM_DataStatus m474 : 56|1@1+ (1,0) [0|0] "" Vector__XXX
 SG_ VCFRONT_a475_EEPROM_DataStatus m475 : 56|1@1+ (1,0) [0|0] "" Vector__XXX
 SG_ VCFRONT_a482_previousAimedP_0000 m482 : 56|1@1+ (1,0) [0|0] "" Vector__XXX
 SG_ VCFRONT_a484_leftHeadlampMigrati m484 : 56|2@1+ (1,0) [0|0] "" Vector__XXX
 SG_ VCFRONT_a485_previousAimedP_0000 m485 : 56|1@1+ (1,0) [0|0] "" Vector__XXX
 SG_ VCFRONT_a493_avgBrickSoc m493 : 56|7@1+ (1,0) [0|0] "" Vector__XXX
 SG_ VCFRONT_a497_frunkOpen m497 : 56|1@1+ (1,0) [0|0] "" Vector__XXX
 SG_ VCFRONT_a511_frunkOpen m511 : 56|1@1+ (1,0) [0|0] "" Vector__XXX
 SG_ VCFRONT_a523_control3Byte3 m523 : 56|8@1+ (1,0) [0|0] "" Vector__XXX
 SG_ VCFRONT_a527_serviceMode m527 : 56|1@1+ (1,0) [0|0] "" Vector__XXX
 SG_ VCFRONT_a541_SOC m541 : 56|7@1+ (1,0) [0|0] "" Vector__XXX
 SG_ VCFRONT_a542_inFactoryMode m542 : 56|1@1+ (1,0) [0|0] "" Vector__XXX
 SG_ VCFRONT_a548_ampHourBucketFilled m548 : 56|1@1+ (1,0) [0|0] "" Vector__XXX
 SG_ VCFRONT_a559_PCS_MIA m559 : 56|1@1+ (1,0) [0|0] "" Vector__XXX
 SG_ VCFRONT_a585_inFactoryMode m585 : 56|1@1+ (1,0) [0|0] "" Vector__XXX
 SG_ VCFRONT_a623_failureLvBatteryExt m623 : 56|1@1+ (1,0) [0|0] "" Vector__XXX
 SG_ VCFRONT_a643_hcmrReadBufferHighW m643 : 56|5@1+ (3.225806451612903,0) [0|0] "" Vector__XXX
 SG_ VCFRONT_a646_fluidSuccessPercent m646 : 56|8@1+ (1,0) [0|0] "" Vector__XXX
 SG_ VCFRONT_a178_isPdAvailable m178 : 55|1@1+ (1,0) [0|0] "" Vector__XXX
 SG_ VCFRONT_a182_calibrationLostFaul m182 : 55|1@1+ (1,0) [0|0] "" Vector__XXX
 SG_ VCFRONT_a183_calibrationLostFaul m183 : 55|1@1+ (1,0) [0|0] "" Vector__XXX
 SG_ VCFRONT_a191_NotEnoughPowerForSu m191 : 55|1@1+ (1,0) [0|0] "" Vector__XXX
 SG_ VCFRONT_a197_frunkOpen m197 : 55|1@1+ (1,0) [0|0] "" Vector__XXX
 SG_ VCFRONT_a253_firstChargeOTA m253 : 55|1@1+ (1,0) [0|0] "" Vector__XXX
 SG_ VCFRONT_a260_serviceMode m260 : 55|1@1+ (1,0) [0|0] "" Vector__XXX
 SG_ VCFRONT_a359_serviceMode m359 : 55|1@1+ (1,0) [0|0] "" Vector__XXX
 SG_ VCFRONT_a446_coolantSysLockedOut m446 : 55|1@1+ (1,0) [0|0] "" Vector__XXX
 SG_ VCFRONT_a474_BoostRailStatus m474 : 55|1@1+ (1,0) [0|0] "" Vector__XXX
 SG_ VCFRONT_a475_BoostRailStatus m475 : 55|1@1+ (1,0) [0|0] "" Vector__XXX
 SG_ VCFRONT_a511_serviceMode m511 : 55|1@1+ (1,0) [0|0] "" Vector__XXX
 SG_ VCFRONT_a559_BMS_MIA m559 : 55|1@1+ (1,0) [0|0] "" Vector__XXX
 SG_ VCFRONT_a623_failureLvBatteryHig m623 : 55|1@1+ (1,0) [0|0] "" Vector__XXX
 SG_ VCFRONT_a178_isPsAvailable m178 : 54|1@1+ (1,0) [0|0] "" Vector__XXX
 SG_ VCFRONT_a184_recircDoorPercent m184 : 54|6@1+ (2,0) [0|0] "" Vector__XXX
 SG_ VCFRONT_a191_PCS_MIA m191 : 54|1@1+ (1,0) [0|0] "" Vector__XXX
 SG_ VCFRONT_a197_serviceMode m197 : 54|1@1+ (1,0) [0|0] "" Vector__XXX
 SG_ VCFRONT_a260_HVBlockingMismatch m260 : 54|1@1+ (1,0) [0|0] "" Vector__XXX
 SG_ VCFRONT_a359_PCS_MIA m359 : 54|1@1+ (1,0) [0|0] "" Vector__XXX
 SG_ VCFRONT_a414_IBSAmpHours m414 : 54|8@1+ (0.01,-2.55) [0|0] "" Vector__XXX
 SG_ VCFRONT_a415_vehiclePowerState m415 : 54|2@1+ (1,0) [0|0] "" Vector__XXX
 SG_ VCFRONT_a416_brickId m416 : 54|8@1+ (1,1) [0|0] "" Vector__XXX
 SG_ VCFRONT_a417_brickId m417 : 54|8@1+ (1,1) [0|0] "" Vector__XXX
 SG_ VCFRONT_a418_brickId m418 : 54|8@1+ (1,1) [0|0] "" Vector__XXX
 SG_ VCFRONT_a419_brickId m419 : 54|8@1+ (1,1) [0|0] "" Vector__XXX
 SG_ VCFRONT_a423_brickId m423 : 54|8@1+ (1,1) [0|0] "" Vector__XXX
 SG_ VCFRONT_a424_brickId m424 : 54|8@1+ (1,1) [0|0] "" Vector__XXX
 SG_ VCFRONT_a446_hvacSystemFault m446 : 54|1@1+ (1,0) [0|0] "" Vector__XXX
 SG_ VCFRONT_a474_TPS92520_BSTUV m474 : 54|1@1+ (1,0) [0|0] "" Vector__XXX
 SG_ VCFRONT_a475_TPS92520_BSTUV m475 : 54|1@1+ (1,0) [0|0] "" Vector__XXX
 SG_ VCFRONT_a498_measuredVoltage m498 : 54|10@1+ (0.05,0) [0|0] "" Vector__XXX
 SG_ VCFRONT_a503_brickId m503 : 54|8@1+ (1,1) [0|0] "" Vector__XXX
 SG_ VCFRONT_a511_vehicleIsUpdating m511 : 54|1@1+ (1,0) [0|0] "" Vector__XXX
 SG_ VCFRONT_a559_crashDetected m559 : 54|1@1+ (1,0) [0|0] "" Vector__XXX
 SG_ VCFRONT_a606_battLPMAtExit m606 : 54|5@1+ (1,0) [0|0] "" Vector__XXX
 SG_ VCFRONT_a623_failureLvBatte_0000 m623 : 54|1@1+ (1,0) [0|0] "" Vector__XXX
 SG_ VCFRONT_a663_hcmlGroupsHigh_0002 m663 : 54|5@1+ (3.225806451612903,0) [0|0] "" Vector__XXX
 SG_ VCFRONT_a664_hcmrGroupsHigh_0002 m664 : 54|5@1+ (3.225806451612903,0) [0|0] "" Vector__XXX
 SG_ VCFRONT_a178_isInSilentMode m178 : 53|1@1+ (1,0) [0|0] "" Vector__XXX
 SG_ VCFRONT_a188_wakeUpMsgID m188 : 53|11@1+ (1,0) [0|0] "" Vector__XXX
 SG_ VCFRONT_a191_LVBMSMIA m191 : 53|1@1+ (1,0) [0|0] "" Vector__XXX
 SG_ VCFRONT_a260_PCS_MIA m260 : 53|1@1+ (1,0) [0|0] "" Vector__XXX
 SG_ VCFRONT_a359_BMS_MIA m359 : 53|1@1+ (1,0) [0|0] "" Vector__XXX
 SG_ VCFRONT_a405_intervalCurrentVari m405 : 53|6@1+ (0.1,0) [0|0] "" Vector__XXX
 SG_ VCFRONT_a406_IBSTemperature m406 : 53|6@1+ (1,-3) [0|0] "" Vector__XXX
 SG_ VCFRONT_a408_standbyChargeProfil m408 : 53|10@1+ (1,0) [0|0] "" Vector__XXX
 SG_ VCFRONT_a428_modCacImbalancePct m428 : 53|10@1+ (0.1,0) [0|0] "" Vector__XXX
 SG_ VCFRONT_a446_batteryOverTemp m446 : 53|1@1+ (1,0) [0|0] "" Vector__XXX
 SG_ VCFRONT_a474_TPS92520_HSILIM m474 : 53|1@1+ (1,0) [0|0] "" Vector__XXX
 SG_ VCFRONT_a475_TPS92520_HSILIM m475 : 53|1@1+ (1,0) [0|0] "" Vector__XXX
 SG_ VCFRONT_a511_factoryGated m511 : 53|1@1+ (1,0) [0|0] "" Vector__XXX
 SG_ VCFRONT_a559_notEnoughPowerForSu m559 : 53|1@1+ (1,0) [0|0] "" Vector__XXX
 SG_ VCFRONT_a561_cell4Voltage m561 : 53|7@1+ (0.04,0) [0|0] "" Vector__XXX
 SG_ VCFRONT_a562_cell4Voltage m562 : 53|7@1+ (0.04,0) [0|0] "" Vector__XXX
 SG_ VCFRONT_a623_failureLvBatteryCap m623 : 53|1@1+ (1,0) [0|0] "" Vector__XXX
 SG_ VCFRONT_a669_minPackTemperature m669 : 53|6@1+ (2,-40) [0|0] "" Vector__XXX
 SG_ VCFRONT_a187_chBusRetryCount m187 : 52|9@1+ (1,0) [0|0] "" Vector__XXX
 SG_ VCFRONT_a188_SleepRequestTimeout m188 : 52|1@1+ (1,0) [0|0] "" Vector__XXX
 SG_ VCFRONT_a190_maxMessagePeriod m190 : 52|12@1+ (1,0) [0|0] "" Vector__XXX
 SG_ VCFRONT_a191_exitDriveWarningTim m191 : 52|1@1+ (1,0) [0|0] "" Vector__XXX
 SG_ VCFRONT_a248_voltageCalScaling m248 : 52|12@1+ (0.025,0) [0|0] "" Vector__XXX
 SG_ VCFRONT_a260_BMS_MIA m260 : 52|1@1+ (1,0) [0|0] "" Vector__XXX
 SG_ VCFRONT_a334_vehicleState m334 : 52|2@1+ (1,0) [0|0] "" Vector__XXX
 SG_ VCFRONT_a335_vehicleState m335 : 52|2@1+ (1,0) [0|0] "" Vector__XXX
 SG_ VCFRONT_a336_vehicleState m336 : 52|2@1+ (1,0) [0|0] "" Vector__XXX
 SG_ VCFRONT_a337_vehicleState m337 : 52|2@1+ (1,0) [0|0] "" Vector__XXX
 SG_ VCFRONT_a338_vehicleState m338 : 52|2@1+ (1,0) [0|0] "" Vector__XXX
 SG_ VCFRONT_a339_vehicleState m339 : 52|2@1+ (1,0) [0|0] "" Vector__XXX
 SG_ VCFRONT_a340_vehicleState m340 : 52|2@1+ (1,0) [0|0] "" Vector__XXX
 SG_ VCFRONT_a341_vehicleState m341 : 52|2@1+ (1,0) [0|0] "" Vector__XXX
 SG_ VCFRONT_a342_vehicleState m342 : 52|2@1+ (1,0) [0|0] "" Vector__XXX
 SG_ VCFRONT_a343_vehicleState m343 : 52|2@1+ (1,0) [0|0] "" Vector__XXX
 SG_ VCFRONT_a344_vehicleState m344 : 52|2@1+ (1,0) [0|0] "" Vector__XXX
 SG_ VCFRONT_a345_vehicleState m345 : 52|2@1+ (1,0) [0|0] "" Vector__XXX
 SG_ VCFRONT_a346_vehicleState m346 : 52|2@1+ (1,0) [0|0] "" Vector__XXX
 SG_ VCFRONT_a347_vehicleState m347 : 52|2@1+ (1,0) [0|0] "" Vector__XXX
 SG_ VCFRONT_a348_vehicleState m348 : 52|2@1+ (1,0) [0|0] "" Vector__XXX
 SG_ VCFRONT_a349_vehicleState m349 : 52|2@1+ (1,0) [0|0] "" Vector__XXX
 SG_ VCFRONT_a352_duration m352 : 52|10@1+ (1,0) [0|0] "" Vector__XXX
 SG_ VCFRONT_a359_crashDetected m359 : 52|1@1+ (1,0) [0|0] "" Vector__XXX
 SG_ VCFRONT_a370_SOC m370 : 52|3@1+ (2.5,5) [0|0] "" Vector__XXX
 SG_ VCFRONT_a391_switch2VoltageInsta m391 : 52|10@1+ (5,0) [0|0] "" Vector__XXX
 SG_ VCFRONT_a403_chargeTime m403 : 52|10@1+ (1,0) [0|0] "" Vector__XXX
 SG_ VCFRONT_a407_IBSTemperature m407 : 52|8@1+ (0.5,-30) [0|0] "" Vector__XXX
 SG_ VCFRONT_a446_evapLowPsCutout m446 : 52|1@1+ (1,0) [0|0] "" Vector__XXX
 SG_ VCFRONT_a463_switch2VoltageInsta m463 : 52|10@1+ (5,0) [0|0] "" Vector__XXX
 SG_ VCFRONT_a474_TPS92520_COMPOV m474 : 52|1@1+ (1,0) [0|0] "" Vector__XXX
 SG_ VCFRONT_a475_TPS92520_COMPOV m475 : 52|1@1+ (1,0) [0|0] "" Vector__XXX
 SG_ VCFRONT_a477_sumCellVoltage m477 : 52|8@1+ (0.1,0) [0|0] "" Vector__XXX
 SG_ VCFRONT_a484_headlampAimingDebug m484 : 52|3@1+ (1,0) [0|0] "" Vector__XXX
 SG_ VCFRONT_a502_shortImpedance m502 : 52|10@1+ (1,0) [0|0] "" Vector__XXX
 SG_ VCFRONT_a511_PCSSignalsAreValid m511 : 52|1@1+ (1,0) [0|0] "" Vector__XXX
 SG_ VCFRONT_a512_vehiclePowerState m512 : 52|2@1+ (1,0) [0|0] "" Vector__XXX
 SG_ VCFRONT_a514_packSOC m514 : 52|8@1+ (0.4,0) [0|0] "" Vector__XXX
 SG_ VCFRONT_a515_packSOC m515 : 52|8@1+ (0.4,0) [0|0] "" Vector__XXX
 SG_ VCFRONT_a559_transportMode m559 : 52|1@1+ (1,0) [0|0] "" Vector__XXX
 SG_ VCFRONT_a600_version m600 : 52|4@1+ (1,0) [0|0] "" Vector__XXX
 SG_ VCFRONT_a611_heatGenTotal m611 : 52|6@1+ (500,0) [0|0] "" Vector__XXX
 SG_ VCFRONT_a623_failureLvBatteryPow m623 : 52|1@1+ (1,0) [0|0] "" Vector__XXX
 SG_ VCFRONT_a626_IBSTemperature m626 : 52|8@1+ (0.5,-30) [0|0] "" Vector__XXX
 SG_ VCFRONT_a627_sumCellVoltage m627 : 52|8@1+ (0.1,0) [0|0] "" Vector__XXX
 SG_ VCFRONT_a058_newREstimate m58 : 51|12@1+ (0.00061,0) [0|0] "" Vector__XXX
 SG_ VCFRONT_a188_CANAfterQuiet m188 : 51|1@1+ (1,0) [0|0] "" Vector__XXX
 SG_ VCFRONT_a260_crashDetected m260 : 51|1@1+ (1,0) [0|0] "" Vector__XXX
 SG_ VCFRONT_a310_vehicleState m310 : 51|2@1+ (1,0) [0|0] "" Vector__XXX
 SG_ VCFRONT_a311_vehicleState m311 : 51|2@1+ (1,0) [0|0] "" Vector__XXX
 SG_ VCFRONT_a312_vehicleState m312 : 51|2@1+ (1,0) [0|0] "" Vector__XXX
 SG_ VCFRONT_a313_vehicleState m313 : 51|2@1+ (1,0) [0|0] "" Vector__XXX
 SG_ VCFRONT_a314_vehicleState m314 : 51|2@1+ (1,0) [0|0] "" Vector__XXX
 SG_ VCFRONT_a315_vehicleState m315 : 51|2@1+ (1,0) [0|0] "" Vector__XXX
 SG_ VCFRONT_a316_vehicleState m316 : 51|2@1+ (1,0) [0|0] "" Vector__XXX
 SG_ VCFRONT_a317_vehicleState m317 : 51|2@1+ (1,0) [0|0] "" Vector__XXX
 SG_ VCFRONT_a318_vehicleState m318 : 51|2@1+ (1,0) [0|0] "" Vector__XXX
 SG_ VCFRONT_a319_vehicleState m319 : 51|2@1+ (1,0) [0|0] "" Vector__XXX
 SG_ VCFRONT_a320_vehicleState m320 : 51|2@1+ (1,0) [0|0] "" Vector__XXX
 SG_ VCFRONT_a321_vehicleState m321 : 51|2@1+ (1,0) [0|0] "" Vector__XXX
 SG_ VCFRONT_a322_vehicleState m322 : 51|2@1+ (1,0) [0|0] "" Vector__XXX
 SG_ VCFRONT_a323_vehicleState m323 : 51|2@1+ (1,0) [0|0] "" Vector__XXX
 SG_ VCFRONT_a324_vehicleState m324 : 51|2@1+ (1,0) [0|0] "" Vector__XXX
 SG_ VCFRONT_a325_vehicleState m325 : 51|2@1+ (1,0) [0|0] "" Vector__XXX
 SG_ VCFRONT_a359_coolantHasBeenFille m359 : 51|1@1+ (1,0) [0|0] "" Vector__XXX
 SG_ VCFRONT_a444_enableLow m444 : 51|1@1+ (1,0) [0|0] "" Vector__XXX
 SG_ VCFRONT_a446_highSuctionSuperhea m446 : 51|1@1+ (1,0) [0|0] "" Vector__XXX
 SG_ VCFRONT_a474_fanStatus m474 : 51|1@1+ (1,0) [0|0] "" Vector__XXX
 SG_ VCFRONT_a475_fanStatus m475 : 51|1@1+ (1,0) [0|0] "" Vector__XXX
 SG_ VCFRONT_a511_DCDCOutputIsLimited m511 : 51|1@1+ (1,0) [0|0] "" Vector__XXX
 SG_ VCFRONT_a512_frunkOpen m512 : 51|1@1+ (1,0) [0|0] "" Vector__XXX
 SG_ VCFRONT_a559_serviceMode m559 : 51|1@1+ (1,0) [0|0] "" Vector__XXX
 SG_ VCFRONT_a623_failurePcsOpenCircu m623 : 51|1@1+ (1,0) [0|0] "" Vector__XXX
 SG_ VCFRONT_a635_didCore2EverSleep m635 : 51|1@1+ (1,0) [0|0] "" Vector__XXX
 SG_ VCFRONT_a113_VEH_odo m113 : 50|1@1+ (1,0) [0|0] "" Vector__XXX
 SG_ VCFRONT_a162_evapExvFlow m162 : 50|7@1+ (1,0) [0|0] "" Vector__XXX
 SG_ VCFRONT_a188_accessoryRequest m188 : 50|1@1+ (1,0) [0|0] "" Vector__XXX
 SG_ VCFRONT_a191_vehicleLoadShedStag m191 : 50|2@1+ (1,0) [0|0] "" Vector__XXX
 SG_ VCFRONT_a250_calibratedHori_0000 m250 : 50|10@1+ (1,0) [0|0] "" Vector__XXX
 SG_ VCFRONT_a260_voltageTrigger m260 : 50|1@1+ (1,0) [0|0] "" Vector__XXX
 SG_ VCFRONT_a365_bmsTooHot m365 : 50|1@1+ (1,0) [0|0] "" Vector__XXX
 SG_ VCFRONT_a379_timeBelowVoltageThr m379 : 50|6@1+ (32,0) [0|0] "" Vector__XXX
 SG_ VCFRONT_a429_duration m429 : 50|6@1+ (1,-1) [0|0] "" Vector__XXX
 SG_ VCFRONT_a444_voltageMonitor m444 : 50|1@1+ (1,0) [0|0] "" Vector__XXX
 SG_ VCFRONT_a446_sensorIntermit_0002 m446 : 50|1@1+ (1,0) [0|0] "" Vector__XXX
 SG_ VCFRONT_a481_currentSenseVoltage m481 : 50|8@1+ (1,0) [0|0] "" Vector__XXX
 SG_ VCFRONT_a512_serviceMode m512 : 50|1@1+ (1,0) [0|0] "" Vector__XXX
 SG_ VCFRONT_a559_factoryMode m559 : 50|1@1+ (1,0) [0|0] "" Vector__XXX
 SG_ VCFRONT_a594_lifetimeSampleCount m594 : 50|10@1+ (100,0) [0|0] "" Vector__XXX
 SG_ VCFRONT_a623_failurePcsMia m623 : 50|1@1+ (1,0) [0|0] "" Vector__XXX
 SG_ VCFRONT_a635_didCore1EverSleep m635 : 50|1@1+ (1,0) [0|0] "" Vector__XXX
 SG_ VCFRONT_a113_CH_vehicleControl2 m113 : 49|1@1+ (1,0) [0|0] "" Vector__XXX
 SG_ VCFRONT_a184_evapOutTempNominal m184 : 49|5@1+ (1,0) [0|0] "" Vector__XXX
 SG_ VCFRONT_a188_ThermalSupport m188 : 49|1@1+ (1,0) [0|0] "" Vector__XXX
 SG_ VCFRONT_a191_frunkOpen m191 : 49|1@1+ (1,0) [0|0] "" Vector__XXX
 SG_ VCFRONT_a260_ampHourTrigger m260 : 49|1@1+ (1,0) [0|0] "" Vector__XXX
 SG_ VCFRONT_a365_pcsReportsUnavailab m365 : 49|1@1+ (1,0) [0|0] "" Vector__XXX
 SG_ VCFRONT_a366_bmsTooHot m366 : 49|1@1+ (1,0) [0|0] "" Vector__XXX
 SG_ VCFRONT_a433_useBmbModuleId m433 : 49|1@1+ (1,0) [0|0] "" Vector__XXX
 SG_ VCFRONT_a434_useBmbModuleId m434 : 49|1@1+ (1,0) [0|0] "" Vector__XXX
 SG_ VCFRONT_a444_spiFault m444 : 49|1@1+ (1,0) [0|0] "" Vector__XXX
 SG_ VCFRONT_a446_sensorIntermittentT m446 : 49|1@1+ (1,0) [0|0] "" Vector__XXX
 SG_ VCFRONT_a481_softShortThresholdR m481 : 49|1@1+ (1,0) [0|0] "" Vector__XXX
 SG_ VCFRONT_a509_frunkOpen m509 : 49|1@1+ (1,0) [0|0] "" Vector__XXX
 SG_ VCFRONT_a518_packSOC m518 : 49|10@1+ (0.1,0) [0|0] "" Vector__XXX
 SG_ VCFRONT_a521_frunkOpen m521 : 49|1@1+ (1,0) [0|0] "" Vector__XXX
 SG_ VCFRONT_a529_LVBusVoltageNotCont m529 : 49|1@1+ (1,0) [0|0] "" Vector__XXX
 SG_ VCFRONT_a584_elapsedTime m584 : 49|15@1+ (100,0) [0|0] "" Vector__XXX
 SG_ VCFRONT_a606_battLPMBeforeEntry m606 : 49|5@1+ (1,0) [0|0] "" Vector__XXX
 SG_ VCFRONT_a623_failurePcsNotActive m623 : 49|1@1+ (1,0) [0|0] "" Vector__XXX
 SG_ VCFRONT_a635_sleepShutdownC_0000 m635 : 49|1@1+ (1,0) [0|0] "" Vector__XXX
 SG_ VCFRONT_a663_hcmlValidatedG_0001 m663 : 49|5@1+ (3.225806451612903,0) [0|0] "" Vector__XXX
 SG_ VCFRONT_a664_hcmrValidatedG_0001 m664 : 49|5@1+ (3.225806451612903,0) [0|0] "" Vector__XXX
 SG_ VCFRONT_a000_alertDataW2 m0 : 48|16@1+ (1,0) [0|0] "" Vector__XXX
 SG_ VCFRONT_a003_Data m3 : 48|16@1+ (1,0) [0|0] "" Vector__XXX
 SG_ VCFRONT_a009_subcoolAtExit m9 : 48|5@1- (1,6) [0|0] "" Vector__XXX
 SG_ VCFRONT_a022_TaskInitError3 m22 : 48|8@1+ (1,0) [0|0] "" Vector__XXX
 SG_ VCFRONT_a031_uds_bytes_4 m31 : 48|8@1+ (1,0) [0|0] "" Vector__XXX
 SG_ VCFRONT_a041_CPULoad1000msTask m41 : 48|8@1+ (1,0) [0|0] "" Vector__XXX
 SG_ VCFRONT_a042_UsageUDSTask m42 : 48|8@1+ (1,0) [0|0] "" Vector__XXX
 SG_ VCFRONT_a113_VEH_driverAssistMap m113 : 48|1@1+ (1,0) [0|0] "" Vector__XXX
 SG_ VCFRONT_a120_BDY_speed m120 : 48|1@1+ (1,0) [0|0] "" Vector__XXX
 SG_ VCFRONT_a127_vcleftEFuseTemp m127 : 48|11@1+ (0.125,-40) [0|0] "" Vector__XXX
 SG_ VCFRONT_a128_vcrightEFuseTemp m128 : 48|11@1+ (0.125,-40) [0|0] "" Vector__XXX
 SG_ VCFRONT_a129_pcsEFuseTemp m129 : 48|11@1+ (0.125,-40) [0|0] "" Vector__XXX
 SG_ VCFRONT_a130_epas3pEFuseTemp m130 : 48|11@1+ (0.125,-40) [0|0] "" Vector__XXX
 SG_ VCFRONT_a131_epas3sEFuseTemp m131 : 48|11@1+ (0.125,-40) [0|0] "" Vector__XXX
 SG_ VCFRONT_a132_iBoosterEFuseTemp m132 : 48|11@1+ (0.125,-40) [0|0] "" Vector__XXX
 SG_ VCFRONT_a133_espEFuseTemp m133 : 48|11@1+ (0.125,-40) [0|0] "" Vector__XXX
 SG_ VCFRONT_a134_fusedHighTemp m134 : 48|11@1+ (0.125,-40) [0|0] "" Vector__XXX
 SG_ VCFRONT_a154_lastSilentWakeTimeS m154 : 48|8@1+ (0.2,0) [0|0] "" Vector__XXX
 SG_ VCFRONT_a155_minHVComingUpIBSTem m155 : 48|7@1+ (1,-24) [0|0] "" Vector__XXX
 SG_ VCFRONT_a180_IBSVoltage m180 : 48|8@1+ (0.08741903380905883,0) [0|0] "" Vector__XXX
 SG_ VCFRONT_a188_12VSupport m188 : 48|1@1+ (1,0) [0|0] "" Vector__XXX
 SG_ VCFRONT_a191_serviceMode m191 : 48|1@1+ (1,0) [0|0] "" Vector__XXX
 SG_ VCFRONT_a192_PCSCurrent m192 : 48|8@1+ (0.5,-127) [0|0] "" Vector__XXX
 SG_ VCFRONT_a196_disconnectedBa_0001 m196 : 48|8@1+ (0.0392156862745098,6) [0|0] "" Vector__XXX
 SG_ VCFRONT_a213_LVBatteryTemp m213 : 48|16@1- (0.01,0) [0|0] "" Vector__XXX
 SG_ VCFRONT_a219_IBSCurrent m219 : 48|16@1- (0.005,0) [0|0] "" Vector__XXX
 SG_ VCFRONT_a242_IBSAmpHours m242 : 48|8@1+ (0.01,-2.55) [0|0] "" Vector__XXX
 SG_ VCFRONT_a243_LVBatteryTemp m243 : 48|16@1- (0.01,0) [0|0] "" Vector__XXX
 SG_ VCFRONT_a244_vbatProtVoltage m244 : 48|16@1+ (0.1,0) [0|0] "" Vector__XXX
 SG_ VCFRONT_a245_eFuseRemainingRetri m245 : 48|4@1+ (1,0) [0|0] "" Vector__XXX
 SG_ VCFRONT_a246_eFuseRemainingRetri m246 : 48|4@1+ (1,0) [0|0] "" Vector__XXX
 SG_ VCFRONT_a252_IBSCurrent m252 : 48|16@1- (0.005,0) [0|0] "" Vector__XXX
 SG_ VCFRONT_a253_LVBatteryTemp m253 : 48|7@1+ (1,-40) [0|0] "" Vector__XXX
 SG_ VCFRONT_a259_maxCurrentReached m259 : 48|16@1- (0.005,0) [0|0] "" Vector__XXX
 SG_ VCFRONT_a260_coolantHasBeenFille m260 : 48|1@1+ (1,0) [0|0] "" Vector__XXX
 SG_ VCFRONT_a269_IBSAmpHours m269 : 48|8@1+ (0.01,-2.55) [0|0] "" Vector__XXX
 SG_ VCFRONT_a283_thmlFanPhaseILimit m283 : 48|7@1+ (0.25,0) [0|0] "" Vector__XXX
 SG_ VCFRONT_a303_lockStatus m303 : 48|2@1+ (1,0) [0|0] "" Vector__XXX
 SG_ VCFRONT_a309_lockStatus m309 : 48|2@1+ (1,0) [0|0] "" Vector__XXX
 SG_ VCFRONT_a326_vehicleState m326 : 48|2@1+ (1,0) [0|0] "" Vector__XXX
 SG_ VCFRONT_a327_vehicleState m327 : 48|2@1+ (1,0) [0|0] "" Vector__XXX
 SG_ VCFRONT_a328_vehicleState m328 : 48|2@1+ (1,0) [0|0] "" Vector__XXX
 SG_ VCFRONT_a329_vehicleState m329 : 48|2@1+ (1,0) [0|0] "" Vector__XXX
 SG_ VCFRONT_a330_vehicleState m330 : 48|2@1+ (1,0) [0|0] "" Vector__XXX
 SG_ VCFRONT_a331_vehicleState m331 : 48|2@1+ (1,0) [0|0] "" Vector__XXX
 SG_ VCFRONT_a332_vehicleState m332 : 48|2@1+ (1,0) [0|0] "" Vector__XXX
 SG_ VCFRONT_a333_vehicleState m333 : 48|2@1+ (1,0) [0|0] "" Vector__XXX
 SG_ VCFRONT_a359_hvState m359 : 48|3@1+ (1,0) [0|0] "" Vector__XXX
 SG_ VCFRONT_a363_checkIntervalDays m363 : 48|5@1+ (1,0) [0|0] "" Vector__XXX
 SG_ VCFRONT_a365_pcsTooHot m365 : 48|1@1+ (1,0) [0|0] "" Vector__XXX
 SG_ VCFRONT_a366_pcsReportsUnavailab m366 : 48|1@1+ (1,0) [0|0] "" Vector__XXX
 SG_ VCFRONT_a387_maxCurrentReached m387 : 48|16@1- (0.005,0) [0|0] "" Vector__XXX
 SG_ VCFRONT_a388_maxCurrentReached m388 : 48|16@1- (0.005,0) [0|0] "" Vector__XXX
 SG_ VCFRONT_a401_IBSAmpHours m401 : 48|8@1+ (0.01,-2.55) [0|0] "" Vector__XXX
 SG_ VCFRONT_a404_maxCurrentReached m404 : 48|16@1- (0.005,0) [0|0] "" Vector__XXX
 SG_ VCFRONT_a405_avgIntervalCurrent m405 : 48|5@1+ (1,-31) [0|0] "" Vector__XXX
 SG_ VCFRONT_a410_IBSAmpHours m410 : 48|8@1+ (0.01,-2.55) [0|0] "" Vector__XXX
 SG_ VCFRONT_a411_IBSAmpHours m411 : 48|8@1+ (0.01,-2.55) [0|0] "" Vector__XXX
 SG_ VCFRONT_a412_avgPulseCurrentShif m412 : 48|7@1+ (1,-127) [0|0] "" Vector__XXX
 SG_ VCFRONT_a421_hcmlTxBufferHighWat m421 : 48|5@1+ (3.225806451612903,0) [0|0] "" Vector__XXX
 SG_ VCFRONT_a427_cacChangeBrickId m427 : 48|7@1+ (1,1) [0|0] "" Vector__XXX
 SG_ VCFRONT_a430_hvjbCurrentLimit m430 : 48|16@1- (0.1,0) [0|0] "" Vector__XXX
 SG_ VCFRONT_a431_hvjbCurrentLimit m431 : 48|16@1- (0.1,0) [0|0] "" Vector__XXX
 SG_ VCFRONT_a433_bmbModuleIdValid m433 : 48|1@1+ (1,0) [0|0] "" Vector__XXX
 SG_ VCFRONT_a434_bmbModuleIdValid m434 : 48|1@1+ (1,0) [0|0] "" Vector__XXX
 SG_ VCFRONT_a435_hvjbCurrentLimit m435 : 48|16@1- (0.1,0) [0|0] "" Vector__XXX
 SG_ VCFRONT_a436_hvjbCurrentLimit m436 : 48|16@1- (0.1,0) [0|0] "" Vector__XXX
 SG_ VCFRONT_a442_brickChangeHystRati m442 : 48|10@1+ (0.001,0) [0|0] "" Vector__XXX
 SG_ VCFRONT_a444_spiPeriodicCheck m444 : 48|1@1+ (1,0) [0|0] "" Vector__XXX
 SG_ VCFRONT_a445_actualLSB m445 : 48|8@1+ (1,0) [0|0] "" Vector__XXX
 SG_ VCFRONT_a446_sensorIntermit_0003 m446 : 48|1@1+ (1,0) [0|0] "" Vector__XXX
 SG_ VCFRONT_a461_numBricksHighSocAhE m461 : 48|8@1+ (1,0) [0|0] "" Vector__XXX
 SG_ VCFRONT_a465_flaggedAtUnsteadySt m465 : 48|1@1+ (1,0) [0|0] "" Vector__XXX
 SG_ VCFRONT_a474_turnStatus m474 : 48|3@1+ (1,0) [0|0] "" Vector__XXX
 SG_ VCFRONT_a475_turnStatus m475 : 48|3@1+ (1,0) [0|0] "" Vector__XXX
 SG_ VCFRONT_a481_hardShortThresholdR m481 : 48|1@1+ (1,0) [0|0] "" Vector__XXX
 SG_ VCFRONT_a492_avgBrickSoc m492 : 48|8@1+ (0.5,0) [0|0] "" Vector__XXX
 SG_ VCFRONT_a493_maxBrickSoc m493 : 48|7@1+ (1,0) [0|0] "" Vector__XXX
 SG_ VCFRONT_a497_SumCellVoltage m497 : 48|8@1+ (0.1,0) [0|0] "" Vector__XXX
 SG_ VCFRONT_a509_serviceMode m509 : 48|1@1+ (1,0) [0|0] "" Vector__XXX
 SG_ VCFRONT_a511_hvState m511 : 48|3@1+ (1,0) [0|0] "" Vector__XXX
 SG_ VCFRONT_a512_overcurrentDirectio m512 : 48|2@1+ (1,0) [0|0] "" Vector__XXX
 SG_ VCFRONT_a513_packSOC m513 : 48|10@1+ (0.1,0) [0|0] "" Vector__XXX
 SG_ VCFRONT_a521_serviceMode m521 : 48|1@1+ (1,0) [0|0] "" Vector__XXX
 SG_ VCFRONT_a523_control3Byte2 m523 : 48|8@1+ (1,0) [0|0] "" Vector__XXX
 SG_ VCFRONT_a529_externalPowerSupply m529 : 48|1@1+ (1,0) [0|0] "" Vector__XXX
 SG_ VCFRONT_a530_vehicleState m530 : 48|2@1+ (1,0) [0|0] "" Vector__XXX
 SG_ VCFRONT_a542_ambientTempFiltered m542 : 48|8@1+ (0.5,-40) [0|0] "" Vector__XXX
 SG_ VCFRONT_a548_PCSTargetVoltage m548 : 48|8@1+ (0.1,0) [0|0] "" Vector__XXX
 SG_ VCFRONT_a556_disconnectedBa_0001 m556 : 48|8@1+ (0.0392156862745098,6) [0|0] "" Vector__XXX
 SG_ VCFRONT_a558_levelingOffsetPrior m558 : 48|8@1- (1,0) [0|0] "" Vector__XXX
 SG_ VCFRONT_a559_dcdcLVSupportStatus m559 : 48|2@1+ (1,0) [0|0] "" Vector__XXX
 SG_ VCFRONT_a564_levelingOffsetPrior m564 : 48|8@1- (1,0) [0|0] "" Vector__XXX
 SG_ VCFRONT_a579_leftHeadlightRemain m579 : 48|4@1+ (1,0) [0|0] "" Vector__XXX
 SG_ VCFRONT_a580_rightHeadlightRemai m580 : 48|4@1+ (1,0) [0|0] "" Vector__XXX
 SG_ VCFRONT_a588_vcleftCTerm m588 : 48|16@1- (50,0) [0|0] "" Vector__XXX
 SG_ VCFRONT_a589_vcleftMaxCount m589 : 48|5@1+ (1,0) [0|0] "" Vector__XXX
 SG_ VCFRONT_a590_vcrightCTerm m590 : 48|16@1- (50,0) [0|0] "" Vector__XXX
 SG_ VCFRONT_a591_vcrightMaxCount m591 : 48|5@1+ (1,0) [0|0] "" Vector__XXX
 SG_ VCFRONT_a592_vcleftCutoffCTerm m592 : 48|16@1- (50,0) [0|0] "" Vector__XXX
 SG_ VCFRONT_a593_vcleftCutoffMaxCoun m593 : 48|5@1+ (1,0) [0|0] "" Vector__XXX
 SG_ VCFRONT_a596_vcrightCutoffCTerm m596 : 48|16@1- (50,0) [0|0] "" Vector__XXX
 SG_ VCFRONT_a597_vcrightCutoffMaxCou m597 : 48|5@1+ (1,0) [0|0] "" Vector__XXX
 SG_ VCFRONT_a618_relativeHumidity m618 : 48|6@1+ (0.02,0) [0|0] "" Vector__XXX
 SG_ VCFRONT_a623_failurePcsEfuseOff m623 : 48|1@1+ (1,0) [0|0] "" Vector__XXX
 SG_ VCFRONT_a635_sleepShutdownComple m635 : 48|1@1+ (1,0) [0|0] "" Vector__XXX
 SG_ VCFRONT_a643_hcmrTxBufferHighWat m643 : 48|5@1+ (3.225806451612903,0) [0|0] "" Vector__XXX
 SG_ VCFRONT_a644_maxCycleCurrent m644 : 48|8@1- (0.0984251968503937,5.807086614173229) [0|0] "" Vector__XXX
 SG_ VCFRONT_a104_BDY_bodyControls m104 : 47|1@1+ (1,0) [0|0] "" Vector__XXX
 SG_ VCFRONT_a113_VEH_ambientLighting m113 : 47|1@1+ (1,0) [0|0] "" Vector__XXX
 SG_ VCFRONT_a120_VEH_motorStatus m120 : 47|1@1+ (1,0) [0|0] "" Vector__XXX
 SG_ VCFRONT_a171_serviceMode m171 : 47|1@1+ (1,0) [0|0] "" Vector__XXX
 SG_ VCFRONT_a182_chargedAmpHours m182 : 47|8@1+ (60,0) [0|0] "" Vector__XXX
 SG_ VCFRONT_a183_chargedAmpHours m183 : 47|8@1+ (60,0) [0|0] "" Vector__XXX
 SG_ VCFRONT_a188_chargeRequest m188 : 47|1@1+ (1,0) [0|0] "" Vector__XXX
 SG_ VCFRONT_a191_LVBMSVoltageTargetV m191 : 47|1@1+ (1,0) [0|0] "" Vector__XXX
 SG_ VCFRONT_a197_validityStatus m197 : 47|7@1+ (1,0) [0|0] "" Vector__XXX
 SG_ VCFRONT_a260_notEnoughPowerForSu m260 : 47|1@1+ (1,0) [0|0] "" Vector__XXX
 SG_ VCFRONT_a365_dcCharging m365 : 47|1@1+ (1,0) [0|0] "" Vector__XXX
 SG_ VCFRONT_a366_finishedSuccessfull m366 : 47|1@1+ (1,0) [0|0] "" Vector__XXX
 SG_ VCFRONT_a406_pulseCurrentVarianc m406 : 47|6@1+ (0.25,0) [0|0] "" Vector__XXX
 SG_ VCFRONT_a415_IBSAmpHours m415 : 47|7@1+ (0.02,-2.55) [0|0] "" Vector__XXX
 SG_ VCFRONT_a444_spiInit m444 : 47|1@1+ (1,0) [0|0] "" Vector__XXX
 SG_ VCFRONT_a446_sensorIntermit_0000 m446 : 47|1@1+ (1,0) [0|0] "" Vector__XXX
 SG_ VCFRONT_a465_flaggedAtSteadyStat m465 : 47|1@1+ (1,0) [0|0] "" Vector__XXX
 SG_ VCFRONT_a478_frunkOpen m478 : 47|1@1+ (1,0) [0|0] "" Vector__XXX
 SG_ VCFRONT_a481_stuckOnFailure m481 : 47|1@1+ (1,0) [0|0] "" Vector__XXX
 SG_ VCFRONT_a623_failureLvBatte_0001 m623 : 47|1@1+ (1,0) [0|0] "" Vector__XXX
 SG_ VCFRONT_a104_VEH_redundantBrakin m104 : 46|1@1+ (1,0) [0|0] "" Vector__XXX
 SG_ VCFRONT_a113_VEH_autopilotContro m113 : 46|1@1+ (1,0) [0|0] "" Vector__XXX
 SG_ VCFRONT_a120_PARTY_motorStatus m120 : 46|1@1+ (1,0) [0|0] "" Vector__XXX
 SG_ VCFRONT_a171_DPBCAL m171 : 46|1@1+ (1,0) [0|0] "" Vector__XXX
 SG_ VCFRONT_a191_LVBMSCurrentTargetV m191 : 46|1@1+ (1,0) [0|0] "" Vector__XXX
 SG_ VCFRONT_a260_HV_UP m260 : 46|1@1+ (1,0) [0|0] "" Vector__XXX
 SG_ VCFRONT_a365_updateInProgress m365 : 46|1@1+ (1,0) [0|0] "" Vector__XXX
 SG_ VCFRONT_a366_dcCharging m366 : 46|1@1+ (1,0) [0|0] "" Vector__XXX
 SG_ VCFRONT_a407_pulseCurrentVarianc m407 : 46|6@1+ (0.25,0) [0|0] "" Vector__XXX
 SG_ VCFRONT_a408_IBSTemp m408 : 46|7@1+ (1,-40) [0|0] "" Vector__XXX
 SG_ VCFRONT_a416_socMin m416 : 46|8@1+ (0.5,0) [0|0] "" Vector__XXX
 SG_ VCFRONT_a417_socMax m417 : 46|8@1+ (0.5,0) [0|0] "" Vector__XXX
 SG_ VCFRONT_a418_socMax m418 : 46|8@1+ (0.5,0) [0|0] "" Vector__XXX
 SG_ VCFRONT_a419_socMin m419 : 46|8@1+ (0.5,0) [0|0] "" Vector__XXX
 SG_ VCFRONT_a423_socMin m423 : 46|8@1+ (0.5,0) [0|0] "" Vector__XXX
 SG_ VCFRONT_a424_socMin m424 : 46|8@1+ (0.5,0) [0|0] "" Vector__XXX
 SG_ VCFRONT_a444_lowSide1OverCurent m444 : 46|1@1+ (1,0) [0|0] "" Vector__XXX
 SG_ VCFRONT_a446_sensorIntermittentP m446 : 46|1@1+ (1,0) [0|0] "" Vector__XXX
 SG_ VCFRONT_a478_hvcEFuseStable m478 : 46|1@1+ (1,0) [0|0] "" Vector__XXX
 SG_ VCFRONT_a481_stuckOnFinished m481 : 46|1@1+ (1,0) [0|0] "" Vector__XXX
 SG_ VCFRONT_a503_socMax m503 : 46|8@1+ (0.5,0) [0|0] "" Vector__XXX
 SG_ VCFRONT_a527_cell4Voltage m527 : 46|10@1+ (0.01,0) [0|0] "" Vector__XXX
 SG_ VCFRONT_a548_frunkOpen m548 : 46|1@1+ (1,0) [0|0] "" Vector__XXX
 SG_ VCFRONT_a555_cell4Voltage m555 : 46|10@1+ (0.01,0) [0|0] "" Vector__XXX
 SG_ VCFRONT_a561_cell3Voltage m561 : 46|7@1+ (0.04,0) [0|0] "" Vector__XXX
 SG_ VCFRONT_a562_cell3Voltage m562 : 46|7@1+ (0.04,0) [0|0] "" Vector__XXX
 SG_ VCFRONT_a582_frunkOpen m582 : 46|1@1+ (1,0) [0|0] "" Vector__XXX
 SG_ VCFRONT_a584_firstFaultedSwitch m584 : 46|3@1+ (1,0) [0|0] "" Vector__XXX
 SG_ VCFRONT_a611_compressorPower m611 : 46|6@1+ (200,0) [0|0] "" Vector__XXX
 SG_ VCFRONT_a623_failureLvBatteryCon m623 : 46|1@1+ (1,0) [0|0] "" Vector__XXX
 SG_ VCFRONT_a626_pulseCurrentVarianc m626 : 46|6@1+ (0.25,0) [0|0] "" Vector__XXX
 SG_ VCFRONT_a634_ajar2ClosingDeltaV m634 : 46|10@1- (0.01,0) [0|0] "" Vector__XXX
 SG_ VCFRONT_a104_VEH_control m104 : 45|1@1+ (1,0) [0|0] "" Vector__XXX
 SG_ VCFRONT_a113_VEH_status2 m113 : 45|1@1+ (1,0) [0|0] "" Vector__XXX
 SG_ VCFRONT_a120_VEH_vehicleEstimate m120 : 45|1@1+ (1,0) [0|0] "" Vector__XXX
 SG_ VCFRONT_a171_DPB m171 : 45|1@1+ (1,0) [0|0] "" Vector__XXX
 SG_ VCFRONT_a178_ambientTempFiltered m178 : 45|8@1+ (0.5,-40) [0|0] "" Vector__XXX
 SG_ VCFRONT_a366_updateInProgress m366 : 45|1@1+ (1,0) [0|0] "" Vector__XXX
 SG_ VCFRONT_a403_IBSTemp m403 : 45|7@1+ (1,-40) [0|0] "" Vector__XXX
 SG_ VCFRONT_a444_highSide1OverCurent m444 : 45|1@1+ (1,0) [0|0] "" Vector__XXX
 SG_ VCFRONT_a446_sensorIntermit_0001 m446 : 45|1@1+ (1,0) [0|0] "" Vector__XXX
 SG_ VCFRONT_a478_contactorEFuseStabl m478 : 45|1@1+ (1,0) [0|0] "" Vector__XXX
 SG_ VCFRONT_a541_AverageCurrent m541 : 45|10@1+ (0.05,0) [0|0] "" Vector__XXX
 SG_ VCFRONT_a548_serviceMode m548 : 45|1@1+ (1,0) [0|0] "" Vector__XXX
 SG_ VCFRONT_a582_inFactoryMode m582 : 45|1@1+ (1,0) [0|0] "" Vector__XXX
 SG_ VCFRONT_a623_failureLvBatterySen m623 : 45|1@1+ (1,0) [0|0] "" Vector__XXX
 SG_ VCFRONT_a104_VEH_wirelessChargin m104 : 44|1@1+ (1,0) [0|0] "" Vector__XXX
 SG_ VCFRONT_a113_VEH_gpsVehicleSpeed m113 : 44|1@1+ (1,0) [0|0] "" Vector__XXX
 SG_ VCFRONT_a118_PARTY_VCFRONT_camer m118 : 44|1@1+ (1,0) [0|0] "" Vector__XXX
 SG_ VCFRONT_a120_VEH_prndControl m120 : 44|1@1+ (1,0) [0|0] "" Vector__XXX
 SG_ VCFRONT_a171_RCUCAL m171 : 44|1@1+ (1,0) [0|0] "" Vector__XXX
 SG_ VCFRONT_a184_evapOutTemp m184 : 44|5@1+ (1,0) [0|0] "" Vector__XXX
 SG_ VCFRONT_a190_maxResponseTime m190 : 44|8@1+ (0.1,0) [0|0] "" Vector__XXX
 SG_ VCFRONT_a191_ECPAState m191 : 44|2@1+ (1,0) [0|0] "" Vector__XXX
 SG_ VCFRONT_a258_maxCurrentReached m258 : 44|16@1- (0.005,0) [0|0] "" Vector__XXX
 SG_ VCFRONT_a365_chgNoFlowTetherStat m365 : 44|2@1+ (1,0) [0|0] "" Vector__XXX
 SG_ VCFRONT_a444_lowSide2OverCurent m444 : 44|1@1+ (1,0) [0|0] "" Vector__XXX
 SG_ VCFRONT_a446_sensorHasOffsetTl m446 : 44|1@1+ (1,0) [0|0] "" Vector__XXX
 SG_ VCFRONT_a478_vcrightEFuseStable m478 : 44|1@1+ (1,0) [0|0] "" Vector__XXX
 SG_ VCFRONT_a498_targetVoltage m498 : 44|10@1+ (0.05,0) [0|0] "" Vector__XXX
 SG_ VCFRONT_a514_packVoltage m514 : 44|8@1+ (0.1,0) [0|0] "" Vector__XXX
 SG_ VCFRONT_a515_packVoltage m515 : 44|8@1+ (0.1,0) [0|0] "" Vector__XXX
 SG_ VCFRONT_a559_bmsState m559 : 44|4@1+ (1,0) [0|0] "" Vector__XXX
 SG_ VCFRONT_a584_switch2StuckReason m584 : 44|2@1+ (1,0) [0|0] "" Vector__XXX
 SG_ VCFRONT_a608_setFromNvm m608 : 44|1@1+ (1,0) [0|0] "" Vector__XXX
 SG_ VCFRONT_a623_failureLvBatteryCom m623 : 44|1@1+ (1,0) [0|0] "" Vector__XXX
 SG_ VCFRONT_a663_hcmlGroupsHigh_0001 m663 : 44|5@1+ (3.225806451612903,0) [0|0] "" Vector__XXX
 SG_ VCFRONT_a664_hcmrGroupsHigh_0001 m664 : 44|5@1+ (3.225806451612903,0) [0|0] "" Vector__XXX
 SG_ VCFRONT_a669_minPackSOC m669 : 44|9@1+ (0.2,0) [0|0] "" Vector__XXX
 SG_ VCFRONT_a063_faulted m63 : 43|1@1+ (1,0) [0|0] "" Vector__XXX
 SG_ VCFRONT_a104_BDY_autonomyControl m104 : 43|1@1+ (1,0) [0|0] "" Vector__XXX
 SG_ VCFRONT_a113_VEH_gpsTime m113 : 43|1@1+ (1,0) [0|0] "" Vector__XXX
 SG_ VCFRONT_a118_BDY_AP_vehicleState m118 : 43|1@1+ (1,0) [0|0] "" Vector__XXX
 SG_ VCFRONT_a120_VEH_locStatus2 m120 : 43|1@1+ (1,0) [0|0] "" Vector__XXX
 SG_ VCFRONT_a162_ccRightExvFlow m162 : 43|7@1+ (1,0) [0|0] "" Vector__XXX
 SG_ VCFRONT_a171_RCU m171 : 43|1@1+ (1,0) [0|0] "" Vector__XXX
 SG_ VCFRONT_a187_ethBusRetryCount m187 : 43|9@1+ (1,0) [0|0] "" Vector__XXX
 SG_ VCFRONT_a257_vehicleState m257 : 43|5@1+ (1,0) [0|0] "" Vector__XXX
 SG_ VCFRONT_a366_chgNoFlowTetherStat m366 : 43|2@1+ (1,0) [0|0] "" Vector__XXX
 SG_ VCFRONT_a414_IBSVoltage m414 : 43|11@1+ (0.01088735219,0) [0|0] "" Vector__XXX
 SG_ VCFRONT_a444_highSide2OverCurent m444 : 43|1@1+ (1,0) [0|0] "" Vector__XXX
 SG_ VCFRONT_a446_sensorDroopPd m446 : 43|1@1+ (1,0) [0|0] "" Vector__XXX
 SG_ VCFRONT_a474_drl3Status m474 : 43|3@1+ (1,0) [0|0] "" Vector__XXX
 SG_ VCFRONT_a475_drl3Status m475 : 43|3@1+ (1,0) [0|0] "" Vector__XXX
 SG_ VCFRONT_a477_cell4Voltage m477 : 43|9@1+ (0.01,0) [0|0] "" Vector__XXX
 SG_ VCFRONT_a478_pcsEFuseStable m478 : 43|1@1+ (1,0) [0|0] "" Vector__XXX
 SG_ VCFRONT_a606_ccQdotTotalAtExit m606 : 43|6@1+ (111.11111111111111,0) [0|0] "" Vector__XXX
 SG_ VCFRONT_a623_failureLvbmbEfuseOp m623 : 43|1@1+ (1,0) [0|0] "" Vector__XXX
 SG_ VCFRONT_a627_cell4Voltage m627 : 43|9@1+ (0.01,0) [0|0] "" Vector__XXX
 SG_ VCFRONT_a063_stuckActive m63 : 42|1@1+ (1,0) [0|0] "" Vector__XXX
 SG_ VCFRONT_a104_CH_autonomyControl m104 : 42|1@1+ (1,0) [0|0] "" Vector__XXX
 SG_ VCFRONT_a113_VEH_locationStatus m113 : 42|1@1+ (1,0) [0|0] "" Vector__XXX
 SG_ VCFRONT_a118_PARTY_AP_vehicleSta m118 : 42|1@1+ (1,0) [0|0] "" Vector__XXX
 SG_ VCFRONT_a120_VEH_locStatus m120 : 42|1@1+ (1,0) [0|0] "" Vector__XXX
 SG_ VCFRONT_a171_IDBCAL m171 : 42|1@1+ (1,0) [0|0] "" Vector__XXX
 SG_ VCFRONT_a257_revBattFault m257 : 42|1@1+ (1,0) [0|0] "" Vector__XXX
 SG_ VCFRONT_a260_batterySMState m260 : 42|4@1+ (1,0) [0|0] "" Vector__XXX
 SG_ VCFRONT_a352_startTime m352 : 42|10@1+ (10,0) [0|0] "" Vector__XXX
 SG_ VCFRONT_a359_batterySMState m359 : 42|4@1+ (1,0) [0|0] "" Vector__XXX
 SG_ VCFRONT_a370_sleepCurrent m370 : 42|10@1+ (0.1,0) [0|0] "" Vector__XXX
 SG_ VCFRONT_a391_switch2VoltageAvera m391 : 42|10@1+ (5,0) [0|0] "" Vector__XXX
 SG_ VCFRONT_a444_lowSide1GateDriver m444 : 42|1@1+ (1,0) [0|0] "" Vector__XXX
 SG_ VCFRONT_a446_sensorHasOffsetPd m446 : 42|1@1+ (1,0) [0|0] "" Vector__XXX
 SG_ VCFRONT_a463_switch2VoltageAvera m463 : 42|10@1+ (5,0) [0|0] "" Vector__XXX
 SG_ VCFRONT_a478_HV_UP m478 : 42|1@1+ (1,0) [0|0] "" Vector__XXX
 SG_ VCFRONT_a480_enable m480 : 42|1@1+ (1,0) [0|0] "" Vector__XXX
 SG_ VCFRONT_a484_currentVehiclePitch m484 : 42|10@1- (0.0001,0) [0|0] "" Vector__XXX
 SG_ VCFRONT_a582_batteryType m582 : 42|3@1+ (1,0) [0|0] "" Vector__XXX
 SG_ VCFRONT_a584_switch1StuckReason m584 : 42|2@1+ (1,0) [0|0] "" Vector__XXX
 SG_ VCFRONT_a623_failureReverseBatte m623 : 42|1@1+ (1,0) [0|0] "" Vector__XXX
 SG_ VCFRONT_a645_totalWashDuration m645 : 42|10@1+ (9.775171065493646,0) [0|0] "" Vector__XXX
 SG_ VCFRONT_a667_isRightHandDrive m667 : 42|1@1+ (1,0) [0|0] "" Vector__XXX
 SG_ VCFRONT_a668_isRightHandDrive m668 : 42|1@1+ (1,0) [0|0] "" Vector__XXX
 SG_ VCFRONT_a063_indeterminate m63 : 41|1@1+ (1,0) [0|0] "" Vector__XXX
 SG_ VCFRONT_a104_VEH_autonomyControl m104 : 41|1@1+ (1,0) [0|0] "" Vector__XXX
 SG_ VCFRONT_a113_CH_odo m113 : 41|1@1+ (1,0) [0|0] "" Vector__XXX
 SG_ VCFRONT_a118_BDY_vehicleTime m118 : 41|1@1+ (1,0) [0|0] "" Vector__XXX
 SG_ VCFRONT_a120_CH_locStatus2 m120 : 41|1@1+ (1,0) [0|0] "" Vector__XXX
 SG_ VCFRONT_a171_IDB1 m171 : 41|1@1+ (1,0) [0|0] "" Vector__XXX
 SG_ VCFRONT_a188_timeNotSleeping m188 : 41|6@1+ (1,0) [0|0] "" Vector__XXX
 SG_ VCFRONT_a220_frunkOpen m220 : 41|1@1+ (1,0) [0|0] "" Vector__XXX
 SG_ VCFRONT_a257_epas3sFault m257 : 41|1@1+ (1,0) [0|0] "" Vector__XXX
 SG_ VCFRONT_a365_userChargeStatus m365 : 41|3@1+ (1,0) [0|0] "" Vector__XXX
 SG_ VCFRONT_a370_serviceMode m370 : 41|1@1+ (1,0) [0|0] "" Vector__XXX
 SG_ VCFRONT_a444_highSide1GateDriver m444 : 41|1@1+ (1,0) [0|0] "" Vector__XXX
 SG_ VCFRONT_a446_sensorHasOffsetTd m446 : 41|1@1+ (1,0) [0|0] "" Vector__XXX
 SG_ VCFRONT_a478_HVBlockingMismatch m478 : 41|1@1+ (1,0) [0|0] "" Vector__XXX
 SG_ VCFRONT_a480_hwlo m480 : 41|1@1+ (1,0) [0|0] "" Vector__XXX
 SG_ VCFRONT_a498_testAbortReason m498 : 41|3@1+ (1,0) [0|0] "" Vector__XXX
 SG_ VCFRONT_a510_frunkOpen m510 : 41|1@1+ (1,0) [0|0] "" Vector__XXX
 SG_ VCFRONT_a518_outputVoltageAtPCS m518 : 41|8@1+ (0.1,0) [0|0] "" Vector__XXX
 SG_ VCFRONT_a594_fusionSessionCalibr m594 : 41|9@1- (0.0005,0) [0|0] "" Vector__XXX
 SG_ VCFRONT_a611_coolantFlow m611 : 41|5@1+ (1,0) [0|0] "" Vector__XXX
 SG_ VCFRONT_a623_failureLvBatteryEne m623 : 41|1@1+ (1,0) [0|0] "" Vector__XXX
 SG_ VCFRONT_a645_fluidLevelSensorFil m645 : 41|1@1+ (1,0) [0|0] "" Vector__XXX
 SG_ VCFRONT_a009_PlAtExit m9 : 40|5@1+ (1,0) [0|0] "" Vector__XXX
 SG_ VCFRONT_a022_TaskInitError2 m22 : 40|8@1+ (1,0) [0|0] "" Vector__XXX
 SG_ VCFRONT_a031_uds_bytes_3 m31 : 40|8@1+ (1,0) [0|0] "" Vector__XXX
 SG_ VCFRONT_a038_faultSource m38 : 40|7@1+ (1,0) [0|0] "" Vector__XXX
 SG_ VCFRONT_a041_CPULoad100msTask m41 : 40|8@1+ (1,0) [0|0] "" Vector__XXX
 SG_ VCFRONT_a042_Usage1000msTask m42 : 40|8@1+ (1,0) [0|0] "" Vector__XXX
 SG_ VCFRONT_a043_CallTrace1 m43 : 40|24@1+ (1,0) [0|0] "" Vector__XXX
 SG_ VCFRONT_a044_CallTrace1 m44 : 40|24@1+ (1,0) [0|0] "" Vector__XXX
 SG_ VCFRONT_a045_CallTrace1 m45 : 40|24@1+ (1,0) [0|0] "" Vector__XXX
 SG_ VCFRONT_a046_CallTrace1 m46 : 40|24@1+ (1,0) [0|0] "" Vector__XXX
 SG_ VCFRONT_a047_CsvHf m47 : 40|16@1+ (1,0) [0|0] "" Vector__XXX
 SG_ VCFRONT_a059_current m59 : 40|12@1+ (0.05,0) [0|0] "" Vector__XXX
 SG_ VCFRONT_a063_disconnected m63 : 40|1@1+ (1,0) [0|0] "" Vector__XXX
 SG_ VCFRONT_a104_PARTY_autonomyContr m104 : 40|1@1+ (1,0) [0|0] "" Vector__XXX
 SG_ VCFRONT_a113_VEH_vehicleControlT m113 : 40|1@1+ (1,0) [0|0] "" Vector__XXX
 SG_ VCFRONT_a118_BDY_outputPowerStat m118 : 40|1@1+ (1,0) [0|0] "" Vector__XXX
 SG_ VCFRONT_a120_VEH_chassisCntl m120 : 40|1@1+ (1,0) [0|0] "" Vector__XXX
 SG_ VCFRONT_a154_lastSilentWakeIBSAm m154 : 40|6@1+ (0.05,-3) [0|0] "" Vector__XXX
 SG_ VCFRONT_a171_IDB m171 : 40|1@1+ (1,0) [0|0] "" Vector__XXX
 SG_ VCFRONT_a180_dcdcLVSupportStatus m180 : 40|2@1+ (1,0) [0|0] "" Vector__XXX
 SG_ VCFRONT_a184_humidityRatio m184 : 40|4@1+ (4,0) [0|0] "" Vector__XXX
 SG_ VCFRONT_a192_IBSCurrent m192 : 40|8@1+ (0.5,-63) [0|0] "" Vector__XXX
 SG_ VCFRONT_a196_disconnectedBa_0000 m196 : 40|8@1+ (0.0392156862745098,6) [0|0] "" Vector__XXX
 SG_ VCFRONT_a220_serviceMode m220 : 40|1@1+ (1,0) [0|0] "" Vector__XXX
 SG_ VCFRONT_a228_measurementInterval m228 : 40|8@1+ (1,0) [0|0] "" Vector__XXX
 SG_ VCFRONT_a229_measurementInterval m229 : 40|8@1+ (1,0) [0|0] "" Vector__XXX
 SG_ VCFRONT_a230_measurementInterval m230 : 40|8@1+ (1,0) [0|0] "" Vector__XXX
 SG_ VCFRONT_a248_vbatMonitor m248 : 40|12@1+ (0.005443676098,0) [0|0] "" Vector__XXX
 SG_ VCFRONT_a250_calibratedHorizonta m250 : 40|10@1+ (1,0) [0|0] "" Vector__XXX
 SG_ VCFRONT_a257_epas3pFault m257 : 40|1@1+ (1,0) [0|0] "" Vector__XXX
 SG_ VCFRONT_a260_vehiclePowerState m260 : 40|2@1+ (1,0) [0|0] "" Vector__XXX
 SG_ VCFRONT_a283_thmlFanPhaseI m283 : 40|7@1+ (0.25,0) [0|0] "" Vector__XXX
 SG_ VCFRONT_a310_avgTemp m310 : 40|11@1+ (0.125,-40) [0|0] "" Vector__XXX
 SG_ VCFRONT_a311_avgTemp m311 : 40|11@1+ (0.125,-40) [0|0] "" Vector__XXX
 SG_ VCFRONT_a312_avgTemp m312 : 40|11@1+ (0.125,-40) [0|0] "" Vector__XXX
 SG_ VCFRONT_a313_avgTemp m313 : 40|11@1+ (0.125,-40) [0|0] "" Vector__XXX
 SG_ VCFRONT_a314_avgTemp m314 : 40|11@1+ (0.125,-40) [0|0] "" Vector__XXX
 SG_ VCFRONT_a315_avgTemp m315 : 40|11@1+ (0.125,-40) [0|0] "" Vector__XXX
 SG_ VCFRONT_a316_avgTemp m316 : 40|11@1+ (0.125,-40) [0|0] "" Vector__XXX
 SG_ VCFRONT_a317_avgTemp m317 : 40|11@1+ (0.125,-40) [0|0] "" Vector__XXX
 SG_ VCFRONT_a318_avgTemp m318 : 40|11@1+ (0.125,-40) [0|0] "" Vector__XXX
 SG_ VCFRONT_a319_avgTemp m319 : 40|11@1+ (0.125,-40) [0|0] "" Vector__XXX
 SG_ VCFRONT_a320_avgTemp m320 : 40|11@1+ (0.125,-40) [0|0] "" Vector__XXX
 SG_ VCFRONT_a321_avgTemp m321 : 40|11@1+ (0.125,-40) [0|0] "" Vector__XXX
 SG_ VCFRONT_a322_avgTemp m322 : 40|11@1+ (0.125,-40) [0|0] "" Vector__XXX
 SG_ VCFRONT_a323_avgTemp m323 : 40|11@1+ (0.125,-40) [0|0] "" Vector__XXX
 SG_ VCFRONT_a324_avgTemp m324 : 40|11@1+ (0.125,-40) [0|0] "" Vector__XXX
 SG_ VCFRONT_a325_avgTemp m325 : 40|11@1+ (0.125,-40) [0|0] "" Vector__XXX
 SG_ VCFRONT_a334_maxCurrent m334 : 40|12@1+ (0.1,0) [0|0] "" Vector__XXX
 SG_ VCFRONT_a335_maxCurrent m335 : 40|12@1+ (0.1,0) [0|0] "" Vector__XXX
 SG_ VCFRONT_a336_maxCurrent m336 : 40|12@1+ (0.1,0) [0|0] "" Vector__XXX
 SG_ VCFRONT_a337_maxCurrent m337 : 40|12@1+ (0.1,0) [0|0] "" Vector__XXX
 SG_ VCFRONT_a338_maxCurrent m338 : 40|12@1+ (0.1,0) [0|0] "" Vector__XXX
 SG_ VCFRONT_a339_maxCurrent m339 : 40|12@1+ (0.1,0) [0|0] "" Vector__XXX
 SG_ VCFRONT_a340_maxCurrent m340 : 40|12@1+ (0.1,0) [0|0] "" Vector__XXX
 SG_ VCFRONT_a341_maxCurrent m341 : 40|12@1+ (0.1,0) [0|0] "" Vector__XXX
 SG_ VCFRONT_a342_maxCurrent m342 : 40|12@1+ (0.1,0) [0|0] "" Vector__XXX
 SG_ VCFRONT_a343_maxCurrent m343 : 40|12@1+ (0.1,0) [0|0] "" Vector__XXX
 SG_ VCFRONT_a344_maxCurrent m344 : 40|12@1+ (0.1,0) [0|0] "" Vector__XXX
 SG_ VCFRONT_a345_maxCurrent m345 : 40|12@1+ (0.1,0) [0|0] "" Vector__XXX
 SG_ VCFRONT_a346_maxCurrent m346 : 40|12@1+ (0.1,0) [0|0] "" Vector__XXX
 SG_ VCFRONT_a347_maxCurrent m347 : 40|12@1+ (0.1,0) [0|0] "" Vector__XXX
 SG_ VCFRONT_a348_maxCurrent m348 : 40|12@1+ (0.1,0) [0|0] "" Vector__XXX
 SG_ VCFRONT_a349_maxCurrent m349 : 40|12@1+ (0.1,0) [0|0] "" Vector__XXX
 SG_ VCFRONT_a359_vehiclePowerState m359 : 40|2@1+ (1,0) [0|0] "" Vector__XXX
 SG_ VCFRONT_a365_LowCoolant m365 : 40|1@1+ (1,0) [0|0] "" Vector__XXX
 SG_ VCFRONT_a366_userChargeStatus m366 : 40|3@1+ (1,0) [0|0] "" Vector__XXX
 SG_ VCFRONT_a368_belowSocMin m368 : 40|1@1+ (1,0) [0|0] "" Vector__XXX
 SG_ VCFRONT_a370_notEnoughPowerForSu m370 : 40|1@1+ (1,0) [0|0] "" Vector__XXX
 SG_ VCFRONT_a373_compDemandChiller m373 : 40|7@1+ (1,0) [0|0] "" Vector__XXX
 SG_ VCFRONT_a389_latchStatus m389 : 40|4@1+ (1,0) [0|0] "" Vector__XXX
 SG_ VCFRONT_a405_intervalCompareV m405 : 40|8@1+ (0.02,9) [0|0] "" Vector__XXX
 SG_ VCFRONT_a406_avgPulseCurrent m406 : 40|7@1+ (1,-127) [0|0] "" Vector__XXX
 SG_ VCFRONT_a412_pulseCompareVShifte m412 : 40|8@1+ (0.02,9) [0|0] "" Vector__XXX
 SG_ VCFRONT_a428_avgBrickCac m428 : 40|13@1+ (0.1,0) [0|0] "" Vector__XXX
 SG_ VCFRONT_a429_usableEnergy m429 : 40|10@1+ (0.2,-0.2) [0|0] "" Vector__XXX
 SG_ VCFRONT_a433_cellTypeData m433 : 40|8@1+ (1,0) [0|0] "" Vector__XXX
 SG_ VCFRONT_a434_cellTypeData m434 : 40|8@1+ (1,0) [0|0] "" Vector__XXX
 SG_ VCFRONT_a442_numBricksChanged m442 : 40|8@1+ (1,0) [0|0] "" Vector__XXX
 SG_ VCFRONT_a444_lowSide2GateDriver m444 : 40|1@1+ (1,0) [0|0] "" Vector__XXX
 SG_ VCFRONT_a445_actualMSB m445 : 40|8@1+ (1,0) [0|0] "" Vector__XXX
 SG_ VCFRONT_a446_usingModeledTl m446 : 40|1@1+ (1,0) [0|0] "" Vector__XXX
 SG_ VCFRONT_a461_maxSocAhErrorBrickI m461 : 40|7@1+ (1,1) [0|0] "" Vector__XXX
 SG_ VCFRONT_a462_frunkOpen m462 : 40|1@1+ (1,0) [0|0] "" Vector__XXX
 SG_ VCFRONT_a464_subcoolFiltered m464 : 40|7@1+ (0.4,-10) [0|0] "" Vector__XXX
 SG_ VCFRONT_a465_subcoolFiltered m465 : 40|7@1+ (0.4,-10) [0|0] "" Vector__XXX
 SG_ VCFRONT_a466_subcoolFiltered m466 : 40|7@1+ (0.4,-10) [0|0] "" Vector__XXX
 SG_ VCFRONT_a472_headlampTemperature m472 : 40|8@1+ (0.5,-40) [0|0] "" Vector__XXX
 SG_ VCFRONT_a473_headlampTemperature m473 : 40|8@1+ (0.5,-40) [0|0] "" Vector__XXX
 SG_ VCFRONT_a474_drl2Status m474 : 40|3@1+ (1,0) [0|0] "" Vector__XXX
 SG_ VCFRONT_a475_drl2Status m475 : 40|3@1+ (1,0) [0|0] "" Vector__XXX
 SG_ VCFRONT_a478_PCS_MIA m478 : 40|1@1+ (1,0) [0|0] "" Vector__XXX
 SG_ VCFRONT_a480_hitAlertRateLimit m480 : 40|1@1+ (1,0) [0|0] "" Vector__XXX
 SG_ VCFRONT_a482_desiredPositionRela m482 : 40|16@1- (1,0) [0|0] "" Vector__XXX
 SG_ VCFRONT_a485_desiredPositionRela m485 : 40|16@1- (1,0) [0|0] "" Vector__XXX
 SG_ VCFRONT_a492_maxBrickSoc m492 : 40|8@1+ (0.5,0) [0|0] "" Vector__XXX
 SG_ VCFRONT_a493_maxBrickSocByOcvMin m493 : 40|8@1+ (0.5,0) [0|0] "" Vector__XXX
 SG_ VCFRONT_a502_worstBrickV m502 : 40|12@1+ (0.002,0) [0|0] "" Vector__XXX
 SG_ VCFRONT_a508_brickImpedanceId m508 : 40|5@1+ (1,1) [0|0] "" Vector__XXX
 SG_ VCFRONT_a509_ambientTemp m509 : 40|8@1+ (0.5,-40) [0|0] "" Vector__XXX
 SG_ VCFRONT_a510_serviceMode m510 : 40|1@1+ (1,0) [0|0] "" Vector__XXX
 SG_ VCFRONT_a512_sumCellVoltage m512 : 40|8@1+ (0.1,0) [0|0] "" Vector__XXX
 SG_ VCFRONT_a513_packVoltage m513 : 40|8@1+ (0.1,0) [0|0] "" Vector__XXX
 SG_ VCFRONT_a521_ambientTemp m521 : 40|8@1+ (0.5,-40) [0|0] "" Vector__XXX
 SG_ VCFRONT_a523_control2Byte3 m523 : 40|8@1+ (1,0) [0|0] "" Vector__XXX
 SG_ VCFRONT_a534_measuredCloseRange m534 : 40|8@1+ (7,0) [0|0] "" Vector__XXX
 SG_ VCFRONT_a535_measuredCloseRange m535 : 40|8@1+ (7,0) [0|0] "" Vector__XXX
 SG_ VCFRONT_a536_measuredCloseRange m536 : 40|8@1+ (7,0) [0|0] "" Vector__XXX
 SG_ VCFRONT_a537_measuredCloseRange m537 : 40|8@1+ (7,0) [0|0] "" Vector__XXX
 SG_ VCFRONT_a538_measuredCloseRange m538 : 40|8@1+ (7,0) [0|0] "" Vector__XXX
 SG_ VCFRONT_a539_measuredCloseRange m539 : 40|8@1+ (7,0) [0|0] "" Vector__XXX
 SG_ VCFRONT_a542_ambientTempRaw m542 : 40|8@1+ (0.5,-40) [0|0] "" Vector__XXX
 SG_ VCFRONT_a548_LVBMSSOC m548 : 40|5@1+ (3,0) [0|0] "" Vector__XXX
 SG_ VCFRONT_a556_disconnectedBa_0000 m556 : 40|8@1+ (0.0392156862745098,6) [0|0] "" Vector__XXX
 SG_ VCFRONT_a559_batterySMState m559 : 40|4@1+ (1,0) [0|0] "" Vector__XXX
 SG_ VCFRONT_a582_LVBusVoltageSource m582 : 40|2@1+ (1,0) [0|0] "" Vector__XXX
 SG_ VCFRONT_a587_IBSCurrent m587 : 40|12@1- (0.1,0) [0|0] "" Vector__XXX
 SG_ VCFRONT_a588_vcleftBTerm m588 : 40|8@1- (1,-78) [0|0] "" Vector__XXX
 SG_ VCFRONT_a590_vcrightBTerm m590 : 40|8@1- (1,-78) [0|0] "" Vector__XXX
 SG_ VCFRONT_a592_vcleftCutoffBTerm m592 : 40|8@1- (1,-78) [0|0] "" Vector__XXX
 SG_ VCFRONT_a596_vcrightCutoffBTerm m596 : 40|8@1- (1,-78) [0|0] "" Vector__XXX
 SG_ VCFRONT_a600_IBSCurrent m600 : 40|12@1- (0.1,0) [0|0] "" Vector__XXX
 SG_ VCFRONT_a608_retryCount m608 : 40|4@1+ (1,0) [0|0] "" Vector__XXX
 SG_ VCFRONT_a618_ptInletTemp m618 : 40|6@1+ (2,0) [0|0] "" Vector__XXX
 SG_ VCFRONT_a623_failureLvBatte_0002 m623 : 40|1@1+ (1,0) [0|0] "" Vector__XXX
 SG_ VCFRONT_a644_minCycleCurrent m644 : 40|8@1- (0.0984251968503937,5.807086614173229) [0|0] "" Vector__XXX
 SG_ VCFRONT_a645_fluidLevelSensorRaw m645 : 40|1@1+ (1,0) [0|0] "" Vector__XXX
 SG_ VCFRONT_a646_timeSinceLastValidW m646 : 40|14@1+ (1,0) [0|0] "" Vector__XXX
 SG_ VCFRONT_a667_homologationRegionO m667 : 40|2@1+ (1,0) [0|0] "" Vector__XXX
 SG_ VCFRONT_a668_homologationRegionO m668 : 40|2@1+ (1,0) [0|0] "" Vector__XXX
 SG_ VCFRONT_a058_prevREstimate m58 : 39|12@1+ (0.00061,0) [0|0] "" Vector__XXX
 SG_ VCFRONT_a104_BDY_status m104 : 39|1@1+ (1,0) [0|0] "" Vector__XXX
 SG_ VCFRONT_a113_VEH_vehicleControl3 m113 : 39|1@1+ (1,0) [0|0] "" Vector__XXX
 SG_ VCFRONT_a117_PARTY_lightingSecon m117 : 39|1@1+ (1,0) [0|0] "" Vector__XXX
 SG_ VCFRONT_a118_CH_alertMatrix m118 : 39|1@1+ (1,0) [0|0] "" Vector__XXX
 SG_ VCFRONT_a120_PARTY_locStatus2 m120 : 39|1@1+ (1,0) [0|0] "" Vector__XXX
 SG_ VCFRONT_a171_LVBMS m171 : 39|1@1+ (1,0) [0|0] "" Vector__XXX
 SG_ VCFRONT_a178_inverterTemp m178 : 39|6@1+ (3,-40) [0|0] "" Vector__XXX
 SG_ VCFRONT_a180_frunkOpen m180 : 39|1@1+ (1,0) [0|0] "" Vector__XXX
 SG_ VCFRONT_a182_dischargedAmpHours m182 : 39|8@1+ (60,0) [0|0] "" Vector__XXX
 SG_ VCFRONT_a183_dischargedAmpHours m183 : 39|8@1+ (60,0) [0|0] "" Vector__XXX
 SG_ VCFRONT_a197_dcrMilliOhms m197 : 39|8@1+ (1,0) [0|0] "" Vector__XXX
 SG_ VCFRONT_a257_espFault m257 : 39|1@1+ (1,0) [0|0] "" Vector__XXX
 SG_ VCFRONT_a365_ScheduledDeparture m365 : 39|1@1+ (1,0) [0|0] "" Vector__XXX
 SG_ VCFRONT_a366_LowCoolant m366 : 39|1@1+ (1,0) [0|0] "" Vector__XXX
 SG_ VCFRONT_a368_preconditionsNotMet m368 : 39|1@1+ (1,0) [0|0] "" Vector__XXX
 SG_ VCFRONT_a407_avgPulseCurrent m407 : 39|7@1+ (1,-127) [0|0] "" Vector__XXX
 SG_ VCFRONT_a444_highSide2GateDriver m444 : 39|1@1+ (1,0) [0|0] "" Vector__XXX
 SG_ VCFRONT_a446_usingModeledTd m446 : 39|1@1+ (1,0) [0|0] "" Vector__XXX
 SG_ VCFRONT_a462_serviceMode m462 : 39|1@1+ (1,0) [0|0] "" Vector__XXX
 SG_ VCFRONT_a478_BMS_MIA m478 : 39|1@1+ (1,0) [0|0] "" Vector__XXX
 SG_ VCFRONT_a480_bufferFull m480 : 39|1@1+ (1,0) [0|0] "" Vector__XXX
 SG_ VCFRONT_a561_cell2Voltage m561 : 39|7@1+ (0.04,0) [0|0] "" Vector__XXX
 SG_ VCFRONT_a562_cell2Voltage m562 : 39|7@1+ (0.04,0) [0|0] "" Vector__XXX
 SG_ VCFRONT_a626_avgPulseCurrent m626 : 39|7@1+ (1,-127) [0|0] "" Vector__XXX
 SG_ VCFRONT_a663_hcmlValidatedG_0000 m663 : 39|5@1+ (3.225806451612903,0) [0|0] "" Vector__XXX
 SG_ VCFRONT_a664_hcmrValidatedG_0000 m664 : 39|5@1+ (3.225806451612903,0) [0|0] "" Vector__XXX
 SG_ VCFRONT_a104_BDY_control m104 : 38|1@1+ (1,0) [0|0] "" Vector__XXX
 SG_ VCFRONT_a113_VEH_tripPlanning m113 : 38|1@1+ (1,0) [0|0] "" Vector__XXX
 SG_ VCFRONT_a117_PARTY_prndStatus m117 : 38|1@1+ (1,0) [0|0] "" Vector__XXX
 SG_ VCFRONT_a118_CH_LVBMS_statusHigh m118 : 38|1@1+ (1,0) [0|0] "" Vector__XXX
 SG_ VCFRONT_a120_PARTY_prndControl m120 : 38|1@1+ (1,0) [0|0] "" Vector__XXX
 SG_ VCFRONT_a171_SCCM m171 : 38|1@1+ (1,0) [0|0] "" Vector__XXX
 SG_ VCFRONT_a180_transportMode m180 : 38|1@1+ (1,0) [0|0] "" Vector__XXX
 SG_ VCFRONT_a192_frunkOpen m192 : 38|1@1+ (1,0) [0|0] "" Vector__XXX
 SG_ VCFRONT_a197_prechargeSuccessful m197 : 38|1@1+ (1,0) [0|0] "" Vector__XXX
 SG_ VCFRONT_a257_iBoosterFault m257 : 38|1@1+ (1,0) [0|0] "" Vector__XXX
 SG_ VCFRONT_a365_TransportMode m365 : 38|1@1+ (1,0) [0|0] "" Vector__XXX
 SG_ VCFRONT_a366_ScheduledDeparture m366 : 38|1@1+ (1,0) [0|0] "" Vector__XXX
 SG_ VCFRONT_a368_coolantPumpsFaulted m368 : 38|1@1+ (1,0) [0|0] "" Vector__XXX
 SG_ VCFRONT_a379_minUnfilteredVoltag m379 : 38|12@1+ (0.005443676098,0) [0|0] "" Vector__XXX
 SG_ VCFRONT_a400_VrefType m400 : 38|2@1+ (1,0) [0|0] "" Vector__XXX
 SG_ VCFRONT_a413_VrefType m413 : 38|2@1+ (1,0) [0|0] "" Vector__XXX
 SG_ VCFRONT_a415_IBSVoltage m415 : 38|9@1+ (0.04,0) [0|0] "" Vector__XXX
 SG_ VCFRONT_a444_overTempWarning m444 : 38|1@1+ (1,0) [0|0] "" Vector__XXX
 SG_ VCFRONT_a446_usingModeledTs m446 : 38|1@1+ (1,0) [0|0] "" Vector__XXX
 SG_ VCFRONT_a462_Imbalance m462 : 38|1@1+ (1,0) [0|0] "" Vector__XXX
 SG_ VCFRONT_a476_ECPAState m476 : 38|2@1+ (1,0) [0|0] "" Vector__XXX
 SG_ VCFRONT_a478_crashDetected m478 : 38|1@1+ (1,0) [0|0] "" Vector__XXX
 SG_ VCFRONT_a480_configIncorrect m480 : 38|1@1+ (1,0) [0|0] "" Vector__XXX
 SG_ VCFRONT_a595_IBSVoltage m595 : 38|10@1+ (0.1,-1) [0|0] "" Vector__XXX
 SG_ VCFRONT_a016_NVMMWriteFailed m16 : 37|1@1+ (1,0) [0|0] "" Vector__XXX
 SG_ VCFRONT_a104_BDY_gpsAccuracies m104 : 37|1@1+ (1,0) [0|0] "" Vector__XXX
 SG_ VCFRONT_a113_CH_powertrainContro m113 : 37|1@1+ (1,0) [0|0] "" Vector__XXX
 SG_ VCFRONT_a116_BDY_switchStatus m116 : 37|1@1+ (1,0) [0|0] "" Vector__XXX
 SG_ VCFRONT_a117_VEH_status m117 : 37|1@1+ (1,0) [0|0] "" Vector__XXX
 SG_ VCFRONT_a118_CH_12VBatteryStatus m118 : 37|1@1+ (1,0) [0|0] "" Vector__XXX
 SG_ VCFRONT_a120_VEH_estimatedBrakeT m120 : 37|1@1+ (1,0) [0|0] "" Vector__XXX
 SG_ VCFRONT_a171_OPCS m171 : 37|1@1+ (1,0) [0|0] "" Vector__XXX
 SG_ VCFRONT_a180_serviceMode m180 : 37|1@1+ (1,0) [0|0] "" Vector__XXX
 SG_ VCFRONT_a192_serviceMode m192 : 37|1@1+ (1,0) [0|0] "" Vector__XXX
 SG_ VCFRONT_a257_vbatFusedFault m257 : 37|1@1+ (1,0) [0|0] "" Vector__XXX
 SG_ VCFRONT_a365_showroomMode m365 : 37|1@1+ (1,0) [0|0] "" Vector__XXX
 SG_ VCFRONT_a366_TransportMode m366 : 37|1@1+ (1,0) [0|0] "" Vector__XXX
 SG_ VCFRONT_a368_coolantNotFilled m368 : 37|1@1+ (1,0) [0|0] "" Vector__XXX
 SG_ VCFRONT_a444_overTempShutdown m444 : 37|1@1+ (1,0) [0|0] "" Vector__XXX
 SG_ VCFRONT_a446_usingModeledPl m446 : 37|1@1+ (1,0) [0|0] "" Vector__XXX
 SG_ VCFRONT_a462_MOSFETStuckOpen m462 : 37|1@1+ (1,0) [0|0] "" Vector__XXX
 SG_ VCFRONT_a474_drl1Status m474 : 37|3@1+ (1,0) [0|0] "" Vector__XXX
 SG_ VCFRONT_a475_drl1Status m475 : 37|3@1+ (1,0) [0|0] "" Vector__XXX
 SG_ VCFRONT_a478_notEnoughPowerForSu m478 : 37|1@1+ (1,0) [0|0] "" Vector__XXX
 SG_ VCFRONT_a480_spiNotDone m480 : 37|1@1+ (1,0) [0|0] "" Vector__XXX
 SG_ VCFRONT_a514_cell4Voltage m514 : 37|7@1+ (0.08,0) [0|0] "" Vector__XXX
 SG_ VCFRONT_a515_cell4Voltage m515 : 37|7@1+ (0.08,0) [0|0] "" Vector__XXX
 SG_ VCFRONT_a516_LVBatteryCannotSupp m516 : 37|1@1+ (1,0) [0|0] "" Vector__XXX
 SG_ VCFRONT_a522_LVBatteryCannotSupp m522 : 37|1@1+ (1,0) [0|0] "" Vector__XXX
 SG_ VCFRONT_a606_ccQdotTotalBeforeEn m606 : 37|6@1+ (111.11111111111111,0) [0|0] "" Vector__XXX
 SG_ VCFRONT_a669_vehicleSpeed m669 : 37|7@1+ (2,0) [0|0] "" Vector__XXX
 SG_ VCFRONT_a670_gpioEfuseEn m670 : 37|1@1+ (1,0) [0|0] "" Vector__XXX
 SG_ VCFRONT_a005_faults1 m5 : 36|12@1+ (1,0) [0|0] "" Vector__XXX
 SG_ VCFRONT_a016_NVMMMemOverflow m16 : 36|1@1+ (1,0) [0|0] "" Vector__XXX
 SG_ VCFRONT_a038_violationType m38 : 36|3@1+ (1,0) [0|0] "" Vector__XXX
 SG_ VCFRONT_a047_Porvddd m47 : 36|1@1+ (1,0) [0|0] "" Vector__XXX
 SG_ VCFRONT_a104_CH_pscControl m104 : 36|1@1+ (1,0) [0|0] "" Vector__XXX
 SG_ VCFRONT_a113_CH_chassisControl m113 : 36|1@1+ (1,0) [0|0] "" Vector__XXX
 SG_ VCFRONT_a116_BDY_restraintStatus m116 : 36|1@1+ (1,0) [0|0] "" Vector__XXX
 SG_ VCFRONT_a117_PARTY_doorStatus m117 : 36|1@1+ (1,0) [0|0] "" Vector__XXX
 SG_ VCFRONT_a118_PARTY_vehNm m118 : 36|1@1+ (1,0) [0|0] "" Vector__XXX
 SG_ VCFRONT_a120_CH_speed m120 : 36|1@1+ (1,0) [0|0] "" Vector__XXX
 SG_ VCFRONT_a162_ccLeftExvFlow m162 : 36|7@1+ (1,0) [0|0] "" Vector__XXX
 SG_ VCFRONT_a171_OPC m171 : 36|1@1+ (1,0) [0|0] "" Vector__XXX
 SG_ VCFRONT_a180_HVBlockingMismatch m180 : 36|1@1+ (1,0) [0|0] "" Vector__XXX
 SG_ VCFRONT_a188_vehicleState m188 : 36|5@1+ (1,0) [0|0] "" Vector__XXX
 SG_ VCFRONT_a191_LVBMSVoltage m191 : 36|8@1+ (0.08741903380905883,0) [0|0] "" Vector__XXX
 SG_ VCFRONT_a192_GTW_updateStarted m192 : 36|1@1+ (1,0) [0|0] "" Vector__XXX
 SG_ VCFRONT_a242_IBSVoltage m242 : 36|11@1+ (0.01088735219,0) [0|0] "" Vector__XXX
 SG_ VCFRONT_a257_pcsFault m257 : 36|1@1+ (1,0) [0|0] "" Vector__XXX
 SG_ VCFRONT_a269_IBSVoltage m269 : 36|11@1+ (0.01088735219,0) [0|0] "" Vector__XXX
 SG_ VCFRONT_a365_pcsFlowRequest m365 : 36|1@1+ (1,0) [0|0] "" Vector__XXX
 SG_ VCFRONT_a366_showroomMode m366 : 36|1@1+ (1,0) [0|0] "" Vector__XXX
 SG_ VCFRONT_a368_fansFaulted m368 : 36|1@1+ (1,0) [0|0] "" Vector__XXX
 SG_ VCFRONT_a400_VrefStatus m400 : 36|2@1+ (1,0) [0|0] "" Vector__XXX
 SG_ VCFRONT_a401_IBSVoltage m401 : 36|11@1+ (0.01088735219,0) [0|0] "" Vector__XXX
 SG_ VCFRONT_a410_IBSVoltage m410 : 36|11@1+ (0.01088735219,0) [0|0] "" Vector__XXX
 SG_ VCFRONT_a411_IBSVoltage m411 : 36|11@1+ (0.01088735219,0) [0|0] "" Vector__XXX
 SG_ VCFRONT_a413_VrefStatus m413 : 36|2@1+ (1,0) [0|0] "" Vector__XXX
 SG_ VCFRONT_a416_packCurrent m416 : 36|10@1- (5,0) [0|0] "" Vector__XXX
 SG_ VCFRONT_a417_packCurrent m417 : 36|10@1- (5,0) [0|0] "" Vector__XXX
 SG_ VCFRONT_a418_packCurrent m418 : 36|10@1- (5,0) [0|0] "" Vector__XXX
 SG_ VCFRONT_a419_packCurrent m419 : 36|10@1- (5,0) [0|0] "" Vector__XXX
 SG_ VCFRONT_a423_packCurrent m423 : 36|10@1- (5,0) [0|0] "" Vector__XXX
 SG_ VCFRONT_a424_packCurrent m424 : 36|10@1- (5,0) [0|0] "" Vector__XXX
 SG_ VCFRONT_a444_cpUndervoltage m444 : 36|1@1+ (1,0) [0|0] "" Vector__XXX
 SG_ VCFRONT_a446_usingModeledPd m446 : 36|1@1+ (1,0) [0|0] "" Vector__XXX
 SG_ VCFRONT_a462_MOSFETStuckClose m462 : 36|1@1+ (1,0) [0|0] "" Vector__XXX
 SG_ VCFRONT_a472_rangeIndex m472 : 36|2@1+ (1,0) [0|0] "" Vector__XXX
 SG_ VCFRONT_a473_rangeIndex m473 : 36|2@1+ (1,0) [0|0] "" Vector__XXX
 SG_ VCFRONT_a478_transportMode m478 : 36|1@1+ (1,0) [0|0] "" Vector__XXX
 SG_ VCFRONT_a480_watchdog m480 : 36|1@1+ (1,0) [0|0] "" Vector__XXX
 SG_ VCFRONT_a481_stuckOnVDS m481 : 36|10@1+ (1,0) [0|0] "" Vector__XXX
 SG_ VCFRONT_a503_packCurrent m503 : 36|10@1- (5,0) [0|0] "" Vector__XXX
 SG_ VCFRONT_a516_reverseBatteryFault m516 : 36|1@1+ (1,0) [0|0] "" Vector__XXX
 SG_ VCFRONT_a522_reverseBatteryFault m522 : 36|1@1+ (1,0) [0|0] "" Vector__XXX
 SG_ VCFRONT_a527_cell3Voltage m527 : 36|10@1+ (0.01,0) [0|0] "" Vector__XXX
 SG_ VCFRONT_a555_cell3Voltage m555 : 36|10@1+ (0.01,0) [0|0] "" Vector__XXX
 SG_ VCFRONT_a558_worseCaseRequiredRa m558 : 36|10@1+ (1,0) [0|0] "" Vector__XXX
 SG_ VCFRONT_a559_vehiclePowerState m559 : 36|2@1+ (1,0) [0|0] "" Vector__XXX
 SG_ VCFRONT_a564_worseCaseRequiredRa m564 : 36|10@1+ (1,0) [0|0] "" Vector__XXX
 SG_ VCFRONT_a585_rightHeadlampIntern m585 : 36|20@1+ (1,0) [0|0] "" Vector__XXX
 SG_ VCFRONT_a605_sleepBypassCurrent m605 : 36|10@1+ (0.1,0) [0|0] "" Vector__XXX
 SG_ VCFRONT_a611_radFanSpeed m611 : 36|5@1+ (150,0) [0|0] "" Vector__XXX
 SG_ VCFRONT_a634_ajar1ClosingDeltaV m634 : 36|10@1- (0.01,0) [0|0] "" Vector__XXX
 SG_ VCFRONT_a644_pumpPrimedEstimate m644 : 36|1@1+ (1,0) [0|0] "" Vector__XXX
 SG_ VCFRONT_a670_mosfetFeedback_0000 m670 : 36|1@1+ (1,0) [0|0] "" Vector__XXX
 SG_ VCFRONT_a016_NVMMRecordUpgraded m16 : 35|1@1+ (1,0) [0|0] "" Vector__XXX
 SG_ VCFRONT_a047_Pmic m47 : 35|1@1+ (1,0) [0|0] "" Vector__XXX
 SG_ VCFRONT_a104_VEH_status m104 : 35|1@1+ (1,0) [0|0] "" Vector__XXX
 SG_ VCFRONT_a113_VEH_LVControl m113 : 35|1@1+ (1,0) [0|0] "" Vector__XXX
 SG_ VCFRONT_a114_CH_status m114 : 35|1@1+ (1,0) [0|0] "" Vector__XXX
 SG_ VCFRONT_a116_BDY_epbmStatus m116 : 35|1@1+ (1,0) [0|0] "" Vector__XXX
 SG_ VCFRONT_a117_VEH_thermalStatus m117 : 35|1@1+ (1,0) [0|0] "" Vector__XXX
 SG_ VCFRONT_a118_VEH_lightStatus m118 : 35|1@1+ (1,0) [0|0] "" Vector__XXX
 SG_ VCFRONT_a120_PARTY_stalklessInte m120 : 35|1@1+ (1,0) [0|0] "" Vector__XXX
 SG_ VCFRONT_a153_mismatchDuration m153 : 35|26@1+ (1,0) [0|0] "" Vector__XXX
 SG_ VCFRONT_a155_minHVComingUpIBSCur m155 : 35|10@1+ (0.1,-102.3) [0|0] "" Vector__XXX
 SG_ VCFRONT_a171_ESPCAL m171 : 35|1@1+ (1,0) [0|0] "" Vector__XXX
 SG_ VCFRONT_a178_pressureSuction m178 : 35|4@1+ (1,0) [0|0] "" Vector__XXX
 SG_ VCFRONT_a180_PCS_MIA m180 : 35|1@1+ (1,0) [0|0] "" Vector__XXX
 SG_ VCFRONT_a192_GTW_factoryGated m192 : 35|1@1+ (1,0) [0|0] "" Vector__XXX
 SG_ VCFRONT_a257_vcrightFault m257 : 35|1@1+ (1,0) [0|0] "" Vector__XXX
 SG_ VCFRONT_a365_PCSMIA m365 : 35|1@1+ (1,0) [0|0] "" Vector__XXX
 SG_ VCFRONT_a366_pcsFlowRequest m366 : 35|1@1+ (1,0) [0|0] "" Vector__XXX
 SG_ VCFRONT_a368_louverFaulted m368 : 35|1@1+ (1,0) [0|0] "" Vector__XXX
 SG_ VCFRONT_a444_supplyUndervoltage m444 : 35|1@1+ (1,0) [0|0] "" Vector__XXX
 SG_ VCFRONT_a446_usingModeledPs m446 : 35|1@1+ (1,0) [0|0] "" Vector__XXX
 SG_ VCFRONT_a462_SamplingError m462 : 35|1@1+ (1,0) [0|0] "" Vector__XXX
 SG_ VCFRONT_a478_serviceMode m478 : 35|1@1+ (1,0) [0|0] "" Vector__XXX
 SG_ VCFRONT_a480_chargePumpLow m480 : 35|1@1+ (1,0) [0|0] "" Vector__XXX
 SG_ VCFRONT_a481_VDSFailure m481 : 35|1@1+ (1,0) [0|0] "" Vector__XXX
 SG_ VCFRONT_a516_LVBatteryDisconnect m516 : 35|1@1+ (1,0) [0|0] "" Vector__XXX
 SG_ VCFRONT_a522_LVBatteryDisconnect m522 : 35|1@1+ (1,0) [0|0] "" Vector__XXX
 SG_ VCFRONT_a541_PeakCurrent m541 : 35|10@1+ (0.05,0) [0|0] "" Vector__XXX
 SG_ VCFRONT_a565_lastUserPresenceUpd m565 : 35|26@1+ (64,0) [0|0] "" Vector__XXX
 SG_ VCFRONT_a614_compressorFault m614 : 35|1@1+ (1,0) [0|0] "" Vector__XXX
 SG_ VCFRONT_a623_unhealthyReason m623 : 35|5@1+ (1,0) [0|0] "" Vector__XXX
 SG_ VCFRONT_a016_NVMMVersionMismatch m16 : 34|1@1+ (1,0) [0|0] "" Vector__XXX
 SG_ VCFRONT_a047_OcdReghc m47 : 34|1@1+ (1,0) [0|0] "" Vector__XXX
 SG_ VCFRONT_a104_VEH_summonCommand m104 : 34|1@1+ (1,0) [0|0] "" Vector__XXX
 SG_ VCFRONT_a113_VEH_elevationStatus m113 : 34|1@1+ (1,0) [0|0] "" Vector__XXX
 SG_ VCFRONT_a114_CH_party3 m114 : 34|1@1+ (1,0) [0|0] "" Vector__XXX
 SG_ VCFRONT_a116_PARTY_doorStatus m116 : 34|1@1+ (1,0) [0|0] "" Vector__XXX
 SG_ VCFRONT_a117_PARTY_restraintStat m117 : 34|1@1+ (1,0) [0|0] "" Vector__XXX
 SG_ VCFRONT_a118_CH_lighting m118 : 34|1@1+ (1,0) [0|0] "" Vector__XXX
 SG_ VCFRONT_a120_PT_systemPower m120 : 34|1@1+ (1,0) [0|0] "" Vector__XXX
 SG_ VCFRONT_a142_driverHasCommError m142 : 34|1@1+ (1,0) [0|0] "" Vector__XXX
 SG_ VCFRONT_a153_chargeStateTransiti m153 : 34|1@1+ (1,0) [0|0] "" Vector__XXX
 SG_ VCFRONT_a161_overload m161 : 34|1@1+ (1,0) [0|0] "" Vector__XXX
 SG_ VCFRONT_a171_ESP m171 : 34|1@1+ (1,0) [0|0] "" Vector__XXX
 SG_ VCFRONT_a180_BMS_MIA m180 : 34|1@1+ (1,0) [0|0] "" Vector__XXX
 SG_ VCFRONT_a187_hvsBusRetryCount m187 : 34|9@1+ (1,0) [0|0] "" Vector__XXX
 SG_ VCFRONT_a191_MOSState m191 : 34|2@1+ (1,0) [0|0] "" Vector__XXX
 SG_ VCFRONT_a253_IBSAmpHours m253 : 34|14@1- (0.01,0) [0|0] "" Vector__XXX
 SG_ VCFRONT_a257_vcleftFault m257 : 34|1@1+ (1,0) [0|0] "" Vector__XXX
 SG_ VCFRONT_a284_driverHasCommError m284 : 34|1@1+ (1,0) [0|0] "" Vector__XXX
 SG_ VCFRONT_a285_driverHasCommError m285 : 34|1@1+ (1,0) [0|0] "" Vector__XXX
 SG_ VCFRONT_a286_driverHasCommError m286 : 34|1@1+ (1,0) [0|0] "" Vector__XXX
 SG_ VCFRONT_a287_driverHasCommError m287 : 34|1@1+ (1,0) [0|0] "" Vector__XXX
 SG_ VCFRONT_a288_driverHasCommError m288 : 34|1@1+ (1,0) [0|0] "" Vector__XXX
 SG_ VCFRONT_a289_driverHasCommError m289 : 34|1@1+ (1,0) [0|0] "" Vector__XXX
 SG_ VCFRONT_a352_prevFilteredCurrent m352 : 34|8@1+ (0.1,0) [0|0] "" Vector__XXX
 SG_ VCFRONT_a365_DIMIA m365 : 34|1@1+ (1,0) [0|0] "" Vector__XXX
 SG_ VCFRONT_a366_PCSMIA m366 : 34|1@1+ (1,0) [0|0] "" Vector__XXX
 SG_ VCFRONT_a368_coolantValveFaulted m368 : 34|1@1+ (1,0) [0|0] "" Vector__XXX
 SG_ VCFRONT_a402_frunkOpen m402 : 34|1@1+ (1,0) [0|0] "" Vector__XXX
 SG_ VCFRONT_a427_deltaAh m427 : 34|9@1+ (0.5,0) [0|0] "" Vector__XXX
 SG_ VCFRONT_a444_overcurrent m444 : 34|1@1+ (1,0) [0|0] "" Vector__XXX
 SG_ VCFRONT_a462_DeepDischarge m462 : 34|1@1+ (1,0) [0|0] "" Vector__XXX
 SG_ VCFRONT_a474_lowBeamPrefieldStat m474 : 34|3@1+ (1,0) [0|0] "" Vector__XXX
 SG_ VCFRONT_a475_lowBeamPrefieldStat m475 : 34|3@1+ (1,0) [0|0] "" Vector__XXX
 SG_ VCFRONT_a476_batterySMState m476 : 34|4@1+ (1,0) [0|0] "" Vector__XXX
 SG_ VCFRONT_a477_cell3Voltage m477 : 34|9@1+ (0.01,0) [0|0] "" Vector__XXX
 SG_ VCFRONT_a478_factoryMode m478 : 34|1@1+ (1,0) [0|0] "" Vector__XXX
 SG_ VCFRONT_a480_vgsLow m480 : 34|1@1+ (1,0) [0|0] "" Vector__XXX
 SG_ VCFRONT_a481_VDSFinished m481 : 34|1@1+ (1,0) [0|0] "" Vector__XXX
 SG_ VCFRONT_a516_contactorsPermanent m516 : 34|1@1+ (1,0) [0|0] "" Vector__XXX
 SG_ VCFRONT_a522_contactorsPermanent m522 : 34|1@1+ (1,0) [0|0] "" Vector__XXX
 SG_ VCFRONT_a548_ampHourBucketCount m548 : 34|6@1+ (0.01,0) [0|0] "" Vector__XXX
 SG_ VCFRONT_a565_chargeStateTransiti m565 : 34|1@1+ (1,0) [0|0] "" Vector__XXX
 SG_ VCFRONT_a583_disagreementDuratio m583 : 34|19@1+ (100,0) [0|0] "" Vector__XXX
 SG_ VCFRONT_a614_louverFault m614 : 34|1@1+ (1,0) [0|0] "" Vector__XXX
 SG_ VCFRONT_a627_cell3Voltage m627 : 34|9@1+ (0.01,0) [0|0] "" Vector__XXX
 SG_ VCFRONT_a663_hcmlGroupsHigh_0000 m663 : 34|5@1+ (3.225806451612903,0) [0|0] "" Vector__XXX
 SG_ VCFRONT_a664_hcmrGroupsHigh_0000 m664 : 34|5@1+ (3.225806451612903,0) [0|0] "" Vector__XXX
 SG_ VCFRONT_a016_NVMMCRCMismatch m16 : 33|1@1+ (1,0) [0|0] "" Vector__XXX
 SG_ VCFRONT_a047_OcdDpslpLinreg m47 : 33|1@1+ (1,0) [0|0] "" Vector__XXX
 SG_ VCFRONT_a104_VEH_matrixHighBeamR m104 : 33|1@1+ (1,0) [0|0] "" Vector__XXX
 SG_ VCFRONT_a110_PARTY_carConfig m110 : 33|1@1+ (1,0) [0|0] "" Vector__XXX
 SG_ VCFRONT_a113_VEH_status m113 : 33|1@1+ (1,0) [0|0] "" Vector__XXX
 SG_ VCFRONT_a114_CH_party1 m114 : 33|1@1+ (1,0) [0|0] "" Vector__XXX
 SG_ VCFRONT_a116_PARTY_restraintStat m116 : 33|1@1+ (1,0) [0|0] "" Vector__XXX
 SG_ VCFRONT_a117_VEH_seatStatus2 m117 : 33|1@1+ (1,0) [0|0] "" Vector__XXX
 SG_ VCFRONT_a118_VEH_interNodeResist m118 : 33|1@1+ (1,0) [0|0] "" Vector__XXX
 SG_ VCFRONT_a120_VEH_autonomyHealth m120 : 33|1@1+ (1,0) [0|0] "" Vector__XXX
 SG_ VCFRONT_a142_isCoilShortYNVbb m142 : 33|1@1+ (1,0) [0|0] "" Vector__XXX
 SG_ VCFRONT_a153_passengerPresent m153 : 33|1@1+ (1,0) [0|0] "" Vector__XXX
 SG_ VCFRONT_a161_failedStartRepeated m161 : 33|1@1+ (1,0) [0|0] "" Vector__XXX
 SG_ VCFRONT_a171_IBSTCAL m171 : 33|1@1+ (1,0) [0|0] "" Vector__XXX
 SG_ VCFRONT_a180_replaceLVBattery m180 : 33|1@1+ (1,0) [0|0] "" Vector__XXX
 SG_ VCFRONT_a191_a180_DCDCNotSupport m191 : 33|1@1+ (1,0) [0|0] "" Vector__XXX
 SG_ VCFRONT_a284_isCoilShortYNVbb m284 : 33|1@1+ (1,0) [0|0] "" Vector__XXX
 SG_ VCFRONT_a285_isCoilShortYNVbb m285 : 33|1@1+ (1,0) [0|0] "" Vector__XXX
 SG_ VCFRONT_a286_isCoilShortYNVbb m286 : 33|1@1+ (1,0) [0|0] "" Vector__XXX
 SG_ VCFRONT_a287_isCoilShortYNVbb m287 : 33|1@1+ (1,0) [0|0] "" Vector__XXX
 SG_ VCFRONT_a288_isCoilShortYNVbb m288 : 33|1@1+ (1,0) [0|0] "" Vector__XXX
 SG_ VCFRONT_a289_isCoilShortYNVbb m289 : 33|1@1+ (1,0) [0|0] "" Vector__XXX
 SG_ VCFRONT_a365_BMSSOCTooLow m365 : 33|1@1+ (1,0) [0|0] "" Vector__XXX
 SG_ VCFRONT_a366_DIMIA m366 : 33|1@1+ (1,0) [0|0] "" Vector__XXX
 SG_ VCFRONT_a368_coolantTempSensorsF m368 : 33|1@1+ (1,0) [0|0] "" Vector__XXX
 SG_ VCFRONT_a402_serviceMode m402 : 33|1@1+ (1,0) [0|0] "" Vector__XXX
 SG_ VCFRONT_a407_intervalCurrentVari m407 : 33|6@1+ (0.1,0) [0|0] "" Vector__XXX
 SG_ VCFRONT_a444_gateDriver m444 : 33|1@1+ (1,0) [0|0] "" Vector__XXX
 SG_ VCFRONT_a446_hpBatteryLoadType m446 : 33|2@1+ (1,0) [0|0] "" Vector__XXX
 SG_ VCFRONT_a447_refrigLiquidTempCom m447 : 33|1@1+ (1,0) [0|0] "" Vector__XXX
 SG_ VCFRONT_a462_MOSOpenFault m462 : 33|1@1+ (1,0) [0|0] "" Vector__XXX
 SG_ VCFRONT_a480_ntcOvertemperature m480 : 33|1@1+ (1,0) [0|0] "" Vector__XXX
 SG_ VCFRONT_a518_targetPCSVoltage m518 : 33|8@1+ (0.1,0) [0|0] "" Vector__XXX
 SG_ VCFRONT_a548_PCS_MIA m548 : 33|1@1+ (1,0) [0|0] "" Vector__XXX
 SG_ VCFRONT_a565_passengerPresent m565 : 33|1@1+ (1,0) [0|0] "" Vector__XXX
 SG_ VCFRONT_a584_switch2Voltage m584 : 33|9@1+ (10,0) [0|0] "" Vector__XXX
 SG_ VCFRONT_a614_coolantLevelSensorL m614 : 33|1@1+ (1,0) [0|0] "" Vector__XXX
 SG_ VCFRONT_a626_intervalCurrentVari m626 : 33|6@1+ (0.1,0) [0|0] "" Vector__XXX
 SG_ VCFRONT_a000_alertDataW1 m0 : 32|16@1+ (1,0) [0|0] "" Vector__XXX
 SG_ VCFRONT_a003_LineNumber m3 : 32|16@1+ (1,0) [0|0] "" Vector__XXX
 SG_ VCFRONT_a005_busID1 m5 : 32|4@1+ (1,0) [0|0] "" Vector__XXX
 SG_ VCFRONT_a006_messageID m6 : 32|29@1+ (1,0) [0|0] "" Vector__XXX
 SG_ VCFRONT_a009_PsMin m9 : 32|6@1+ (0.1,0) [0|0] "" Vector__XXX
 SG_ VCFRONT_a016_NVMMRecordNotFound m16 : 32|1@1+ (1,0) [0|0] "" Vector__XXX
 SG_ VCFRONT_a022_TaskInitError1 m22 : 32|8@1+ (1,0) [0|0] "" Vector__XXX
 SG_ VCFRONT_a031_uds_bytes_2 m31 : 32|8@1+ (1,0) [0|0] "" Vector__XXX
 SG_ VCFRONT_a033_address m33 : 32|32@1+ (1,0) [0|0] "" Vector__XXX
 SG_ VCFRONT_a038_protectionContext m38 : 32|4@1+ (1,0) [0|0] "" Vector__XXX
 SG_ VCFRONT_a041_CPULoad10msTask m41 : 32|8@1+ (1,0) [0|0] "" Vector__XXX
 SG_ VCFRONT_a042_Usage100msTask m42 : 32|8@1+ (1,0) [0|0] "" Vector__XXX
 SG_ VCFRONT_a047_OcdActLinreg m47 : 32|1@1+ (1,0) [0|0] "" Vector__XXX
 SG_ VCFRONT_a063_ADCVoltage m63 : 32|8@1+ (0.025,0) [0|0] "" Vector__XXX
 SG_ VCFRONT_a104_PARTY_matrixBendAng m104 : 32|1@1+ (1,0) [0|0] "" Vector__XXX
 SG_ VCFRONT_a110_CH_epochTimeGtw m110 : 32|1@1+ (1,0) [0|0] "" Vector__XXX
 SG_ VCFRONT_a113_VEH_debugECU m113 : 32|1@1+ (1,0) [0|0] "" Vector__XXX
 SG_ VCFRONT_a114_BDY_wheelSpeeds m114 : 32|1@1+ (1,0) [0|0] "" Vector__XXX
 SG_ VCFRONT_a116_VEH_windowStatus m116 : 32|1@1+ (1,0) [0|0] "" Vector__XXX
 SG_ VCFRONT_a117_VEH_liftgateStatus m117 : 32|1@1+ (1,0) [0|0] "" Vector__XXX
 SG_ VCFRONT_a118_CH_sensors m118 : 32|1@1+ (1,0) [0|0] "" Vector__XXX
 SG_ VCFRONT_a120_PARTY_autonomyHealt m120 : 32|1@1+ (1,0) [0|0] "" Vector__XXX
 SG_ VCFRONT_a127_vcleftEFuseVoltage m127 : 32|16@1+ (0.1,0) [0|0] "" Vector__XXX
 SG_ VCFRONT_a128_vcrightEFuseVoltage m128 : 32|16@1+ (0.1,0) [0|0] "" Vector__XXX
 SG_ VCFRONT_a129_pcsEFuseVoltage m129 : 32|16@1+ (0.1,0) [0|0] "" Vector__XXX
 SG_ VCFRONT_a130_epas3pEFuseVoltage m130 : 32|16@1+ (0.1,0) [0|0] "" Vector__XXX
 SG_ VCFRONT_a131_epas3sEFuseVoltage m131 : 32|16@1+ (0.1,0) [0|0] "" Vector__XXX
 SG_ VCFRONT_a132_iBoosterVoltage m132 : 32|16@1+ (0.1,0) [0|0] "" Vector__XXX
 SG_ VCFRONT_a133_espEFuseVoltage m133 : 32|16@1+ (0.1,0) [0|0] "" Vector__XXX
 SG_ VCFRONT_a134_fusedHighVoltage m134 : 32|16@1+ (0.1,0) [0|0] "" Vector__XXX
 SG_ VCFRONT_a142_isCoilShortYNGnd m142 : 32|1@1+ (1,0) [0|0] "" Vector__XXX
 SG_ VCFRONT_a153_UIUserActivity m153 : 32|1@1+ (1,0) [0|0] "" Vector__XXX
 SG_ VCFRONT_a160_compressorRpm m160 : 32|7@1+ (90,0) [0|0] "" Vector__XXX
 SG_ VCFRONT_a161_warnOverTemperature m161 : 32|1@1+ (1,0) [0|0] "" Vector__XXX
 SG_ VCFRONT_a163_powerIndexFiltered m163 : 32|7@1+ (1,0) [0|0] "" Vector__XXX
 SG_ VCFRONT_a171_IBST m171 : 32|1@1+ (1,0) [0|0] "" Vector__XXX
 SG_ VCFRONT_a180_hvcEFuseStable m180 : 32|1@1+ (1,0) [0|0] "" Vector__XXX
 SG_ VCFRONT_a182_ambientTemp m182 : 32|7@1+ (1,-40) [0|0] "" Vector__XXX
 SG_ VCFRONT_a183_ambientTemp m183 : 32|7@1+ (1,-40) [0|0] "" Vector__XXX
 SG_ VCFRONT_a184_evapInTemp m184 : 32|5@1+ (2,0) [0|0] "" Vector__XXX
 SG_ VCFRONT_a192_DI_gear m192 : 32|3@1+ (1,0) [0|0] "" Vector__XXX
 SG_ VCFRONT_a213_IBSAh m213 : 32|14@1- (0.01,0) [0|0] "" Vector__XXX
 SG_ VCFRONT_a219_IBSAh m219 : 32|14@1- (0.01,0) [0|0] "" Vector__XXX
 SG_ VCFRONT_a220_PCSCurrent m220 : 32|8@1+ (0.5,-127) [0|0] "" Vector__XXX
 SG_ VCFRONT_a243_IBSCurrent m243 : 32|16@1- (0.005,0) [0|0] "" Vector__XXX
 SG_ VCFRONT_a244_voltage m244 : 32|16@1+ (0.1,0) [0|0] "" Vector__XXX
 SG_ VCFRONT_a245_voltage m245 : 32|16@1+ (0.1,0) [0|0] "" Vector__XXX
 SG_ VCFRONT_a246_voltage m246 : 32|16@1+ (0.1,0) [0|0] "" Vector__XXX
 SG_ VCFRONT_a252_IBSAmpHours m252 : 32|14@1- (0.01,0) [0|0] "" Vector__XXX
 SG_ VCFRONT_a257_vcrightLockoutStatu m257 : 32|2@1+ (1,0) [0|0] "" Vector__XXX
 SG_ VCFRONT_a259_IBSTemp m259 : 32|16@1- (0.01,0) [0|0] "" Vector__XXX
 SG_ VCFRONT_a261_vbatProtVoltage m261 : 32|16@1+ (0.1,0) [0|0] "" Vector__XXX
 SG_ VCFRONT_a262_vbatProtVoltage m262 : 32|16@1+ (0.1,0) [0|0] "" Vector__XXX
 SG_ VCFRONT_a263_vbatProtVoltage m263 : 32|16@1+ (0.1,0) [0|0] "" Vector__XXX
 SG_ VCFRONT_a264_vbatProtVoltage m264 : 32|16@1+ (0.1,0) [0|0] "" Vector__XXX
 SG_ VCFRONT_a265_vbatProtVoltage m265 : 32|16@1+ (0.1,0) [0|0] "" Vector__XXX
 SG_ VCFRONT_a266_vbatProtVoltage m266 : 32|16@1+ (0.1,0) [0|0] "" Vector__XXX
 SG_ VCFRONT_a267_vbatProtVoltage m267 : 32|16@1+ (0.1,0) [0|0] "" Vector__XXX
 SG_ VCFRONT_a268_vbatProtVoltage m268 : 32|16@1+ (0.1,0) [0|0] "" Vector__XXX
 SG_ VCFRONT_a275_bmbChainBreakType m275 : 32|3@1+ (1,0) [0|0] "" Vector__XXX
 SG_ VCFRONT_a277_regErrorType m277 : 32|8@1+ (1,0) [0|0] "" Vector__XXX
 SG_ VCFRONT_a283_thmlFanDemandLimit m283 : 32|7@1+ (1,0) [0|0] "" Vector__XXX
 SG_ VCFRONT_a284_isCoilShortYNGnd m284 : 32|1@1+ (1,0) [0|0] "" Vector__XXX
 SG_ VCFRONT_a285_isCoilShortYNGnd m285 : 32|1@1+ (1,0) [0|0] "" Vector__XXX
 SG_ VCFRONT_a286_isCoilShortYNGnd m286 : 32|1@1+ (1,0) [0|0] "" Vector__XXX
 SG_ VCFRONT_a287_isCoilShortYNGnd m287 : 32|1@1+ (1,0) [0|0] "" Vector__XXX
 SG_ VCFRONT_a288_isCoilShortYNGnd m288 : 32|1@1+ (1,0) [0|0] "" Vector__XXX
 SG_ VCFRONT_a289_isCoilShortYNGnd m289 : 32|1@1+ (1,0) [0|0] "" Vector__XXX
 SG_ VCFRONT_a303_postVoltage m303 : 32|16@1+ (0.1,0) [0|0] "" Vector__XXX
 SG_ VCFRONT_a305_actuatorCurrent m305 : 32|8@1+ (0.1,0) [0|0] "" Vector__XXX
 SG_ VCFRONT_a306_actuatorCurrent m306 : 32|8@1+ (0.1,0) [0|0] "" Vector__XXX
 SG_ VCFRONT_a307_actuatorCurrent m307 : 32|8@1+ (0.1,0) [0|0] "" Vector__XXX
 SG_ VCFRONT_a308_actuatorCurrent m308 : 32|8@1+ (0.1,0) [0|0] "" Vector__XXX
 SG_ VCFRONT_a309_switchVoltage m309 : 32|16@1+ (0.1,0) [0|0] "" Vector__XXX
 SG_ VCFRONT_a326_maxCurrent m326 : 32|16@1+ (0.1,0) [0|0] "" Vector__XXX
 SG_ VCFRONT_a327_maxCurrent m327 : 32|16@1+ (0.1,0) [0|0] "" Vector__XXX
 SG_ VCFRONT_a328_maxCurrent m328 : 32|16@1+ (0.1,0) [0|0] "" Vector__XXX
 SG_ VCFRONT_a329_maxCurrent m329 : 32|16@1+ (0.1,0) [0|0] "" Vector__XXX
 SG_ VCFRONT_a330_maxCurrent m330 : 32|16@1+ (0.1,0) [0|0] "" Vector__XXX
 SG_ VCFRONT_a331_maxCurrent m331 : 32|16@1+ (0.1,0) [0|0] "" Vector__XXX
 SG_ VCFRONT_a332_maxCurrent m332 : 32|16@1+ (0.1,0) [0|0] "" Vector__XXX
 SG_ VCFRONT_a333_maxCurrent m333 : 32|16@1+ (0.1,0) [0|0] "" Vector__XXX
 SG_ VCFRONT_a353_ambientTemperature m353 : 32|8@1+ (0.5,-40) [0|0] "" Vector__XXX
 SG_ VCFRONT_a354_ambientTemperature m354 : 32|8@1+ (0.5,-40) [0|0] "" Vector__XXX
 SG_ VCFRONT_a363_avgBleedCharge m363 : 32|15@1+ (0.001,0) [0|0] "" Vector__XXX
 SG_ VCFRONT_a365_BMSSOCInvalid m365 : 32|1@1+ (1,0) [0|0] "" Vector__XXX
 SG_ VCFRONT_a366_BMSSOCTooLow m366 : 32|1@1+ (1,0) [0|0] "" Vector__XXX
 SG_ VCFRONT_a368_systemFaulted m368 : 32|1@1+ (1,0) [0|0] "" Vector__XXX
 SG_ VCFRONT_a369_wasteHeatPower m369 : 32|7@1+ (100,0) [0|0] "" Vector__XXX
 SG_ VCFRONT_a375_sampledADCValue m375 : 32|13@1+ (0.0002,0) [0|0] "" Vector__XXX
 SG_ VCFRONT_a376_IBSCurrentSampleAbo m376 : 32|16@1+ (1,0) [0|0] "" Vector__XXX
 SG_ VCFRONT_a387_IBSTemp m387 : 32|16@1- (0.01,0) [0|0] "" Vector__XXX
 SG_ VCFRONT_a388_IBSTemp m388 : 32|16@1- (0.01,0) [0|0] "" Vector__XXX
 SG_ VCFRONT_a389_temperature m389 : 32|8@1+ (0.5,-40) [0|0] "" Vector__XXX
 SG_ VCFRONT_a390_evaluateToFindDomin m390 : 32|1@1+ (1,0) [0|0] "" Vector__XXX
 SG_ VCFRONT_a391_switch1VoltageInsta m391 : 32|10@1+ (5,0) [0|0] "" Vector__XXX
 SG_ VCFRONT_a400_bmbDeviceId m400 : 32|4@1+ (1,1) [0|0] "" Vector__XXX
 SG_ VCFRONT_a402_MOSOpen m402 : 32|1@1+ (1,0) [0|0] "" Vector__XXX
 SG_ VCFRONT_a404_IBSTemp m404 : 32|16@1- (0.01,0) [0|0] "" Vector__XXX
 SG_ VCFRONT_a405_intervalVoltage2 m405 : 32|8@1+ (0.02,9) [0|0] "" Vector__XXX
 SG_ VCFRONT_a406_pulseCompareV m406 : 32|8@1+ (0.02,9) [0|0] "" Vector__XXX
 SG_ VCFRONT_a408_IBSAmpHours m408 : 32|14@1- (0.01,0) [0|0] "" Vector__XXX
 SG_ VCFRONT_a412_pulseVoltage2Shifte m412 : 32|8@1+ (0.02,9) [0|0] "" Vector__XXX
 SG_ VCFRONT_a413_bmbDeviceId m413 : 32|4@1+ (1,1) [0|0] "" Vector__XXX
 SG_ VCFRONT_a421_uartConditionBitfie m421 : 32|16@1+ (1,0) [0|0] "" Vector__XXX
 SG_ VCFRONT_a425_maxBusVoltageLimit m425 : 32|16@1+ (0.002,0) [0|0] "" Vector__XXX
 SG_ VCFRONT_a426_minBusVoltageLimit m426 : 32|16@1+ (0.002,0) [0|0] "" Vector__XXX
 SG_ VCFRONT_a430_maxChargeCurrentLim m430 : 32|16@1- (0.1,0) [0|0] "" Vector__XXX
 SG_ VCFRONT_a431_maxChargeCurrentLim m431 : 32|16@1- (0.1,0) [0|0] "" Vector__XXX
 SG_ VCFRONT_a432_packCurrent m432 : 32|16@1- (0.1,0) [0|0] "" Vector__XXX
 SG_ VCFRONT_a433_packTypeData m433 : 32|8@1+ (1,0) [0|0] "" Vector__XXX
 SG_ VCFRONT_a434_packTypeData m434 : 32|8@1+ (1,0) [0|0] "" Vector__XXX
 SG_ VCFRONT_a435_maxDischargeCurrent m435 : 32|16@1- (0.1,0) [0|0] "" Vector__XXX
 SG_ VCFRONT_a436_maxDischargeCurrent m436 : 32|16@1- (0.1,0) [0|0] "" Vector__XXX
 SG_ VCFRONT_a438_sensorId m438 : 32|6@1+ (1,1) [0|0] "" Vector__XXX
 SG_ VCFRONT_a439_sensorId m439 : 32|6@1+ (1,1) [0|0] "" Vector__XXX
 SG_ VCFRONT_a441_bmbModuleIdPrev m441 : 32|16@1+ (1,0) [0|0] "" Vector__XXX
 SG_ VCFRONT_a442_maxSocChangeBrickId m442 : 32|7@1+ (1,1) [0|0] "" Vector__XXX
 SG_ VCFRONT_a444_watchdog m444 : 32|1@1+ (1,0) [0|0] "" Vector__XXX
 SG_ VCFRONT_a445_expectedLSB m445 : 32|8@1+ (1,0) [0|0] "" Vector__XXX
 SG_ VCFRONT_a447_refrigLiquidPressCo m447 : 32|1@1+ (1,0) [0|0] "" Vector__XXX
 SG_ VCFRONT_a462_BalanceCircuitFault m462 : 32|1@1+ (1,0) [0|0] "" Vector__XXX
 SG_ VCFRONT_a463_switch1VoltageInsta m463 : 32|10@1+ (5,0) [0|0] "" Vector__XXX
 SG_ VCFRONT_a464_subcool m464 : 32|7@1+ (0.4,-10) [0|0] "" Vector__XXX
 SG_ VCFRONT_a465_subcool m465 : 32|7@1+ (0.4,-10) [0|0] "" Vector__XXX
 SG_ VCFRONT_a466_subcool m466 : 32|7@1+ (0.4,-10) [0|0] "" Vector__XXX
 SG_ VCFRONT_a474_ssl100Bank9Status m474 : 32|2@1+ (1,0) [0|0] "" Vector__XXX
 SG_ VCFRONT_a475_ssl100Bank9Status m475 : 32|2@1+ (1,0) [0|0] "" Vector__XXX
 SG_ VCFRONT_a476_vehiclePowerState m476 : 32|2@1+ (1,0) [0|0] "" Vector__XXX
 SG_ VCFRONT_a478_dcdcLVSupportStatus m478 : 32|2@1+ (1,0) [0|0] "" Vector__XXX
 SG_ VCFRONT_a479_batterySMState m479 : 32|4@1+ (1,0) [0|0] "" Vector__XXX
 SG_ VCFRONT_a480_deviceOvertemperatu m480 : 32|1@1+ (1,0) [0|0] "" Vector__XXX
 SG_ VCFRONT_a484_vehiclePitchWhenLas m484 : 32|10@1- (0.0001,0) [0|0] "" Vector__XXX
 SG_ VCFRONT_a492_maxBrickSocId m492 : 32|7@1+ (1,1) [0|0] "" Vector__XXX
 SG_ VCFRONT_a493_maxBrickSocId m493 : 32|7@1+ (1,1) [0|0] "" Vector__XXX
 SG_ VCFRONT_a497_PackCurrent m497 : 32|12@1+ (0.2,-600) [0|0] "" Vector__XXX
 SG_ VCFRONT_a509_vcrightEFuseTemp m509 : 32|8@1+ (0.75,0) [0|0] "" Vector__XXX
 SG_ VCFRONT_a510_targetPCSVoltage m510 : 32|8@1+ (0.1,0) [0|0] "" Vector__XXX
 SG_ VCFRONT_a511_DCDCMaxOutputCurren m511 : 32|16@1- (0.1,0) [0|0] "" Vector__XXX
 SG_ VCFRONT_a512_packTemperature m512 : 32|8@1+ (1,-40) [0|0] "" Vector__XXX
 SG_ VCFRONT_a513_packTemperature m513 : 32|8@1+ (1,-40) [0|0] "" Vector__XXX
 SG_ VCFRONT_a521_vcleftEFuseTemp m521 : 32|8@1+ (0.75,0) [0|0] "" Vector__XXX
 SG_ VCFRONT_a523_control2Byte2 m523 : 32|8@1+ (1,0) [0|0] "" Vector__XXX
 SG_ VCFRONT_a529_LVBatteryTemp m529 : 32|16@1- (0.01,0) [0|0] "" Vector__XXX
 SG_ VCFRONT_a530_IBSCurrent m530 : 32|16@1- (0.1,0) [0|0] "" Vector__XXX
 SG_ VCFRONT_a534_measuredOpenRange m534 : 32|8@1+ (7,0) [0|0] "" Vector__XXX
 SG_ VCFRONT_a535_measuredOpenRange m535 : 32|8@1+ (7,0) [0|0] "" Vector__XXX
 SG_ VCFRONT_a536_measuredOpenRange m536 : 32|8@1+ (7,0) [0|0] "" Vector__XXX
 SG_ VCFRONT_a537_measuredOpenRange m537 : 32|8@1+ (7,0) [0|0] "" Vector__XXX
 SG_ VCFRONT_a538_measuredOpenRange m538 : 32|8@1+ (7,0) [0|0] "" Vector__XXX
 SG_ VCFRONT_a539_measuredOpenRange m539 : 32|8@1+ (7,0) [0|0] "" Vector__XXX
 SG_ VCFRONT_a542_suctionPressure m542 : 32|6@1+ (0.5,0) [0|0] "" Vector__XXX
 SG_ VCFRONT_a548_BMS_MIA m548 : 32|1@1+ (1,0) [0|0] "" Vector__XXX
 SG_ VCFRONT_a561_cell1Voltage m561 : 32|7@1+ (0.04,0) [0|0] "" Vector__XXX
 SG_ VCFRONT_a562_cell1Voltage m562 : 32|7@1+ (0.04,0) [0|0] "" Vector__XXX
 SG_ VCFRONT_a565_UIUserActivity m565 : 32|1@1+ (1,0) [0|0] "" Vector__XXX
 SG_ VCFRONT_a572_hvacCompressorVolta m572 : 32|16@1+ (0.1,0) [0|0] "" Vector__XXX
 SG_ VCFRONT_a573_radarVoltage m573 : 32|16@1+ (0.1,0) [0|0] "" Vector__XXX
 SG_ VCFRONT_a574_frontDriveInverterV m574 : 32|16@1+ (0.1,0) [0|0] "" Vector__XXX
 SG_ VCFRONT_a575_frontOilPumpVoltage m575 : 32|16@1+ (0.1,0) [0|0] "" Vector__XXX
 SG_ VCFRONT_a576_mcuLogicVoltage m576 : 32|16@1+ (0.1,0) [0|0] "" Vector__XXX
 SG_ VCFRONT_a577_tasVoltage m577 : 32|16@1+ (0.1,0) [0|0] "" Vector__XXX
 SG_ VCFRONT_a578_vbatFusedLowCu_0000 m578 : 32|16@1+ (0.1,0) [0|0] "" Vector__XXX
 SG_ VCFRONT_a579_leftHeadlightVoltag m579 : 32|16@1+ (0.1,0) [0|0] "" Vector__XXX
 SG_ VCFRONT_a580_rightHeadlightVolta m580 : 32|16@1+ (0.1,0) [0|0] "" Vector__XXX
 SG_ VCFRONT_a581_windshieldWiperVolt m581 : 32|16@1+ (0.1,0) [0|0] "" Vector__XXX
 SG_ VCFRONT_a582_LVBusVoltage m582 : 32|8@1+ (0.1,0) [0|0] "" Vector__XXX
 SG_ VCFRONT_a583_switch2StuckReason m583 : 32|2@1+ (1,0) [0|0] "" Vector__XXX
 SG_ VCFRONT_a589_vcleftTimingThresho m589 : 32|16@1+ (1,0) [0|0] "" Vector__XXX
 SG_ VCFRONT_a591_vcrightTimingThresh m591 : 32|16@1+ (1,0) [0|0] "" Vector__XXX
 SG_ VCFRONT_a593_vcleftCutoffTimingT m593 : 32|16@1+ (1,0) [0|0] "" Vector__XXX
 SG_ VCFRONT_a594_virtualPitchLearned m594 : 32|9@1- (0.0005,0) [0|0] "" Vector__XXX
 SG_ VCFRONT_a597_vcrightCutoffTiming m597 : 32|16@1+ (1,0) [0|0] "" Vector__XXX
 SG_ VCFRONT_a608_bleedFetFailureBric m608 : 32|5@1+ (1,1) [0|0] "" Vector__XXX
 SG_ VCFRONT_a610_temperature m610 : 32|8@1+ (0.5,-40) [0|0] "" Vector__XXX
 SG_ VCFRONT_a612_lvHealthStatus m612 : 32|3@1+ (1,0) [0|0] "" Vector__XXX
 SG_ VCFRONT_a614_coolantLevelSensorF m614 : 32|1@1+ (1,0) [0|0] "" Vector__XXX
 SG_ VCFRONT_a618_evapOutTemp m618 : 32|6@1+ (1,0) [0|0] "" Vector__XXX
 SG_ VCFRONT_a619_temperature m619 : 32|8@1+ (0.5,-40) [0|0] "" Vector__XXX
 SG_ VCFRONT_a623_lvHealthStatus m623 : 32|3@1+ (1,0) [0|0] "" Vector__XXX
 SG_ VCFRONT_a628_lastMeasuredTemp m628 : 32|8@1+ (0.5,-20) [0|0] "" Vector__XXX
 SG_ VCFRONT_a635_requestSleepFailedB m635 : 32|16@1+ (1,0) [0|0] "" Vector__XXX
 SG_ VCFRONT_a643_uartConditionBitfie m643 : 32|16@1+ (1,0) [0|0] "" Vector__XXX
 SG_ VCFRONT_a645_averagePrimedFluidC m645 : 32|8@1- (0.0984251968503937,5.807086614173229) [0|0] "" Vector__XXX
 SG_ VCFRONT_a047_Ovdvccd m47 : 31|1@1+ (1,0) [0|0] "" Vector__XXX
 SG_ VCFRONT_a104_PARTY_integratedSaf m104 : 31|1@1+ (1,0) [0|0] "" Vector__XXX
 SG_ VCFRONT_a109_CH_status m109 : 31|1@1+ (1,0) [0|0] "" Vector__XXX
 SG_ VCFRONT_a110_CH_chNm m110 : 31|1@1+ (1,0) [0|0] "" Vector__XXX
 SG_ VCFRONT_a113_VEH_ventCntlReg m113 : 31|1@1+ (1,0) [0|0] "" Vector__XXX
 SG_ VCFRONT_a114_BDY_wheelRotation m114 : 31|1@1+ (1,0) [0|0] "" Vector__XXX
 SG_ VCFRONT_a116_VEH_thermalCommand m116 : 31|1@1+ (1,0) [0|0] "" Vector__XXX
 SG_ VCFRONT_a117_VEH_intrusionSensor m117 : 31|1@1+ (1,0) [0|0] "" Vector__XXX
 SG_ VCFRONT_a118_PARTY_sensors m118 : 31|1@1+ (1,0) [0|0] "" Vector__XXX
 SG_ VCFRONT_a120_VEH_systemPower m120 : 31|1@1+ (1,0) [0|0] "" Vector__XXX
 SG_ VCFRONT_a142_isCoilShortYPVbb m142 : 31|1@1+ (1,0) [0|0] "" Vector__XXX
 SG_ VCFRONT_a153_UIChargePortDoorReq m153 : 31|1@1+ (1,0) [0|0] "" Vector__XXX
 SG_ VCFRONT_a161_inverterOpenCircuit m161 : 31|1@1+ (1,0) [0|0] "" Vector__XXX
 SG_ VCFRONT_a171_EPBL m171 : 31|1@1+ (1,0) [0|0] "" Vector__XXX
 SG_ VCFRONT_a180_contactorEFuseStabl m180 : 31|1@1+ (1,0) [0|0] "" Vector__XXX
 SG_ VCFRONT_a182_instantPrechargeDCR m182 : 31|1@1+ (1,0) [0|0] "" Vector__XXX
 SG_ VCFRONT_a183_instantPrechargeDCR m183 : 31|1@1+ (1,0) [0|0] "" Vector__XXX
 SG_ VCFRONT_a192_LVBatteryCannotSupp m192 : 31|1@1+ (1,0) [0|0] "" Vector__XXX
 SG_ VCFRONT_a284_isCoilShortYPVbb m284 : 31|1@1+ (1,0) [0|0] "" Vector__XXX
 SG_ VCFRONT_a285_isCoilShortYPVbb m285 : 31|1@1+ (1,0) [0|0] "" Vector__XXX
 SG_ VCFRONT_a286_isCoilShortYPVbb m286 : 31|1@1+ (1,0) [0|0] "" Vector__XXX
 SG_ VCFRONT_a287_isCoilShortYPVbb m287 : 31|1@1+ (1,0) [0|0] "" Vector__XXX
 SG_ VCFRONT_a288_isCoilShortYPVbb m288 : 31|1@1+ (1,0) [0|0] "" Vector__XXX
 SG_ VCFRONT_a289_isCoilShortYPVbb m289 : 31|1@1+ (1,0) [0|0] "" Vector__XXX
 SG_ VCFRONT_a365_DIReportsUnavailabl m365 : 31|1@1+ (1,0) [0|0] "" Vector__XXX
 SG_ VCFRONT_a366_BMSSOCInvalid m366 : 31|1@1+ (1,0) [0|0] "" Vector__XXX
 SG_ VCFRONT_a387_opportunisticTest m387 : 31|1@1+ (1,0) [0|0] "" Vector__XXX
 SG_ VCFRONT_a388_opportunisticTest m388 : 31|1@1+ (1,0) [0|0] "" Vector__XXX
 SG_ VCFRONT_a390_quietModeEnabled m390 : 31|1@1+ (1,0) [0|0] "" Vector__XXX
 SG_ VCFRONT_a394_droopDetectedStands m394 : 31|1@1+ (1,0) [0|0] "" Vector__XXX
 SG_ VCFRONT_a402_reverseBatteryFault m402 : 31|1@1+ (1,0) [0|0] "" Vector__XXX
 SG_ VCFRONT_a403_IBSAmpHours m403 : 31|14@1- (0.01,0) [0|0] "" Vector__XXX
 SG_ VCFRONT_a414_IBSCurrent m414 : 31|12@1- (0.1,0) [0|0] "" Vector__XXX
 SG_ VCFRONT_a446_hpCabinLoadType m446 : 31|2@1+ (1,0) [0|0] "" Vector__XXX
 SG_ VCFRONT_a447_refrigSuctionTempCo m447 : 31|1@1+ (1,0) [0|0] "" Vector__XXX
 SG_ VCFRONT_a462_KBValueLostFault m462 : 31|1@1+ (1,0) [0|0] "" Vector__XXX
 SG_ VCFRONT_a476_frunkOpen m476 : 31|1@1+ (1,0) [0|0] "" Vector__XXX
 SG_ VCFRONT_a480_fuseLatch m480 : 31|1@1+ (1,0) [0|0] "" Vector__XXX
 SG_ VCFRONT_a498_measuredCurrent m498 : 31|10@1- (0.25,0) [0|0] "" Vector__XXX
 SG_ VCFRONT_a565_UIChargePortDoorReq m565 : 31|1@1+ (1,0) [0|0] "" Vector__XXX
 SG_ VCFRONT_a614_ptInletSensor m614 : 31|1@1+ (1,0) [0|0] "" Vector__XXX
 SG_ VCFRONT_a669_totalHvPowerBudget m669 : 31|6@1+ (0.5,0) [0|0] "" Vector__XXX
 SG_ VCFRONT_a047_Ovdvdda m47 : 30|1@1+ (1,0) [0|0] "" Vector__XXX
 SG_ VCFRONT_a104_VEH_steeringControl m104 : 30|1@1+ (1,0) [0|0] "" Vector__XXX
 SG_ VCFRONT_a109_CH_inertial2 m109 : 30|1@1+ (1,0) [0|0] "" Vector__XXX
 SG_ VCFRONT_a110_CH_vin m110 : 30|1@1+ (1,0) [0|0] "" Vector__XXX
 SG_ VCFRONT_a113_VEH_driverProf_0000 m113 : 30|1@1+ (1,0) [0|0] "" Vector__XXX
 SG_ VCFRONT_a114_BDY_status m114 : 30|1@1+ (1,0) [0|0] "" Vector__XXX
 SG_ VCFRONT_a116_VEH_status m116 : 30|1@1+ (1,0) [0|0] "" Vector__XXX
 SG_ VCFRONT_a117_VEH_switchStatus m117 : 30|1@1+ (1,0) [0|0] "" Vector__XXX
 SG_ VCFRONT_a118_CH_LVPowerState m118 : 30|1@1+ (1,0) [0|0] "" Vector__XXX
 SG_ VCFRONT_a120_PARTY_aggregatedAxl m120 : 30|1@1+ (1,0) [0|0] "" Vector__XXX
 SG_ VCFRONT_a142_isCoilShortYPGnd m142 : 30|1@1+ (1,0) [0|0] "" Vector__XXX
 SG_ VCFRONT_a153_chargePortDoorOpen m153 : 30|1@1+ (1,0) [0|0] "" Vector__XXX
 SG_ VCFRONT_a161_internalPowerSupply m161 : 30|1@1+ (1,0) [0|0] "" Vector__XXX
 SG_ VCFRONT_a171_EPBR m171 : 30|1@1+ (1,0) [0|0] "" Vector__XXX
 SG_ VCFRONT_a178_pressureDischarge m178 : 30|5@1+ (1,0) [0|0] "" Vector__XXX
 SG_ VCFRONT_a180_vcrightEFuseStable m180 : 30|1@1+ (1,0) [0|0] "" Vector__XXX
 SG_ VCFRONT_a182_cellImbalance m182 : 30|1@1+ (1,0) [0|0] "" Vector__XXX
 SG_ VCFRONT_a183_cellImbalance m183 : 30|1@1+ (1,0) [0|0] "" Vector__XXX
 SG_ VCFRONT_a192_disconnected12V m192 : 30|1@1+ (1,0) [0|0] "" Vector__XXX
 SG_ VCFRONT_a197_pctValidIBSSamples m197 : 30|8@1+ (0.5,0) [0|0] "" Vector__XXX
 SG_ VCFRONT_a250_calibratedVert_0000 m250 : 30|10@1+ (1,0) [0|0] "" Vector__XXX
 SG_ VCFRONT_a284_isCoilShortYPGnd m284 : 30|1@1+ (1,0) [0|0] "" Vector__XXX
 SG_ VCFRONT_a285_isCoilShortYPGnd m285 : 30|1@1+ (1,0) [0|0] "" Vector__XXX
 SG_ VCFRONT_a286_isCoilShortYPGnd m286 : 30|1@1+ (1,0) [0|0] "" Vector__XXX
 SG_ VCFRONT_a287_isCoilShortYPGnd m287 : 30|1@1+ (1,0) [0|0] "" Vector__XXX
 SG_ VCFRONT_a288_isCoilShortYPGnd m288 : 30|1@1+ (1,0) [0|0] "" Vector__XXX
 SG_ VCFRONT_a289_isCoilShortYPGnd m289 : 30|1@1+ (1,0) [0|0] "" Vector__XXX
 SG_ VCFRONT_a365_DIReportsCompleted m365 : 30|1@1+ (1,0) [0|0] "" Vector__XXX
 SG_ VCFRONT_a366_DIReportsUnavailabl m366 : 30|1@1+ (1,0) [0|0] "" Vector__XXX
 SG_ VCFRONT_a394_droopDetected m394 : 30|1@1+ (1,0) [0|0] "" Vector__XXX
 SG_ VCFRONT_a402_communicationDiscon m402 : 30|1@1+ (1,0) [0|0] "" Vector__XXX
 SG_ VCFRONT_a429_usableCapacity m429 : 30|10@1+ (0.025,-0.025) [0|0] "" Vector__XXX
 SG_ VCFRONT_a446_compStandbyMul_0000 m446 : 30|1@1+ (1,0) [0|0] "" Vector__XXX
 SG_ VCFRONT_a447_refrigSuctionPressC m447 : 30|1@1+ (1,0) [0|0] "" Vector__XXX
 SG_ VCFRONT_a462_NTCTempDiffWarnLeve m462 : 30|1@1+ (1,0) [0|0] "" Vector__XXX
 SG_ VCFRONT_a474_ssl100Bank8Status m474 : 30|2@1+ (1,0) [0|0] "" Vector__XXX
 SG_ VCFRONT_a475_ssl100Bank8Status m475 : 30|2@1+ (1,0) [0|0] "" Vector__XXX
 SG_ VCFRONT_a476_transportMode m476 : 30|1@1+ (1,0) [0|0] "" Vector__XXX
 SG_ VCFRONT_a480_bypassSaturation m480 : 30|1@1+ (1,0) [0|0] "" Vector__XXX
 SG_ VCFRONT_a482_previousAimedPositi m482 : 30|10@1+ (1,0) [0|0] "" Vector__XXX
 SG_ VCFRONT_a485_previousAimedPositi m485 : 30|10@1+ (1,0) [0|0] "" Vector__XXX
 SG_ VCFRONT_a508_brickImpedanceNorma m508 : 30|10@1+ (0.002,0.5) [0|0] "" Vector__XXX
 SG_ VCFRONT_a514_cell3Voltage m514 : 30|7@1+ (0.08,0) [0|0] "" Vector__XXX
 SG_ VCFRONT_a515_cell3Voltage m515 : 30|7@1+ (0.08,0) [0|0] "" Vector__XXX
 SG_ VCFRONT_a565_chargePortDoorOpen m565 : 30|1@1+ (1,0) [0|0] "" Vector__XXX
 SG_ VCFRONT_a583_switch1StuckReason m583 : 30|2@1+ (1,0) [0|0] "" Vector__XXX
 SG_ VCFRONT_a606_chillerLoadAtExit m606 : 30|7@1+ (50.38582677165354,0) [0|0] "" Vector__XXX
 SG_ VCFRONT_alertID M : 0|10@1+ (1,0) [0|0] "" Vector__XXX

CM_ BO_ 1328 "ESP32-DualCAN Model3_VEH. Seen on this car: 8-byte frames; fit good (bits covered 100%, mux 72%, ranges 100%).";
VAL_ 1328 VCSEC_a104_BDY_status 0 "DISABLED" 1 "ENABLED" 2 "TEMPORARY_FAILURE" 3 "SNA" ;
VAL_ 1328 VCSEC_a117_VEH_status 0 "DISABLED" 1 "ENABLED" 2 "TEMPORARY_FAILURE" 3 "SNA" ;
VAL_ 1328 VCSEC_a114_CH_status 0 "DISABLED" 1 "ENABLED" 2 "TEMPORARY_FAILURE" 3 "SNA" ;
VAL_ 1328 VCSEC_a104_VEH_status 0 "DISABLED" 1 "ENABLED" 2 "TEMPORARY_FAILURE" 3 "SNA" ;
VAL_ 1328 VCSEC_a113_VEH_status 0 "DISABLED" 1 "ENABLED" 2 "TEMPORARY_FAILURE" 3 "SNA" ;
VAL_ 1328 VCSEC_a436_countryCode 0 "UNKNOWN" 1023 "SNA" ;
VAL_ 1328 VCSEC_a109_CH_status 0 "DISABLED" 1 "ENABLED" 2 "TEMPORARY_FAILURE" 3 "SNA" ;
VAL_ 1328 VCSEC_a114_BDY_status 0 "DISABLED" 1 "ENABLED" 2 "TEMPORARY_FAILURE" 3 "SNA" ;
VAL_ 1328 VCSEC_a116_VEH_status 0 "DISABLED" 1 "ENABLED" 2 "TEMPORARY_FAILURE" 3 "SNA" ;
VAL_ 1328 VCSEC_a111_CH_status 0 "DISABLED" 1 "ENABLED" 2 "TEMPORARY_FAILURE" 3 "SNA" ;
VAL_ 1328 VCSEC_a120_PT_systemStatus 0 "UNKNOWN" 1 "RELEASED" 2 "PARKED" 3 "DYNAMIC" 4 "PARKING" 5 "RELEASING" 6 "FAULT" 7 "FAULT_SECURE" 8 "MISMATCH" ;
VAL_ 1328 VCSEC_a104_PARTY_status 0 "DISABLED" 1 "ENABLED" 2 "TEMPORARY_FAILURE" 3 "SNA" ;
VAL_ 1328 VCSEC_a109_BDY_status 0 "DISABLED" 1 "ENABLED" 2 "TEMPORARY_FAILURE" 3 "SNA" ;
VAL_ 1328 VCSEC_a110_CH_airbagCutoffStatus 0 "RCM_PASSENGER_AIRBAG_ENABLED" 1 "RCM_PASSENGER_AIRBAG_DISABLED" 3 "SNA" ;
VAL_ 1328 VCSEC_a111_PARTY_status 0 "DISABLED" 1 "ENABLED" 2 "TEMPORARY_FAILURE" 3 "SNA" ;
VAL_ 1328 VCSEC_a112_CH_status 0 "DISABLED" 1 "ENABLED" 2 "TEMPORARY_FAILURE" 3 "SNA" ;
VAL_ 1328 VCSEC_a104_CH_status 0 "DISABLED" 1 "ENABLED" 2 "TEMPORARY_FAILURE" 3 "SNA" ;
VAL_ 1328 VCSEC_a112_PARTY_status 0 "DISABLED" 1 "ENABLED" 2 "TEMPORARY_FAILURE" 3 "SNA" ;
VAL_ 1328 VCSEC_a118_VEH_systemStatus 0 "UNKNOWN" 1 "RELEASED" 2 "PARKED" 3 "DYNAMIC" 4 "PARKING" 5 "RELEASING" 6 "FAULT" 7 "FAULT_SECURE" 8 "MISMATCH" ;
VAL_ 1328 VCSEC_a120_PARTY_status 0 "DISABLED" 1 "ENABLED" 2 "TEMPORARY_FAILURE" 3 "SNA" ;
VAL_ 1328 VCSEC_a107_PT_status 0 "DISABLED" 1 "ENABLED" 2 "TEMPORARY_FAILURE" 3 "SNA" ;
VAL_ 1328 VCSEC_a086_VEH_systemStatus 0 "UNKNOWN" 1 "RELEASED" 2 "PARKED" 3 "DYNAMIC" 4 "PARKING" 5 "RELEASING" 6 "FAULT" 7 "FAULT_SECURE" 8 "MISMATCH" ;
VAL_ 1328 VCSEC_a098_PARTY_status 0 "DISABLED" 1 "ENABLED" 2 "TEMPORARY_FAILURE" 3 "SNA" ;
VAL_ 1328 VCSEC_a108_PARTY_status 0 "DISABLED" 1 "ENABLED" 2 "TEMPORARY_FAILURE" 3 "SNA" ;
VAL_ 1328 VCSEC_a114_VEH_status 0 "DISABLED" 1 "ENABLED" 2 "TEMPORARY_FAILURE" 3 "SNA" ;
VAL_ 1328 VCSEC_a087_PARTY_status 0 "DISABLED" 1 "ENABLED" 2 "TEMPORARY_FAILURE" 3 "SNA" ;
VAL_ 1328 VCSEC_a088_PARTY_status 0 "DISABLED" 1 "ENABLED" 2 "TEMPORARY_FAILURE" 3 "SNA" ;
VAL_ 1328 VCSEC_a089_CH_status 0 "DISABLED" 1 "ENABLED" 2 "TEMPORARY_FAILURE" 3 "SNA" ;
VAL_ 1328 VCSEC_a089_BDY_status 0 "DISABLED" 1 "ENABLED" 2 "TEMPORARY_FAILURE" 3 "SNA" ;
VAL_ 1328 VCSEC_a103_PT_status 0 "DISABLED" 1 "ENABLED" 2 "TEMPORARY_FAILURE" 3 "SNA" ;
VAL_ 1328 VCSEC_a108_VEH_status 0 "DISABLED" 1 "ENABLED" 2 "TEMPORARY_FAILURE" 3 "SNA" ;
VAL_ 1328 VCSEC_a109_VEH_status 0 "DISABLED" 1 "ENABLED" 2 "TEMPORARY_FAILURE" 3 "SNA" ;
VAL_ 1328 VCSEC_a087_VEH_status 0 "DISABLED" 1 "ENABLED" 2 "TEMPORARY_FAILURE" 3 "SNA" ;
VAL_ 1328 VCSEC_a088_VEH_status 0 "DISABLED" 1 "ENABLED" 2 "TEMPORARY_FAILURE" 3 "SNA" ;
VAL_ 1328 VCSEC_a118_VEH_status 0 "DISABLED" 1 "ENABLED" 2 "TEMPORARY_FAILURE" 3 "SNA" ;
VAL_ 1328 VCSEC_a120_PARTY_systemStatus 0 "UNKNOWN" 1 "RELEASED" 2 "PARKED" 3 "DYNAMIC" 4 "PARKING" 5 "RELEASING" 6 "FAULT" 7 "FAULT_SECURE" 8 "MISMATCH" ;
VAL_ 1328 VCSEC_a086_VEH_status 0 "DISABLED" 1 "ENABLED" 2 "TEMPORARY_FAILURE" 3 "SNA" ;
VAL_ 1328 VCSEC_a089_VEH_status 0 "DISABLED" 1 "ENABLED" 2 "TEMPORARY_FAILURE" 3 "SNA" ;
VAL_ 1328 VCSEC_a091_VEH_state 0 "STANDBY" 1 "DRIVE" 2 "SUPPORT" 3 "CHARGE" 4 "FEIM" 5 "CLEAR_FAULT" 6 "FAULT" 7 "WELD" 8 "TEST" 9 "SNA" 10 "DIAG" ;
VAL_ 1328 VCSEC_a098_VEH_status 0 "DISABLED" 1 "ENABLED" 2 "TEMPORARY_FAILURE" 3 "SNA" ;
VAL_ 1328 VCSEC_a103_VEH_status 0 "DISABLED" 1 "ENABLED" 2 "TEMPORARY_FAILURE" 3 "SNA" ;
VAL_ 1328 VCSEC_a107_VEH_status 0 "DISABLED" 1 "ENABLED" 2 "TEMPORARY_FAILURE" 3 "SNA" ;
VAL_ 1328 VCSEC_a089_PARTY_status 0 "DISABLED" 1 "ENABLED" 2 "TEMPORARY_FAILURE" 3 "SNA" ;
VAL_ 1328 VCSEC_a090_VEH_state 0 "STANDBY" 1 "DRIVE" 2 "SUPPORT" 3 "CHARGE" 4 "FEIM" 5 "CLEAR_FAULT" 6 "FAULT" 7 "WELD" 8 "TEST" 9 "SNA" 10 "DIAG" ;
VAL_ 1328 VCSEC_a095_PT_status 0 "DISABLED" 1 "ENABLED" 2 "TEMPORARY_FAILURE" 3 "SNA" ;
VAL_ 1328 VCSEC_a096_CH_status 0 "DISABLED" 1 "ENABLED" 2 "TEMPORARY_FAILURE" 3 "SNA" ;
VAL_ 1328 VCSEC_a097_VEH_state 0 "STANDBY" 1 "DRIVE" 2 "SUPPORT" 3 "CHARGE" 4 "FEIM" 5 "CLEAR_FAULT" 6 "FAULT" 7 "WELD" 8 "TEST" 9 "SNA" 10 "DIAG" ;
VAL_ 1328 VCSEC_a111_VEH_status 0 "DISABLED" 1 "ENABLED" 2 "TEMPORARY_FAILURE" 3 "SNA" ;
VAL_ 1328 VCSEC_a112_VEH_status 0 "DISABLED" 1 "ENABLED" 2 "TEMPORARY_FAILURE" 3 "SNA" ;
VAL_ 1328 VCSEC_a120_VEH_systemStatus 0 "UNKNOWN" 1 "RELEASED" 2 "PARKED" 3 "DYNAMIC" 4 "PARKING" 5 "RELEASING" 6 "FAULT" 7 "FAULT_SECURE" 8 "MISMATCH" ;
VAL_ 1328 VCSEC_a031_uds_bytes_0 0 "0" 1 "1" 2 "2" 3 "3" 4 "4" 5 "5" 6 "6" 7 "7" 8 "8" 9 "9" 10 "10" 11 "11" 12 "12" 13 "13" 14 "14" 15 "15" 16 "16" 17 "17" 18 "18" 19 "19" 20 "20" 21 "21" 22 "22" 23 "23" 24 "24" 25 "25" 26 "26" 27 "27" 28 "28" 29 "29" 30 "30" 31 "31" ;
VAL_ 1328 VCSEC_a096_VEH_status 0 "DISABLED" 1 "ENABLED" 2 "TEMPORARY_FAILURE" 3 "SNA" ;
VAL_ 1328 VCSEC_a101_VEH_state 0 "STANDBY" 1 "DRIVE" 2 "SUPPORT" 3 "CHARGE" 4 "FEIM" 5 "CLEAR_FAULT" 6 "FAULT" 7 "WELD" 8 "TEST" 9 "SNA" 10 "DIAG" ;
VAL_ 1328 VCSEC_a109_PARTY_status 0 "DISABLED" 1 "ENABLED" 2 "TEMPORARY_FAILURE" 3 "SNA" ;
VAL_ 1328 VCSEC_a114_PARTY_status 0 "DISABLED" 1 "ENABLED" 2 "TEMPORARY_FAILURE" 3 "SNA" ;
VAL_ 1328 VCSEC_a121_VEH_status 0 "DISABLED" 1 "ENABLED" 2 "TEMPORARY_FAILURE" 3 "SNA" ;
VAL_ 1328 VCSEC_a221_countryCode 0 "UNKNOWN" 1023 "SNA" ;
VAL_ 1328 VCSEC_alertState 0 "CLEARED" 1 "SET" ;
VAL_ 1328 VCSEC_alertID 0 "ALERT_DO_NOT_USE_ZERO" 1 "a001_DriverDoorOpen" 2 "a002_DoorOpen" 3 "a003_TrunkOpen" 4 "a004_FrunkOpen" 5 "a005_HeadlightsOnDoorOpen" 6 "a006_RemoteServiceAlert" 7 "a007_SoftPackConfigMismatch" 8 "a008_TouchScreenError" 9 "a009_SquashfsError" 10 "a010_MapsMissing" 11 "a011_IncorrectMap" 12 "a012_NotOnPrivateProperty" 13 "a013_TPMSHardWarning" 14 "a014_TPMSSoftWarning" 15 "a015_TPMSOverPressureWarning" 16 "a016_TPMSTemperatureWarning" 17 "a017_TPMSSystemFault" 18 "a018_SlipStartOn" 19 "a019_ParkBrakeFault" 20 "a020_SteeringReduced" 21 "a021_RearSeatbeltUnbuckled" 22 "a022_ApeFusesEtc" 23 "a023_CellInternetCheckFailed" 24 "a024_WifiInternetCheckFailed" 25 "a025_WifiOnlineCheckFailed" 26 "a026_ModemResetLoopDetected" 27 "a027_AutoSteerMIA" 28 "a028_FrontTrunkPopupClosed" 29 "a029_ModemMIA" 30 "a030_ModemVMCrash" 31 "a031_BrakeFluidLow" 32 "a032_CellModemRecoveryResets" 33 "a033_ApTrialExpired" 34 "a034_WakeupProblem" 35 "a035_AudioWatchdogKernelError" 36 "a036_AudioWatchdogHfpError" 37 "a037_AudioWatchdogXrunStormError" 38 "a038_AudioWatchdogA2bI2cLockupError" 39 "a039_AudioA2bNeedRediscovery" 40 "a040_HomelinkTransmit" 41 "a041_AudioDmesgXrun" 42 "a042_AudioDmesgRtThrottling" 43 "a043_InvalidMapDataOverride" 44 "a044_AudioDmesgDspException" 45 "a045_ECallNeedsService" 46 "a046_BackupCameraStreamError" 47 "a047_CellRoamingDisallowed" 48 "a048_AudioPremiumAmpCheckFailed" 49 "a049_BrakeShiftRequired" 50 "a050_BackupCameraIPUTimeout" 51 "a051_BackupCameraFrameTimeout" 52 "a052_KernelPanicReported" 53 "a053_QtCarExitError" 54 "a054_AudioBoostPowerBad" 55 "a055_ManualECallDisabled" 56 "a056_ManualECallButtonDisconnected" 57 "a057_CellAntennaDisconnected" 58 "a058_GPSAntennaDisconnected" 59 "a059_ECallSpeakerDisconnected" 60 "a060_ECallMicDisconnected" 61 "a061_SIMTestFailed" 62 "a062_ENSTestFailed" 63 "a063_CellularTestFailed" 64 "a064_ModemFirmwareTestFailed" 65 "a065_WiFiRecoveryReset" 66 "a066_GpuHangDetected" 67 "a067_WarnOnI915" 68 "a068_VideoUnexpectedExit" 69 "a069_VideoUDPTimeout" 70 "a070_VideoPipelineWarning" 71 "a071_VideoPipelineError" 72 "a072_ECallAnalogMicFailed" 73 "a073_ECallDigitalMicFailed" 74 "a074_EMMCHangDetected" 75 "a075_BackupCameraInitError" 76 "a076_NumFalseManualECalls" 77 "a077_AudioA2bMicChannelSwap" 78 "a078_DashcamUsbDriveUnmountable" 79 "a079_DashcamUsbDriveFull" 80 "a080_DashcamUsbDriveSlow" 81 "a081_CellModemSearchExpired" 82 "a082_NumModemRebootStuckInECall" 83 "a083_ECallProxyWatchdogTriggered" 84 "a084_SerializerError" 85 "a085_DeserializerError" 86 "a086_TouchEnumerationError" 87 "a087_BmpReset" 88 "a088_CellRemovableSimMissing" 89 "a089_RadioSoftResetError" 90 "a090_RadioPingFailError" 91 "a091_VehicleLinkStall" 92 "a092_updateStarted" 93 "a093_updateEnded" 94 "a094_ModemPowerOnFailure" 95 "a095_CidStorageRunningLow" 96 "a096_VideodPipelineIssueDetected" 97 "a097_AudiodRestarted" 98 "a098_DiskCheckFailure" 99 "a099_eMMCStatusError" 100 "a100_eMMCFTLError" 101 "a101_wifiStackProblem" 102 "a102_A2bDiscoveryFailed" 103 "a103_UsbHubNotEnumerating" 104 "a104_DashcamUsbDriveMissing" 105 "a105_firmwareReinstallRequested" 106 "a106_rebootBackstopTriggered" 107 "a107_DashcamUsbDriveTooBigForVfatFsck" 108 "a108_DashcamUsbDriveGettingFull" 109 "a109_DashcamUsbDriveTooSmall" 110 "a110_DashcamUsbDriveCorrupt" 111 "a111_DashcamUsbDriveWrongPort" 112 "a112_badUSBDevice" 113 "a113_DashcamHasOnboardSentryClips" ;
CM_ BO_ 1330 "ESP32-DualCAN Model3_VEH. Not seen on this car in the logs.";
CM_ BO_ 1331 "ESP32-DualCAN Model3_VEH. Not seen on this car in the logs.";
CM_ BO_ 1332 "ESP32-DualCAN Model3_VEH. Seen on this car: 8-byte frames; fit ok (bits covered 100%, mux 0%, ranges 100%).";
VAL_ 1332 VCFRONT_a172_serviceMode 0 "DISABLED" 1 "ENABLED" ;
VAL_ 1332 VCFRONT_a173_serviceMode 0 "DISABLED" 1 "ENABLED" ;
VAL_ 1332 VCFRONT_a412_serviceMode 0 "DISABLED" 1 "ENABLED" ;
VAL_ 1332 VCFRONT_a414_vehiclePowerState 0 "OFF" 1 "CONDITIONING" 2 "ACCESSORY" 3 "DRIVE" ;
VAL_ 1332 VCFRONT_a514_vehiclePowerState 0 "OFF" 1 "CONDITIONING" 2 "ACCESSORY" 3 "DRIVE" ;
VAL_ 1332 VCFRONT_a515_vehiclePowerState 0 "OFF" 1 "CONDITIONING" 2 "ACCESSORY" 3 "DRIVE" ;
VAL_ 1332 VCFRONT_a477_serviceMode 0 "DISABLED" 1 "ENABLED" ;
VAL_ 1332 VCFRONT_a518_vehiclePowerState 0 "OFF" 1 "CONDITIONING" 2 "ACCESSORY" 3 "DRIVE" ;
VAL_ 1332 VCFRONT_a561_serviceMode 0 "DISABLED" 1 "ENABLED" ;
VAL_ 1332 VCFRONT_a562_serviceMode 0 "DISABLED" 1 "ENABLED" ;
VAL_ 1332 VCFRONT_a627_serviceMode 0 "DISABLED" 1 "ENABLED" ;
VAL_ 1332 VCFRONT_a513_vehiclePowerState 0 "OFF" 1 "CONDITIONING" 2 "ACCESSORY" 3 "DRIVE" ;
VAL_ 1332 VCFRONT_a514_serviceMode 0 "DISABLED" 1 "ENABLED" ;
VAL_ 1332 VCFRONT_a515_serviceMode 0 "DISABLED" 1 "ENABLED" ;
VAL_ 1332 VCFRONT_a561_factoryMode 0 "DISABLED" 1 "ENABLED" ;
VAL_ 1332 VCFRONT_a562_factoryMode 0 "DISABLED" 1 "ENABLED" ;
VAL_ 1332 VCFRONT_a518_serviceMode 0 "DISABLED" 1 "ENABLED" ;
VAL_ 1332 VCFRONT_a047_SingleCoreM4_M7_0 0 "0" 1 "1" 2 "2" 3 "3" 4 "4" 5 "5" 6 "6" 7 "7" 8 "8" 9 "9" 10 "10" 11 "11" 12 "12" 13 "13" 14 "14" 15 "15" 16 "16" 17 "17" 18 "18" 19 "19" 20 "20" 21 "21" 22 "22" 23 "23" 24 "24" 25 "25" 26 "26" 27 "27" 28 "28" 29 "29" 30 "30" 31 "31" ;
VAL_ 1332 VCFRONT_a513_serviceMode 0 "DISABLED" 1 "ENABLED" ;
VAL_ 1332 VCFRONT_a623_serviceMode 0 "DISABLED" 1 "ENABLED" ;
VAL_ 1332 VCFRONT_a253_serviceMode 0 "DISABLED" 1 "ENABLED" ;
VAL_ 1332 VCFRONT_a623_factoryMode 0 "DISABLED" 1 "ENABLED" ;
VAL_ 1332 VCFRONT_a196_ECPAState 0 "OPEN" 1 "CLOSED" 2 "INVALID" 3 "SNA" ;
VAL_ 1332 VCFRONT_a242_vehiclePowerState 0 "OFF" 1 "CONDITIONING" 2 "ACCESSORY" 3 "DRIVE" ;
VAL_ 1332 VCFRONT_a269_vehiclePowerState 0 "OFF" 1 "CONDITIONING" 2 "ACCESSORY" 3 "DRIVE" ;
VAL_ 1332 VCFRONT_a527_serviceMode 0 "DISABLED" 1 "ENABLED" ;
VAL_ 1332 VCFRONT_a541_SOC 127 "SNA" ;
VAL_ 1332 VCFRONT_a260_serviceMode 0 "DISABLED" 1 "ENABLED" ;
VAL_ 1332 VCFRONT_a359_serviceMode 0 "DISABLED" 1 "ENABLED" ;
VAL_ 1332 VCFRONT_a511_serviceMode 0 "DISABLED" 1 "ENABLED" ;
VAL_ 1332 VCFRONT_a197_serviceMode 0 "DISABLED" 1 "ENABLED" ;
VAL_ 1332 VCFRONT_a415_vehiclePowerState 0 "OFF" 1 "CONDITIONING" 2 "ACCESSORY" 3 "DRIVE" ;
VAL_ 1332 VCFRONT_a406_IBSTemperature 32767 "IBS_TEMPERATURE_SNA" ;
VAL_ 1332 VCFRONT_a561_cell4Voltage 65535 "SNA" ;
VAL_ 1332 VCFRONT_a562_cell4Voltage 65535 "SNA" ;
VAL_ 1332 VCFRONT_a370_SOC 127 "SNA" ;
VAL_ 1332 VCFRONT_a407_IBSTemperature 32767 "IBS_TEMPERATURE_SNA" ;
VAL_ 1332 VCFRONT_a477_sumCellVoltage 65534 "INVALID" 65535 "SNA" ;
VAL_ 1332 VCFRONT_a512_vehiclePowerState 0 "OFF" 1 "CONDITIONING" 2 "ACCESSORY" 3 "DRIVE" ;
VAL_ 1332 VCFRONT_a559_transportMode 0 "DISABLED" 1 "ENABLED" ;
VAL_ 1332 VCFRONT_a600_version 254 "LOCAL_BUILD" 255 "SNA" ;
VAL_ 1332 VCFRONT_a626_IBSTemperature 32767 "IBS_TEMPERATURE_SNA" ;
VAL_ 1332 VCFRONT_a627_sumCellVoltage 65534 "INVALID" 65535 "SNA" ;
VAL_ 1332 VCFRONT_a559_serviceMode 0 "DISABLED" 1 "ENABLED" ;
VAL_ 1332 VCFRONT_a191_vehicleLoadShedStag 0 "IDLE_OR_UNDEFINED" 1 "1" 2 "2" 3 "3" ;
VAL_ 1332 VCFRONT_a512_serviceMode 0 "DISABLED" 1 "ENABLED" ;
VAL_ 1332 VCFRONT_a559_factoryMode 0 "DISABLED" 1 "ENABLED" ;
VAL_ 1332 VCFRONT_a180_IBSVoltage 4095 "SNA" ;
VAL_ 1332 VCFRONT_a191_serviceMode 0 "DISABLED" 1 "ENABLED" ;
VAL_ 1332 VCFRONT_a359_hvState 0 "DOWN" 1 "COMING_UP" 2 "GOING_DOWN" 3 "UP_FOR_DRIVE" 4 "UP_FOR_CHARGE" 5 "UP_FOR_DC_CHARGE" 6 "UP" ;
VAL_ 1332 VCFRONT_a509_serviceMode 0 "DISABLED" 1 "ENABLED" ;
VAL_ 1332 VCFRONT_a511_hvState 0 "DOWN" 1 "COMING_UP" 2 "GOING_DOWN" 3 "UP_FOR_DRIVE" 4 "UP_FOR_CHARGE" 5 "UP_FOR_DC_CHARGE" 6 "UP" ;
VAL_ 1332 VCFRONT_a521_serviceMode 0 "DISABLED" 1 "ENABLED" ;
VAL_ 1332 VCFRONT_a171_serviceMode 0 "DISABLED" 1 "ENABLED" ;
VAL_ 1332 VCFRONT_a527_cell4Voltage 65535 "SNA" ;
VAL_ 1332 VCFRONT_a555_cell4Voltage 65535 "SNA" ;
VAL_ 1332 VCFRONT_a561_cell3Voltage 65535 "SNA" ;
VAL_ 1332 VCFRONT_a562_cell3Voltage 65535 "SNA" ;
VAL_ 1332 VCFRONT_a548_serviceMode 0 "DISABLED" 1 "ENABLED" ;
VAL_ 1332 VCFRONT_a191_ECPAState 0 "OPEN" 1 "CLOSED" 2 "INVALID" 3 "SNA" ;
VAL_ 1332 VCFRONT_a514_packVoltage 65535 "SNA" ;
VAL_ 1332 VCFRONT_a515_packVoltage 65535 "SNA" ;
VAL_ 1332 VCFRONT_a414_IBSVoltage 4095 "SNA" ;
VAL_ 1332 VCFRONT_a477_cell4Voltage 65535 "SNA" ;
VAL_ 1332 VCFRONT_a627_cell4Voltage 65535 "SNA" ;
VAL_ 1332 VCFRONT_a260_batterySMState 0 "INIT" 1 "CHARGE" 2 "DISCHARGE" 3 "STANDBY" 4 "RESISTANCE_ESTIMATION" 5 "OTA_STANDBY" 6 "DISCONNECTED_BATTERY_TEST" 7 "SHORTED_CELL_TEST" 8 "FAULT" 9 "RECOVERY" ;
VAL_ 1332 VCFRONT_a359_batterySMState 0 "INIT" 1 "CHARGE" 2 "DISCHARGE" 3 "STANDBY" 4 "RESISTANCE_ESTIMATION" 5 "OTA_STANDBY" 6 "DISCONNECTED_BATTERY_TEST" 7 "SHORTED_CELL_TEST" 8 "FAULT" 9 "RECOVERY" ;
VAL_ 1332 VCFRONT_a370_sleepCurrent 4095 "SNA" ;
VAL_ 1332 VCFRONT_a370_serviceMode 0 "DISABLED" 1 "ENABLED" ;
VAL_ 1332 VCFRONT_a220_serviceMode 0 "DISABLED" 1 "ENABLED" ;
VAL_ 1332 VCFRONT_a260_vehiclePowerState 0 "OFF" 1 "CONDITIONING" 2 "ACCESSORY" 3 "DRIVE" ;
VAL_ 1332 VCFRONT_a359_vehiclePowerState 0 "OFF" 1 "CONDITIONING" 2 "ACCESSORY" 3 "DRIVE" ;
VAL_ 1332 VCFRONT_a389_latchStatus 0 "SNA" 1 "OPENED" 2 "CLOSED" 3 "CLOSING" 4 "OPENING" 5 "AJAR" 6 "TIMEOUT" 7 "DEFAULT" 8 "FAULT" ;
VAL_ 1332 VCFRONT_a472_headlampTemperature 31 "SNA" ;
VAL_ 1332 VCFRONT_a473_headlampTemperature 31 "SNA" ;
VAL_ 1332 VCFRONT_a509_ambientTemp 4294966273 "SNA" ;
VAL_ 1332 VCFRONT_a510_serviceMode 0 "DISABLED" 1 "ENABLED" ;
VAL_ 1332 VCFRONT_a512_sumCellVoltage 65534 "INVALID" 65535 "SNA" ;
VAL_ 1332 VCFRONT_a513_packVoltage 65535 "SNA" ;
VAL_ 1332 VCFRONT_a521_ambientTemp 4294966273 "SNA" ;
VAL_ 1332 VCFRONT_a559_batterySMState 0 "INIT" 1 "CHARGE" 2 "DISCHARGE" 3 "STANDBY" 4 "RESISTANCE_ESTIMATION" 5 "OTA_STANDBY" 6 "DISCONNECTED_BATTERY_TEST" 7 "SHORTED_CELL_TEST" 8 "FAULT" 9 "RECOVERY" ;
VAL_ 1332 VCFRONT_a104_BDY_status 0 "DISABLED" 1 "ENABLED" 2 "TEMPORARY_FAILURE" 3 "SNA" ;
VAL_ 1332 VCFRONT_a462_serviceMode 0 "DISABLED" 1 "ENABLED" ;
VAL_ 1332 VCFRONT_a561_cell2Voltage 65535 "SNA" ;
VAL_ 1332 VCFRONT_a562_cell2Voltage 65535 "SNA" ;
VAL_ 1332 VCFRONT_a180_transportMode 0 "DISABLED" 1 "ENABLED" ;
VAL_ 1332 VCFRONT_a415_IBSVoltage 4095 "SNA" ;
VAL_ 1332 VCFRONT_a476_ECPAState 0 "OPEN" 1 "CLOSED" 2 "INVALID" 3 "SNA" ;
VAL_ 1332 VCFRONT_a595_IBSVoltage 4095 "SNA" ;
VAL_ 1332 VCFRONT_a117_VEH_status 0 "DISABLED" 1 "ENABLED" 2 "TEMPORARY_FAILURE" 3 "SNA" ;
VAL_ 1332 VCFRONT_a180_serviceMode 0 "DISABLED" 1 "ENABLED" ;
VAL_ 1332 VCFRONT_a192_serviceMode 0 "DISABLED" 1 "ENABLED" ;
VAL_ 1332 VCFRONT_a365_showroomMode 0 "DISABLED" 1 "ENABLED" ;
VAL_ 1332 VCFRONT_a514_cell4Voltage 65535 "SNA" ;
VAL_ 1332 VCFRONT_a515_cell4Voltage 65535 "SNA" ;
VAL_ 1332 VCFRONT_a669_vehicleSpeed 8191 "SNA" ;
VAL_ 1332 VCFRONT_a242_IBSVoltage 4095 "SNA" ;
VAL_ 1332 VCFRONT_a269_IBSVoltage 4095 "SNA" ;
VAL_ 1332 VCFRONT_a366_showroomMode 0 "DISABLED" 1 "ENABLED" ;
VAL_ 1332 VCFRONT_a401_IBSVoltage 4095 "SNA" ;
VAL_ 1332 VCFRONT_a410_IBSVoltage 4095 "SNA" ;
VAL_ 1332 VCFRONT_a411_IBSVoltage 4095 "SNA" ;
VAL_ 1332 VCFRONT_a416_packCurrent 4294934528 "SNA" ;
VAL_ 1332 VCFRONT_a417_packCurrent 4294934528 "SNA" ;
VAL_ 1332 VCFRONT_a418_packCurrent 4294934528 "SNA" ;
VAL_ 1332 VCFRONT_a419_packCurrent 4294934528 "SNA" ;
VAL_ 1332 VCFRONT_a423_packCurrent 4294934528 "SNA" ;
VAL_ 1332 VCFRONT_a424_packCurrent 4294934528 "SNA" ;
VAL_ 1332 VCFRONT_a478_transportMode 0 "DISABLED" 1 "ENABLED" ;
VAL_ 1332 VCFRONT_a503_packCurrent 4294934528 "SNA" ;
VAL_ 1332 VCFRONT_a527_cell3Voltage 65535 "SNA" ;
VAL_ 1332 VCFRONT_a555_cell3Voltage 65535 "SNA" ;
VAL_ 1332 VCFRONT_a559_vehiclePowerState 0 "OFF" 1 "CONDITIONING" 2 "ACCESSORY" 3 "DRIVE" ;
VAL_ 1332 VCFRONT_a104_VEH_status 0 "DISABLED" 1 "ENABLED" 2 "TEMPORARY_FAILURE" 3 "SNA" ;
VAL_ 1332 VCFRONT_a114_CH_status 0 "DISABLED" 1 "ENABLED" 2 "TEMPORARY_FAILURE" 3 "SNA" ;
VAL_ 1332 VCFRONT_a478_serviceMode 0 "DISABLED" 1 "ENABLED" ;
VAL_ 1332 VCFRONT_a191_MOSState 0 "OPEN" 1 "CLOSED" 2 "INVALID" 3 "SNA" ;
VAL_ 1332 VCFRONT_a476_batterySMState 0 "INIT" 1 "CHARGE" 2 "DISCHARGE" 3 "STANDBY" 4 "RESISTANCE_ESTIMATION" 5 "OTA_STANDBY" 6 "DISCONNECTED_BATTERY_TEST" 7 "SHORTED_CELL_TEST" 8 "FAULT" 9 "RECOVERY" ;
VAL_ 1332 VCFRONT_a477_cell3Voltage 65535 "SNA" ;
VAL_ 1332 VCFRONT_a478_factoryMode 0 "DISABLED" 1 "ENABLED" ;
VAL_ 1332 VCFRONT_a627_cell3Voltage 65535 "SNA" ;
VAL_ 1332 VCFRONT_a113_VEH_status 0 "DISABLED" 1 "ENABLED" 2 "TEMPORARY_FAILURE" 3 "SNA" ;
VAL_ 1332 VCFRONT_a402_serviceMode 0 "DISABLED" 1 "ENABLED" ;
VAL_ 1332 VCFRONT_a446_hpBatteryLoadType 0 "NONE" 1 "BATT_HEAT" 2 "BATT_COOL" ;
VAL_ 1332 VCFRONT_a129_pcsEFuseVoltage 1023 "SNA" ;
VAL_ 1332 VCFRONT_a182_ambientTemp 4294966273 "SNA" ;
VAL_ 1332 VCFRONT_a183_ambientTemp 4294966273 "SNA" ;
VAL_ 1332 VCFRONT_a192_DI_gear 0 "INVALID" 1 "P" 2 "R" 3 "N" 4 "D" 7 "SNA" ;
VAL_ 1332 VCFRONT_a432_packCurrent 4294934528 "SNA" ;
VAL_ 1332 VCFRONT_a476_vehiclePowerState 0 "OFF" 1 "CONDITIONING" 2 "ACCESSORY" 3 "DRIVE" ;
VAL_ 1332 VCFRONT_a479_batterySMState 0 "INIT" 1 "CHARGE" 2 "DISCHARGE" 3 "STANDBY" 4 "RESISTANCE_ESTIMATION" 5 "OTA_STANDBY" 6 "DISCONNECTED_BATTERY_TEST" 7 "SHORTED_CELL_TEST" 8 "FAULT" 9 "RECOVERY" ;
VAL_ 1332 VCFRONT_a512_packTemperature 511 "SNA" ;
VAL_ 1332 VCFRONT_a513_packTemperature 511 "SNA" ;
VAL_ 1332 VCFRONT_a561_cell1Voltage 65535 "SNA" ;
VAL_ 1332 VCFRONT_a562_cell1Voltage 65535 "SNA" ;
VAL_ 1332 VCFRONT_a109_CH_status 0 "DISABLED" 1 "ENABLED" 2 "TEMPORARY_FAILURE" 3 "SNA" ;
VAL_ 1332 VCFRONT_a446_hpCabinLoadType 0 "NONE" 1 "CC" 2 "REHEAT" 3 "EVAP" ;
VAL_ 1332 VCFRONT_a114_BDY_status 0 "DISABLED" 1 "ENABLED" 2 "TEMPORARY_FAILURE" 3 "SNA" ;
VAL_ 1332 VCFRONT_a116_VEH_status 0 "DISABLED" 1 "ENABLED" 2 "TEMPORARY_FAILURE" 3 "SNA" ;
VAL_ 1332 VCFRONT_a476_transportMode 0 "DISABLED" 1 "ENABLED" ;
VAL_ 1332 VCFRONT_a514_cell3Voltage 65535 "SNA" ;
VAL_ 1332 VCFRONT_a515_cell3Voltage 65535 "SNA" ;
