VERSION "2021.24.4"

NS_ :

BS_:

BU_: VEH CH Receiver X

BA_DEF_ BO_ "GenMsgSendType" ENUM "Cyclic";
BA_DEF_ BO_ "GenMsgCycleTime" INT 0 10000;

BO_ 1335 VCFRONT1_alertLog: 8 Vector__XXX
 SG_ VCFRONT1_a058_faultReason m58 : 63|1@1+ (1,0) [0|0] "" Vector__XXX
 SG_ VCFRONT1_a128_vcrightEFuseRemain m128 : 59|4@1+ (1,0) [0|0] "" Vector__XXX
 SG_ VCFRONT1_a129_pcsEFuseRemainingR m129 : 59|4@1+ (1,0) [0|0] "" Vector__XXX
 SG_ VCFRONT1_a130_autopilot2EFuseRem m130 : 59|4@1+ (1,0) [0|0] "" Vector__XXX
 SG_ VCFRONT1_a491_csUvRetryT m491 : 58|2@1+ (1,0) [0|0] "" Vector__XXX
 SG_ VCFRONT1_a490_currentSenseFailur m490 : 57|1@1+ (1,0) [0|0] "" Vector__XXX
 SG_ VCFRONT1_a022_TaskInitError4 m22 : 56|8@1+ (1,0) [0|0] "" Vector__XXX
 SG_ VCFRONT1_a031_uds_bytes_5 m31 : 56|8@1+ (1,0) [0|0] "" Vector__XXX
 SG_ VCFRONT1_a041_CPULoadNVMMTask m41 : 56|8@1+ (1,0) [0|0] "" Vector__XXX
 SG_ VCFRONT1_a042_UsageNVMMTask m42 : 56|8@1+ (1,0) [0|0] "" Vector__XXX
 SG_ VCFRONT1_a253_ambientTemperature m253 : 56|8@1+ (0.5,-40) [0|0] "" Vector__XXX
 SG_ VCFRONT1_a490_currentSenseFinish m490 : 56|1@1+ (1,0) [0|0] "" Vector__XXX
 SG_ VCFRONT1_a250_ovClampMonitorVolt m250 : 55|9@1+ (0.05,0) [0|0] "" Vector__XXX
 SG_ VCFRONT1_a252_ovClampMonitorVolt m252 : 55|9@1+ (0.05,0) [0|0] "" Vector__XXX
 SG_ VCFRONT1_a491_ccmVoutThr m491 : 55|3@1+ (1,0) [0|0] "" Vector__XXX
 SG_ VCFRONT1_a249_ovClampMonito_0001 m249 : 53|9@1+ (0.05,0) [0|0] "" Vector__XXX
 SG_ VCFRONT1_a252_ovClampMonitorChan m252 : 53|2@1+ (1,0) [0|0] "" Vector__XXX
 SG_ VCFRONT1_a491_uvThr m491 : 53|2@1+ (1,0) [0|0] "" Vector__XXX
 SG_ VCFRONT1_a058_newREstimate m58 : 51|12@1+ (0.00061,0) [0|0] "" Vector__XXX
 SG_ VCFRONT1_a491_wdTime m491 : 51|2@1+ (1,0) [0|0] "" Vector__XXX
 SG_ VCFRONT1_a581_calibratedVoltageO m581 : 50|9@1- (0.004,0) [0|0] "" Vector__XXX
 SG_ VCFRONT1_a003_Data m3 : 48|16@1+ (1,0) [0|0] "" Vector__XXX
 SG_ VCFRONT1_a022_TaskInitError3 m22 : 48|8@1+ (1,0) [0|0] "" Vector__XXX
 SG_ VCFRONT1_a031_uds_bytes_4 m31 : 48|8@1+ (1,0) [0|0] "" Vector__XXX
 SG_ VCFRONT1_a041_CPULoad1000msTask m41 : 48|8@1+ (1,0) [0|0] "" Vector__XXX
 SG_ VCFRONT1_a042_UsageUDSTask m42 : 48|8@1+ (1,0) [0|0] "" Vector__XXX
 SG_ VCFRONT1_a127_iBoosterEFuseTemp m127 : 48|11@1+ (0.125,-40) [0|0] "" Vector__XXX
 SG_ VCFRONT1_a128_vcrightEFuseTemp m128 : 48|11@1+ (0.125,-40) [0|0] "" Vector__XXX
 SG_ VCFRONT1_a129_pcsEFuseTemp m129 : 48|11@1+ (0.125,-40) [0|0] "" Vector__XXX
 SG_ VCFRONT1_a130_autopilot2EFuseTem m130 : 48|11@1+ (0.125,-40) [0|0] "" Vector__XXX
 SG_ VCFRONT1_a132_epas2EFuseTemp m132 : 48|11@1+ (0.125,-40) [0|0] "" Vector__XXX
 SG_ VCFRONT1_a250_ovClampReferenceVo m250 : 48|7@1+ (0.025,0) [0|0] "" Vector__XXX
 SG_ VCFRONT1_a482_lvBridgeEFuseTemp m482 : 48|11@1+ (0.125,-40) [0|0] "" Vector__XXX
 SG_ VCFRONT1_a489_currentSenseVoltag m489 : 48|8@1+ (1,0) [0|0] "" Vector__XXX
 SG_ VCFRONT1_a490_currentSenseVoltag m490 : 48|8@1+ (1,0) [0|0] "" Vector__XXX
 SG_ VCFRONT1_a578_vbusFusedLoadShedR m578 : 48|8@1+ (1,0) [0|0] "" Vector__XXX
 SG_ VCFRONT1_a590_vcrightCTerm m590 : 48|16@1- (50,0) [0|0] "" Vector__XXX
 SG_ VCFRONT1_a591_vcrightMaxCount m591 : 48|5@1+ (1,0) [0|0] "" Vector__XXX
 SG_ VCFRONT1_a596_vcrightCutoffCTerm m596 : 48|16@1- (50,0) [0|0] "" Vector__XXX
 SG_ VCFRONT1_a597_vcrightCutoffMaxCo m597 : 48|5@1+ (1,0) [0|0] "" Vector__XXX
 SG_ VCFRONT1_a490_softShortThreshold m490 : 47|1@1+ (1,0) [0|0] "" Vector__XXX
 SG_ VCFRONT1_a491_ntcThr m491 : 47|4@1+ (1,0) [0|0] "" Vector__XXX
 SG_ VCFRONT1_a188_CANAfterQuiet m188 : 46|1@1+ (1,0) [0|0] "" Vector__XXX
 SG_ VCFRONT1_a253_ovClampTvsDio_0001 m253 : 46|9@1+ (0.025,0) [0|0] "" Vector__XXX
 SG_ VCFRONT1_a490_hardShortThreshold m490 : 46|1@1+ (1,0) [0|0] "" Vector__XXX
 SG_ VCFRONT1_a475_enable m475 : 45|1@1+ (1,0) [0|0] "" Vector__XXX
 SG_ VCFRONT1_a490_stuckOnFailure m490 : 45|1@1+ (1,0) [0|0] "" Vector__XXX
 SG_ VCFRONT1_a113_BATTIPC_chassisCon m113 : 44|1@1+ (1,0) [0|0] "" Vector__XXX
 SG_ VCFRONT1_a249_ovClampMonito_0000 m249 : 44|9@1+ (0.05,0) [0|0] "" Vector__XXX
 SG_ VCFRONT1_a475_dinState m475 : 44|1@1+ (1,0) [0|0] "" Vector__XXX
 SG_ VCFRONT1_a490_stuckOnFinished m490 : 44|1@1+ (1,0) [0|0] "" Vector__XXX
 SG_ VCFRONT1_a063_faulted m63 : 43|1@1+ (1,0) [0|0] "" Vector__XXX
 SG_ VCFRONT1_a113_FRONTIPC_chassisCo m113 : 43|1@1+ (1,0) [0|0] "" Vector__XXX
 SG_ VCFRONT1_a251_testTimedOut m251 : 43|1@1+ (1,0) [0|0] "" Vector__XXX
 SG_ VCFRONT1_a252_dcdcEnableLineVolt m252 : 43|10@1+ (0.025,0) [0|0] "" Vector__XXX
 SG_ VCFRONT1_a475_hwlo m475 : 43|1@1+ (1,0) [0|0] "" Vector__XXX
 SG_ VCFRONT1_a063_stuckActive m63 : 42|1@1+ (1,0) [0|0] "" Vector__XXX
 SG_ VCFRONT1_a113_BATTIPC_driverAssi m113 : 42|1@1+ (1,0) [0|0] "" Vector__XXX
 SG_ VCFRONT1_a475_hitAlertRateLimit m475 : 42|1@1+ (1,0) [0|0] "" Vector__XXX
 SG_ VCFRONT1_a491_vdsThr m491 : 42|5@1+ (1,0) [0|0] "" Vector__XXX
 SG_ VCFRONT1_a063_indeterminate m63 : 41|1@1+ (1,0) [0|0] "" Vector__XXX
 SG_ VCFRONT1_a113_FRONTIPC_driverAss m113 : 41|1@1+ (1,0) [0|0] "" Vector__XXX
 SG_ VCFRONT1_a475_bufferFull m475 : 41|1@1+ (1,0) [0|0] "" Vector__XXX
 SG_ VCFRONT1_a022_TaskInitError2 m22 : 40|8@1+ (1,0) [0|0] "" Vector__XXX
 SG_ VCFRONT1_a031_uds_bytes_3 m31 : 40|8@1+ (1,0) [0|0] "" Vector__XXX
 SG_ VCFRONT1_a038_faultSource m38 : 40|7@1+ (1,0) [0|0] "" Vector__XXX
 SG_ VCFRONT1_a041_CPULoad100msTask m41 : 40|8@1+ (1,0) [0|0] "" Vector__XXX
 SG_ VCFRONT1_a042_Usage1000msTask m42 : 40|8@1+ (1,0) [0|0] "" Vector__XXX
 SG_ VCFRONT1_a043_CallTrace1 m43 : 40|24@1+ (1,0) [0|0] "" Vector__XXX
 SG_ VCFRONT1_a044_CallTrace1 m44 : 40|24@1+ (1,0) [0|0] "" Vector__XXX
 SG_ VCFRONT1_a045_CallTrace1 m45 : 40|24@1+ (1,0) [0|0] "" Vector__XXX
 SG_ VCFRONT1_a046_CallTrace1 m46 : 40|24@1+ (1,0) [0|0] "" Vector__XXX
 SG_ VCFRONT1_a059_current m59 : 40|12@1+ (0.05,0) [0|0] "" Vector__XXX
 SG_ VCFRONT1_a063_disconnected m63 : 40|1@1+ (1,0) [0|0] "" Vector__XXX
 SG_ VCFRONT1_a113_FRONTIPC_vehi_0001 m113 : 40|1@1+ (1,0) [0|0] "" Vector__XXX
 SG_ VCFRONT1_a188_timeNotSleeping m188 : 40|6@1+ (1,0) [0|0] "" Vector__XXX
 SG_ VCFRONT1_a220_unhealthyReason m220 : 40|5@1+ (1,0) [0|0] "" Vector__XXX
 SG_ VCFRONT1_a251_rationalityPc_0000 m251 : 40|3@1+ (1,0) [0|0] "" Vector__XXX
 SG_ VCFRONT1_a475_configIncorrect m475 : 40|1@1+ (1,0) [0|0] "" Vector__XXX
 SG_ VCFRONT1_a581_QF m581 : 40|10@1+ (0.0005,0) [0|0] "" Vector__XXX
 SG_ VCFRONT1_a590_vcrightBTerm m590 : 40|8@1- (1,-78) [0|0] "" Vector__XXX
 SG_ VCFRONT1_a596_vcrightCutoffBTerm m596 : 40|8@1- (1,-78) [0|0] "" Vector__XXX
 SG_ VCFRONT1_a058_prevREstimate m58 : 39|12@1+ (0.00061,0) [0|0] "" Vector__XXX
 SG_ VCFRONT1_a113_FRONTIPC_autopilot m113 : 39|1@1+ (1,0) [0|0] "" Vector__XXX
 SG_ VCFRONT1_a117_BATTIPC_systemStat m117 : 39|1@1+ (1,0) [0|0] "" Vector__XXX
 SG_ VCFRONT1_a475_csUndervoltage m475 : 39|1@1+ (1,0) [0|0] "" Vector__XXX
 SG_ VCFRONT1_a113_FRONTIPC_tpmsRCPse m113 : 38|1@1+ (1,0) [0|0] "" Vector__XXX
 SG_ VCFRONT1_a117_FRONTIPC_windowSta m117 : 38|1@1+ (1,0) [0|0] "" Vector__XXX
 SG_ VCFRONT1_a250_ovClampBusVoltage m250 : 38|10@1+ (0.025,0) [0|0] "" Vector__XXX
 SG_ VCFRONT1_a475_spiNotDone m475 : 38|1@1+ (1,0) [0|0] "" Vector__XXX
 SG_ VCFRONT1_a491_hshtThr m491 : 38|4@1+ (1,0) [0|0] "" Vector__XXX
 SG_ VCFRONT1_a016_NVMMWriteFailed m16 : 37|1@1+ (1,0) [0|0] "" Vector__XXX
 SG_ VCFRONT1_a113_FRONTIPC_vehi_0002 m113 : 37|1@1+ (1,0) [0|0] "" Vector__XXX
 SG_ VCFRONT1_a117_BATTIPC_lightingSe m117 : 37|1@1+ (1,0) [0|0] "" Vector__XXX
 SG_ VCFRONT1_a214_filteredCurrent m214 : 37|10@1- (0.1,0) [0|0] "" Vector__XXX
 SG_ VCFRONT1_a251_rationalityPcsShut m251 : 37|2@1+ (1,0) [0|0] "" Vector__XXX
 SG_ VCFRONT1_a253_ovClampTvsDio_0000 m253 : 37|9@1+ (0.025,0) [0|0] "" Vector__XXX
 SG_ VCFRONT1_a475_watchdog m475 : 37|1@1+ (1,0) [0|0] "" Vector__XXX
 SG_ VCFRONT1_a005_faults1 m5 : 36|12@1+ (1,0) [0|0] "" Vector__XXX
 SG_ VCFRONT1_a016_NVMMMemOverflow m16 : 36|1@1+ (1,0) [0|0] "" Vector__XXX
 SG_ VCFRONT1_a038_violationType m38 : 36|3@1+ (1,0) [0|0] "" Vector__XXX
 SG_ VCFRONT1_a113_FRONTIPC_tripPlann m113 : 36|1@1+ (1,0) [0|0] "" Vector__XXX
 SG_ VCFRONT1_a117_FRONTIPC_lightingS m117 : 36|1@1+ (1,0) [0|0] "" Vector__XXX
 SG_ VCFRONT1_a118_BATTIPC_LVBMS_stat m118 : 36|1@1+ (1,0) [0|0] "" Vector__XXX
 SG_ VCFRONT1_a191_bmsState m191 : 36|4@1+ (1,0) [0|0] "" Vector__XXX
 SG_ VCFRONT1_a220_serviceMode m220 : 36|1@1+ (1,0) [0|0] "" Vector__XXX
 SG_ VCFRONT1_a475_chargePumpLow m475 : 36|1@1+ (1,0) [0|0] "" Vector__XXX
 SG_ VCFRONT1_a016_NVMMRecordUpgraded m16 : 35|1@1+ (1,0) [0|0] "" Vector__XXX
 SG_ VCFRONT1_a113_FRONTIPC_trackMode m113 : 35|1@1+ (1,0) [0|0] "" Vector__XXX
 SG_ VCFRONT1_a117_BATTIPC_LVPowerSta m117 : 35|1@1+ (1,0) [0|0] "" Vector__XXX
 SG_ VCFRONT1_a118_FRONTIPC_LVBM_0000 m118 : 35|1@1+ (1,0) [0|0] "" Vector__XXX
 SG_ VCFRONT1_a191_NotEnoughPowerForS m191 : 35|1@1+ (1,0) [0|0] "" Vector__XXX
 SG_ VCFRONT1_a220_factoryMode m220 : 35|1@1+ (1,0) [0|0] "" Vector__XXX
 SG_ VCFRONT1_a249_ovClampMonitorVolt m249 : 35|9@1+ (0.05,0) [0|0] "" Vector__XXX
 SG_ VCFRONT1_a475_vgsLow m475 : 35|1@1+ (1,0) [0|0] "" Vector__XXX
 SG_ VCFRONT1_a016_NVMMVersionMismatc m16 : 34|1@1+ (1,0) [0|0] "" Vector__XXX
 SG_ VCFRONT1_a113_FRONTIPC_status2 m113 : 34|1@1+ (1,0) [0|0] "" Vector__XXX
 SG_ VCFRONT1_a117_BATTIPC_status m117 : 34|1@1+ (1,0) [0|0] "" Vector__XXX
 SG_ VCFRONT1_a118_FRONTIPC_LVBMS_sta m118 : 34|1@1+ (1,0) [0|0] "" Vector__XXX
 SG_ VCFRONT1_a191_exitDriveWarningTi m191 : 34|1@1+ (1,0) [0|0] "" Vector__XXX
 SG_ VCFRONT1_a251_clampHighSideFailu m251 : 34|3@1+ (1,0) [0|0] "" Vector__XXX
 SG_ VCFRONT1_a475_ntcOvertemperature m475 : 34|1@1+ (1,0) [0|0] "" Vector__XXX
 SG_ VCFRONT1_a490_stuckOnVDS m490 : 34|10@1+ (1,0) [0|0] "" Vector__XXX
 SG_ VCFRONT1_a016_NVMMCRCMismatch m16 : 33|1@1+ (1,0) [0|0] "" Vector__XXX
 SG_ VCFRONT1_a113_FRONTIPC_status m113 : 33|1@1+ (1,0) [0|0] "" Vector__XXX
 SG_ VCFRONT1_a116_BATTIPC_systemStat m116 : 33|1@1+ (1,0) [0|0] "" Vector__XXX
 SG_ VCFRONT1_a117_BATTIPC_doorStatus m117 : 33|1@1+ (1,0) [0|0] "" Vector__XXX
 SG_ VCFRONT1_a118_BATTIPC_pcsInterfa m118 : 33|1@1+ (1,0) [0|0] "" Vector__XXX
 SG_ VCFRONT1_a191_frunkOpen m191 : 33|1@1+ (1,0) [0|0] "" Vector__XXX
 SG_ VCFRONT1_a252_busVoltage m252 : 33|10@1+ (0.025,0) [0|0] "" Vector__XXX
 SG_ VCFRONT1_a475_deviceOvertemperat m475 : 33|1@1+ (1,0) [0|0] "" Vector__XXX
 SG_ VCFRONT1_a490_VDSFailure m490 : 33|1@1+ (1,0) [0|0] "" Vector__XXX
 SG_ VCFRONT1_a491_ovcThr m491 : 33|5@1+ (1,0) [0|0] "" Vector__XXX
 SG_ VCFRONT1_a003_LineNumber m3 : 32|16@1+ (1,0) [0|0] "" Vector__XXX
 SG_ VCFRONT1_a005_busID1 m5 : 32|4@1+ (1,0) [0|0] "" Vector__XXX
 SG_ VCFRONT1_a006_messageID m6 : 32|29@1+ (1,0) [0|0] "" Vector__XXX
 SG_ VCFRONT1_a016_NVMMRecordNotFound m16 : 32|1@1+ (1,0) [0|0] "" Vector__XXX
 SG_ VCFRONT1_a022_TaskInitError1 m22 : 32|8@1+ (1,0) [0|0] "" Vector__XXX
 SG_ VCFRONT1_a031_uds_bytes_2 m31 : 32|8@1+ (1,0) [0|0] "" Vector__XXX
 SG_ VCFRONT1_a038_protectionContext m38 : 32|4@1+ (1,0) [0|0] "" Vector__XXX
 SG_ VCFRONT1_a041_CPULoad10msTask m41 : 32|8@1+ (1,0) [0|0] "" Vector__XXX
 SG_ VCFRONT1_a042_Usage100msTask m42 : 32|8@1+ (1,0) [0|0] "" Vector__XXX
 SG_ VCFRONT1_a063_ADCVoltage m63 : 32|8@1+ (0.025,0) [0|0] "" Vector__XXX
 SG_ VCFRONT1_a113_FRONTIPC_hvacDebug m113 : 32|1@1+ (1,0) [0|0] "" Vector__XXX
 SG_ VCFRONT1_a116_FRONTIPC_systemSta m116 : 32|1@1+ (1,0) [0|0] "" Vector__XXX
 SG_ VCFRONT1_a117_BATTIPC_lightStatu m117 : 32|1@1+ (1,0) [0|0] "" Vector__XXX
 SG_ VCFRONT1_a118_FRONTIPC_LVPowerSt m118 : 32|1@1+ (1,0) [0|0] "" Vector__XXX
 SG_ VCFRONT1_a127_iBoosterEFuseVolta m127 : 32|16@1+ (0.1,0) [0|0] "" Vector__XXX
 SG_ VCFRONT1_a128_vcrightEFuseVoltag m128 : 32|16@1+ (0.1,0) [0|0] "" Vector__XXX
 SG_ VCFRONT1_a129_pcsEFuseVoltage m129 : 32|16@1+ (0.1,0) [0|0] "" Vector__XXX
 SG_ VCFRONT1_a130_autopilot2EFuseVol m130 : 32|16@1+ (0.1,0) [0|0] "" Vector__XXX
 SG_ VCFRONT1_a132_epas2EFuseVoltage m132 : 32|16@1+ (0.1,0) [0|0] "" Vector__XXX
 SG_ VCFRONT1_a134_hvContactorsEFuseV m134 : 32|16@1+ (0.1,0) [0|0] "" Vector__XXX
 SG_ VCFRONT1_a177_mcuAudioEFuseVolta m177 : 32|16@1+ (0.1,0) [0|0] "" Vector__XXX
 SG_ VCFRONT1_a188_vehiclePowerState m188 : 32|5@1+ (1,0) [0|0] "" Vector__XXX
 SG_ VCFRONT1_a191_serviceMode m191 : 32|1@1+ (1,0) [0|0] "" Vector__XXX
 SG_ VCFRONT1_a204_pcsBridgeCurrent m204 : 32|16@1- (0.0625,0) [0|0] "" Vector__XXX
 SG_ VCFRONT1_a205_pcsBridgeCurrent m205 : 32|16@1- (0.0625,0) [0|0] "" Vector__XXX
 SG_ VCFRONT1_a220_lvHealthStatus m220 : 32|3@1+ (1,0) [0|0] "" Vector__XXX
 SG_ VCFRONT1_a251_clampHighSideCheck m251 : 32|2@1+ (1,0) [0|0] "" Vector__XXX
 SG_ VCFRONT1_a252_pcsOvSelfTestEnabl m252 : 32|1@1+ (1,0) [0|0] "" Vector__XXX
 SG_ VCFRONT1_a262_vbatProtVoltage m262 : 32|16@1+ (0.1,0) [0|0] "" Vector__XXX
 SG_ VCFRONT1_a263_vbatProtVoltage m263 : 32|16@1+ (0.1,0) [0|0] "" Vector__XXX
 SG_ VCFRONT1_a264_vbatProtVoltage m264 : 32|16@1+ (0.1,0) [0|0] "" Vector__XXX
 SG_ VCFRONT1_a266_vbatProtVoltage m266 : 32|16@1+ (0.1,0) [0|0] "" Vector__XXX
 SG_ VCFRONT1_a423_requestSleepF_0000 m423 : 32|16@1+ (1,0) [0|0] "" Vector__XXX
 SG_ VCFRONT1_a475_fuseLatch m475 : 32|1@1+ (1,0) [0|0] "" Vector__XXX
 SG_ VCFRONT1_a482_lvBridgeEFuseVolta m482 : 32|16@1+ (0.1,0) [0|0] "" Vector__XXX
 SG_ VCFRONT1_a484_upstreamEFuseRatio m484 : 32|7@1+ (1,0) [0|0] "" Vector__XXX
 SG_ VCFRONT1_a489_stuckOnVDS m489 : 32|10@1+ (1,0) [0|0] "" Vector__XXX
 SG_ VCFRONT1_a490_VDSFinished m490 : 32|1@1+ (1,0) [0|0] "" Vector__XXX
 SG_ VCFRONT1_a509_unlocksRemaining m509 : 32|8@1+ (1,0) [0|0] "" Vector__XXX
 SG_ VCFRONT1_a574_frontDriveInv_0000 m574 : 32|8@1+ (1,0) [0|0] "" Vector__XXX
 SG_ VCFRONT1_a578_vbusFusedLoadShedV m578 : 32|16@1+ (0.1,0) [0|0] "" Vector__XXX
 SG_ VCFRONT1_a591_vcrightTimingThres m591 : 32|16@1+ (1,0) [0|0] "" Vector__XXX
 SG_ VCFRONT1_a597_vcrightCutoffTimin m597 : 32|16@1+ (1,0) [0|0] "" Vector__XXX
 SG_ VCFRONT1_a104_BATTIPC_bodyC_0001 m104 : 31|1@1+ (1,0) [0|0] "" Vector__XXX
 SG_ VCFRONT1_a113_FRONTIPC_hvacReque m113 : 31|1@1+ (1,0) [0|0] "" Vector__XXX
 SG_ VCFRONT1_a116_BATTIPC_AP_hvacSta m116 : 31|1@1+ (1,0) [0|0] "" Vector__XXX
 SG_ VCFRONT1_a117_BATTIPC_switchStat m117 : 31|1@1+ (1,0) [0|0] "" Vector__XXX
 SG_ VCFRONT1_a118_BATTIPC_12VBattery m118 : 31|1@1+ (1,0) [0|0] "" Vector__XXX
 SG_ VCFRONT1_a252_pcsOvClampArmed m252 : 31|1@1+ (1,0) [0|0] "" Vector__XXX
 SG_ VCFRONT1_a475_bypassSaturation m475 : 31|1@1+ (1,0) [0|0] "" Vector__XXX
 SG_ VCFRONT1_a104_BATTIPC_cameraClea m104 : 30|1@1+ (1,0) [0|0] "" Vector__XXX
 SG_ VCFRONT1_a110_BATTIPC_vehNm m110 : 30|1@1+ (1,0) [0|0] "" Vector__XXX
 SG_ VCFRONT1_a113_FRONTIPC_gpsTime m113 : 30|1@1+ (1,0) [0|0] "" Vector__XXX
 SG_ VCFRONT1_a116_FRONTIPC_windowSta m116 : 30|1@1+ (1,0) [0|0] "" Vector__XXX
 SG_ VCFRONT1_a117_BATTIPC_pitchEstim m117 : 30|1@1+ (1,0) [0|0] "" Vector__XXX
 SG_ VCFRONT1_a118_FRONTIPC_12VBatter m118 : 30|1@1+ (1,0) [0|0] "" Vector__XXX
 SG_ VCFRONT1_a252_pcsDcdcEnableFeedb m252 : 30|1@1+ (1,0) [0|0] "" Vector__XXX
 SG_ VCFRONT1_a475_vdsMax m475 : 30|1@1+ (1,0) [0|0] "" Vector__XXX
 SG_ VCFRONT1_a104_BATTIPC_bodyC_0000 m104 : 29|1@1+ (1,0) [0|0] "" Vector__XXX
 SG_ VCFRONT1_a107_FRONTIPC_ther_0000 m107 : 29|1@1+ (1,0) [0|0] "" Vector__XXX
 SG_ VCFRONT1_a110_BATTIPC_status m110 : 29|1@1+ (1,0) [0|0] "" Vector__XXX
 SG_ VCFRONT1_a113_FRONTIPC_debugECU m113 : 29|1@1+ (1,0) [0|0] "" Vector__XXX
 SG_ VCFRONT1_a116_BATTIPC_thsStatus m116 : 29|1@1+ (1,0) [0|0] "" Vector__XXX
 SG_ VCFRONT1_a117_FRONTIPC_pitchEsti m117 : 29|1@1+ (1,0) [0|0] "" Vector__XXX
 SG_ VCFRONT1_a118_BATTIPC_vehicleSta m118 : 29|1@1+ (1,0) [0|0] "" Vector__XXX
 SG_ VCFRONT1_a250_dcdcEnableLineVolt m250 : 29|9@1+ (0.05,0) [0|0] "" Vector__XXX
 SG_ VCFRONT1_a251_rationalitySh_0000 m251 : 29|3@1+ (1,0) [0|0] "" Vector__XXX
 SG_ VCFRONT1_a252_pcsSupporting m252 : 29|1@1+ (1,0) [0|0] "" Vector__XXX
 SG_ VCFRONT1_a475_prechargeFailure m475 : 29|1@1+ (1,0) [0|0] "" Vector__XXX
 SG_ VCFRONT1_a581_criticalResistance m581 : 29|10@1+ (0.0005,0) [0|0] "" Vector__XXX
 SG_ VCFRONT1_a058_current m58 : 28|11@1+ (0.1,0) [0|0] "" Vector__XXX
 SG_ VCFRONT1_a059_resistanceEstimate m59 : 28|12@1+ (0.00244,0) [0|0] "" Vector__XXX
 SG_ VCFRONT1_a104_FRONTIPC_body_0000 m104 : 28|1@1+ (1,0) [0|0] "" Vector__XXX
 SG_ VCFRONT1_a107_FRONTIPC_thermalSt m107 : 28|1@1+ (1,0) [0|0] "" Vector__XXX
 SG_ VCFRONT1_a110_FRONTIPC_mismatchF m110 : 28|1@1+ (1,0) [0|0] "" Vector__XXX
 SG_ VCFRONT1_a113_FRONTIPC_driverPro m113 : 28|1@1+ (1,0) [0|0] "" Vector__XXX
 SG_ VCFRONT1_a116_BATTIPC_doorStatus m116 : 28|1@1+ (1,0) [0|0] "" Vector__XXX
 SG_ VCFRONT1_a117_FRONTIPC_lightStat m117 : 28|1@1+ (1,0) [0|0] "" Vector__XXX
 SG_ VCFRONT1_a118_FRONTIPC_vehicleSt m118 : 28|1@1+ (1,0) [0|0] "" Vector__XXX
 SG_ VCFRONT1_a249_ovClampReferenceVo m249 : 28|7@1+ (0.025,0) [0|0] "" Vector__XXX
 SG_ VCFRONT1_a252_pcsOvShutdownArmed m252 : 28|1@1+ (1,0) [0|0] "" Vector__XXX
 SG_ VCFRONT1_a253_ovClampTvsDiodeVol m253 : 28|9@1+ (0.025,0) [0|0] "" Vector__XXX
 SG_ VCFRONT1_a475_hardShort m475 : 28|1@1+ (1,0) [0|0] "" Vector__XXX
 SG_ VCFRONT1_a021_Task1000msMissed m21 : 27|1@1+ (1,0) [0|0] "" Vector__XXX
 SG_ VCFRONT1_a078_BATTIPC_LVBMS_stat m78 : 27|1@1+ (1,0) [0|0] "" Vector__XXX
 SG_ VCFRONT1_a104_BATTIPC_status m104 : 27|1@1+ (1,0) [0|0] "" Vector__XXX
 SG_ VCFRONT1_a107_FRONTIPC_vehicleNo m107 : 27|1@1+ (1,0) [0|0] "" Vector__XXX
 SG_ VCFRONT1_a110_FRONTIPC_canLogAva m110 : 27|1@1+ (1,0) [0|0] "" Vector__XXX
 SG_ VCFRONT1_a113_FRONTIPC_vehicleMo m113 : 27|1@1+ (1,0) [0|0] "" Vector__XXX
 SG_ VCFRONT1_a116_BATTIPC_LVPowerSta m116 : 27|1@1+ (1,0) [0|0] "" Vector__XXX
 SG_ VCFRONT1_a117_FRONTIPC_ther_0000 m117 : 27|1@1+ (1,0) [0|0] "" Vector__XXX
 SG_ VCFRONT1_a118_BATTIPC_systemStat m118 : 27|1@1+ (1,0) [0|0] "" Vector__XXX
 SG_ VCFRONT1_a188_frontPrivBusAwake m188 : 27|1@1+ (1,0) [0|0] "" Vector__XXX
 SG_ VCFRONT1_a204_uvLoadshedFaultInj m204 : 27|1@1+ (1,0) [0|0] "" Vector__XXX
 SG_ VCFRONT1_a205_ovLoadshedFaultInj m205 : 27|1@1+ (1,0) [0|0] "" Vector__XXX
 SG_ VCFRONT1_a214_clearCurrent m214 : 27|10@1- (0.1,0) [0|0] "" Vector__XXX
 SG_ VCFRONT1_a251_rationalityShutdow m251 : 27|2@1+ (1,0) [0|0] "" Vector__XXX
 SG_ VCFRONT1_a252_pcsOvShutdownFault m252 : 27|1@1+ (1,0) [0|0] "" Vector__XXX
 SG_ VCFRONT1_a475_vsUndervoltage m475 : 27|1@1+ (1,0) [0|0] "" Vector__XXX
 SG_ VCFRONT1_a509_hardwareLockout m509 : 27|1@1+ (1,0) [0|0] "" Vector__XXX
 SG_ VCFRONT1_a021_Task1000msStarved m21 : 26|1@1+ (1,0) [0|0] "" Vector__XXX
 SG_ VCFRONT1_a078_FRONTIPC_LVBM_0000 m78 : 26|1@1+ (1,0) [0|0] "" Vector__XXX
 SG_ VCFRONT1_a104_BATTIPC_matrixHigh m104 : 26|1@1+ (1,0) [0|0] "" Vector__XXX
 SG_ VCFRONT1_a107_FRONTIPC_socStatus m107 : 26|1@1+ (1,0) [0|0] "" Vector__XXX
 SG_ VCFRONT1_a110_BATTIPC_canLogAvai m110 : 26|1@1+ (1,0) [0|0] "" Vector__XXX
 SG_ VCFRONT1_a113_FRONTIPC_chargeReq m113 : 26|1@1+ (1,0) [0|0] "" Vector__XXX
 SG_ VCFRONT1_a116_BATTIPC_hvacStatus m116 : 26|1@1+ (1,0) [0|0] "" Vector__XXX
 SG_ VCFRONT1_a117_FRONTIPC_thermalSt m117 : 26|1@1+ (1,0) [0|0] "" Vector__XXX
 SG_ VCFRONT1_a118_FRONTIPC_systemSta m118 : 26|1@1+ (1,0) [0|0] "" Vector__XXX
 SG_ VCFRONT1_a204_BRailLocked m204 : 26|1@1+ (1,0) [0|0] "" Vector__XXX
 SG_ VCFRONT1_a205_BRailLocked m205 : 26|1@1+ (1,0) [0|0] "" Vector__XXX
 SG_ VCFRONT1_a252_incorrectPcsDcdcEn m252 : 26|1@1+ (1,0) [0|0] "" Vector__XXX
 SG_ VCFRONT1_a414_uvLoadshedVsenseDi m414 : 26|1@1+ (1,0) [0|0] "" Vector__XXX
 SG_ VCFRONT1_a423_requestSleepFailed m423 : 26|1@1+ (1,0) [0|0] "" Vector__XXX
 SG_ VCFRONT1_a475_disableOutputFault m475 : 26|1@1+ (1,0) [0|0] "" Vector__XXX
 SG_ VCFRONT1_a486_remoteBridgeD_0000 m486 : 26|1@1+ (1,0) [0|0] "" Vector__XXX
 SG_ VCFRONT1_a021_Task1000msLate m21 : 25|1@1+ (1,0) [0|0] "" Vector__XXX
 SG_ VCFRONT1_a038_busMaster m38 : 25|4@1+ (1,0) [0|0] "" Vector__XXX
 SG_ VCFRONT1_a078_FRONTIPC_LVBMS_sta m78 : 25|1@1+ (1,0) [0|0] "" Vector__XXX
 SG_ VCFRONT1_a104_BATTIPC_matrixBend m104 : 25|1@1+ (1,0) [0|0] "" Vector__XXX
 SG_ VCFRONT1_a106_FRONTIPC_dcdcStatu m106 : 25|1@1+ (1,0) [0|0] "" Vector__XXX
 SG_ VCFRONT1_a107_FRONTIPC_powerAvai m107 : 25|1@1+ (1,0) [0|0] "" Vector__XXX
 SG_ VCFRONT1_a110_FRONTIPC_time m110 : 25|1@1+ (1,0) [0|0] "" Vector__XXX
 SG_ VCFRONT1_a113_FRONTIPC_vehicleCo m113 : 25|1@1+ (1,0) [0|0] "" Vector__XXX
 SG_ VCFRONT1_a116_FRONTIPC_lightStat m116 : 25|1@1+ (1,0) [0|0] "" Vector__XXX
 SG_ VCFRONT1_a117_FRONTIPC_socStatus m117 : 25|1@1+ (1,0) [0|0] "" Vector__XXX
 SG_ VCFRONT1_a118_BATTIPC_status m118 : 25|1@1+ (1,0) [0|0] "" Vector__XXX
 SG_ VCFRONT1_a252_incorrectPcsSuppor m252 : 25|1@1+ (1,0) [0|0] "" Vector__XXX
 SG_ VCFRONT1_a414_bridgeFailedToOpen m414 : 25|1@1+ (1,0) [0|0] "" Vector__XXX
 SG_ VCFRONT1_a423_readyToSleepFailed m423 : 25|1@1+ (1,0) [0|0] "" Vector__XXX
 SG_ VCFRONT1_a475_unexpectedFailSafe m475 : 25|1@1+ (1,0) [0|0] "" Vector__XXX
 SG_ VCFRONT1_a486_remoteBridgeDinSta m486 : 25|1@1+ (1,0) [0|0] "" Vector__XXX
 SG_ VCFRONT1_a491_tNom m491 : 25|8@1+ (1,0) [0|0] "" Vector__XXX
 SG_ VCFRONT1_a006_mailboxID m6 : 24|8@1+ (1,0) [0|0] "" Vector__XXX
 SG_ VCFRONT1_a018_faultAddress m18 : 24|32@1+ (1,0) [0|0] "" Vector__XXX
 SG_ VCFRONT1_a019_faultAddress m19 : 24|32@1+ (1,0) [0|0] "" Vector__XXX
 SG_ VCFRONT1_a021_Task100msMissed m21 : 24|1@1+ (1,0) [0|0] "" Vector__XXX
 SG_ VCFRONT1_a022_TaskInitError0 m22 : 24|8@1+ (1,0) [0|0] "" Vector__XXX
 SG_ VCFRONT1_a031_uds_bytes_1 m31 : 24|8@1+ (1,0) [0|0] "" Vector__XXX
 SG_ VCFRONT1_a036_intIdx m36 : 24|10@1+ (1,0) [0|0] "" Vector__XXX
 SG_ VCFRONT1_a037_faultAddress m37 : 24|32@1+ (1,0) [0|0] "" Vector__XXX
 SG_ VCFRONT1_a038_nonSecure m38 : 24|1@1+ (1,0) [0|0] "" Vector__XXX
 SG_ VCFRONT1_a039_faultAddress m39 : 24|32@1+ (1,0) [0|0] "" Vector__XXX
 SG_ VCFRONT1_a040_programCounter m40 : 24|32@1+ (1,0) [0|0] "" Vector__XXX
 SG_ VCFRONT1_a041_CPULoad1msTask m41 : 24|8@1+ (1,0) [0|0] "" Vector__XXX
 SG_ VCFRONT1_a042_Usage10msTask m42 : 24|8@1+ (1,0) [0|0] "" Vector__XXX
 SG_ VCFRONT1_a063_switchType m63 : 24|8@1+ (1,0) [0|0] "" Vector__XXX
 SG_ VCFRONT1_a078_BATTIPC_LVSelfTest m78 : 24|1@1+ (1,0) [0|0] "" Vector__XXX
 SG_ VCFRONT1_a104_FRONTIPC_matrixBen m104 : 24|1@1+ (1,0) [0|0] "" Vector__XXX
 SG_ VCFRONT1_a106_FRONTIPC_dcdcRailS m106 : 24|1@1+ (1,0) [0|0] "" Vector__XXX
 SG_ VCFRONT1_a107_FRONTIPC_packConfi m107 : 24|1@1+ (1,0) [0|0] "" Vector__XXX
 SG_ VCFRONT1_a110_FRONTIPC_updateSta m110 : 24|1@1+ (1,0) [0|0] "" Vector__XXX
 SG_ VCFRONT1_a113_BATTIPC_vehicleMod m113 : 24|1@1+ (1,0) [0|0] "" Vector__XXX
 SG_ VCFRONT1_a116_FRONTIPC_switchSta m116 : 24|1@1+ (1,0) [0|0] "" Vector__XXX
 SG_ VCFRONT1_a117_FRONTIPC_powerAvai m117 : 24|1@1+ (1,0) [0|0] "" Vector__XXX
 SG_ VCFRONT1_a118_BATTIPC_sensors m118 : 24|1@1+ (1,0) [0|0] "" Vector__XXX
 SG_ VCFRONT1_a188_bridgeEFuseState m188 : 24|3@1+ (1,0) [0|0] "" Vector__XXX
 SG_ VCFRONT1_a191_busVoltage m191 : 24|8@1+ (0.08741903380905883,0) [0|0] "" Vector__XXX
 SG_ VCFRONT1_a251_clampLowSideFailur m251 : 24|3@1+ (1,0) [0|0] "" Vector__XXX
 SG_ VCFRONT1_a252_incorrectPcsTripSt m252 : 24|1@1+ (1,0) [0|0] "" Vector__XXX
 SG_ VCFRONT1_a414_followerVCRightSel m414 : 24|1@1+ (1,0) [0|0] "" Vector__XXX
 SG_ VCFRONT1_a423_sleepRequest m423 : 24|1@1+ (1,0) [0|0] "" Vector__XXX
 SG_ VCFRONT1_a475_unexpectedLock m475 : 24|1@1+ (1,0) [0|0] "" Vector__XXX
 SG_ VCFRONT1_a484_vbusVoltage m484 : 24|6@1+ (1,0) [0|0] "" Vector__XXX
 SG_ VCFRONT1_a486_remoteBridgeS_0000 m486 : 24|1@1+ (1,0) [0|0] "" Vector__XXX
 SG_ VCFRONT1_a489_VDSDiff m489 : 24|8@1+ (1,0) [0|0] "" Vector__XXX
 SG_ VCFRONT1_a490_VDSDiff m490 : 24|8@1+ (1,0) [0|0] "" Vector__XXX
 SG_ VCFRONT1_a491_dinCtrlEn m491 : 24|1@1+ (1,0) [0|0] "" Vector__XXX
 SG_ VCFRONT1_a509_expectedState m509 : 24|3@1+ (1,0) [0|0] "" Vector__XXX
 SG_ VCFRONT1_a590_vcrightATerm m590 : 24|16@1+ (50,0) [0|0] "" Vector__XXX
 SG_ VCFRONT1_a596_vcrightCutoffATerm m596 : 24|16@1+ (50,0) [0|0] "" Vector__XXX
 SG_ VCFRONT1_a021_Task100msStarved m21 : 23|1@1+ (1,0) [0|0] "" Vector__XXX
 SG_ VCFRONT1_a038_privilegedExecute m38 : 23|1@1+ (1,0) [0|0] "" Vector__XXX
 SG_ VCFRONT1_a078_BATTIPC_pcsInterfa m78 : 23|1@1+ (1,0) [0|0] "" Vector__XXX
 SG_ VCFRONT1_a079_FRONTIPC_systemSta m79 : 23|1@1+ (1,0) [0|0] "" Vector__XXX
 SG_ VCFRONT1_a104_FRONTIPC_matrixHig m104 : 23|1@1+ (1,0) [0|0] "" Vector__XXX
 SG_ VCFRONT1_a106_FRONTIPC_thermalCo m106 : 23|1@1+ (1,0) [0|0] "" Vector__XXX
 SG_ VCFRONT1_a107_FRONTIPC_energySta m107 : 23|1@1+ (1,0) [0|0] "" Vector__XXX
 SG_ VCFRONT1_a110_FRONTIPC_carState m110 : 23|1@1+ (1,0) [0|0] "" Vector__XXX
 SG_ VCFRONT1_a113_BATTIPC_vehic_0001 m113 : 23|1@1+ (1,0) [0|0] "" Vector__XXX
 SG_ VCFRONT1_a115_FRONTIPC_TPMSData m115 : 23|1@1+ (1,0) [0|0] "" Vector__XXX
 SG_ VCFRONT1_a116_FRONTIPC_restraint m116 : 23|1@1+ (1,0) [0|0] "" Vector__XXX
 SG_ VCFRONT1_a117_FRONTIPC_packConfi m117 : 23|1@1+ (1,0) [0|0] "" Vector__XXX
 SG_ VCFRONT1_a118_BATTIPC_lighting m118 : 23|1@1+ (1,0) [0|0] "" Vector__XXX
 SG_ VCFRONT1_a216_vcrightDynamicImmi m216 : 23|1@1+ (1,0) [0|0] "" Vector__XXX
 SG_ VCFRONT1_a252_incorrectPcsEnable m252 : 23|1@1+ (1,0) [0|0] "" Vector__XXX
 SG_ VCFRONT1_a414_deviceStuckOnFailu m414 : 23|1@1+ (1,0) [0|0] "" Vector__XXX
 SG_ VCFRONT1_a423_sleepShutdownCompl m423 : 23|1@1+ (1,0) [0|0] "" Vector__XXX
 SG_ VCFRONT1_a475_deviceError m475 : 23|1@1+ (1,0) [0|0] "" Vector__XXX
 SG_ VCFRONT1_a486_remoteBridgeSyncAr m486 : 23|1@1+ (1,0) [0|0] "" Vector__XXX
 SG_ VCFRONT1_a491_dinCtrlOpt m491 : 23|1@1+ (1,0) [0|0] "" Vector__XXX
 SG_ VCFRONT1_a021_Task100msLate m21 : 22|1@1+ (1,0) [0|0] "" Vector__XXX
 SG_ VCFRONT1_a038_privilegedWrite m38 : 22|1@1+ (1,0) [0|0] "" Vector__XXX
 SG_ VCFRONT1_a078_BATTIPC_12VBattery m78 : 22|1@1+ (1,0) [0|0] "" Vector__XXX
 SG_ VCFRONT1_a079_BATTIPC_systemStat m79 : 22|1@1+ (1,0) [0|0] "" Vector__XXX
 SG_ VCFRONT1_a104_BATTIPC_bodyContro m104 : 22|1@1+ (1,0) [0|0] "" Vector__XXX
 SG_ VCFRONT1_a106_CH_alertMatrix m106 : 22|1@1+ (1,0) [0|0] "" Vector__XXX
 SG_ VCFRONT1_a107_FRONTIPC_chargeInf m107 : 22|1@1+ (1,0) [0|0] "" Vector__XXX
 SG_ VCFRONT1_a110_FRONTIPC_carConfig m110 : 22|1@1+ (1,0) [0|0] "" Vector__XXX
 SG_ VCFRONT1_a113_BATTIPC_vehic_0000 m113 : 22|1@1+ (1,0) [0|0] "" Vector__XXX
 SG_ VCFRONT1_a115_FRONTIPC_ChildSeat m115 : 22|1@1+ (1,0) [0|0] "" Vector__XXX
 SG_ VCFRONT1_a116_FRONTIPC_hvacStatu m116 : 22|1@1+ (1,0) [0|0] "" Vector__XXX
 SG_ VCFRONT1_a117_FRONTIPC_energySta m117 : 22|1@1+ (1,0) [0|0] "" Vector__XXX
 SG_ VCFRONT1_a118_BATTIPC_coolant m118 : 22|1@1+ (1,0) [0|0] "" Vector__XXX
 SG_ VCFRONT1_a120_FRONTIPC_odometerS m120 : 22|1@1+ (1,0) [0|0] "" Vector__XXX
 SG_ VCFRONT1_a216_vcrightStaticImmin m216 : 22|1@1+ (1,0) [0|0] "" Vector__XXX
 SG_ VCFRONT1_a252_incorrectClam_0001 m252 : 22|1@1+ (1,0) [0|0] "" Vector__XXX
 SG_ VCFRONT1_a414_loadUnattemptedOnF m414 : 22|1@1+ (1,0) [0|0] "" Vector__XXX
 SG_ VCFRONT1_a423_ethBusAwake m423 : 22|1@1+ (1,0) [0|0] "" Vector__XXX
 SG_ VCFRONT1_a475_diagnosticBit m475 : 22|1@1+ (1,0) [0|0] "" Vector__XXX
 SG_ VCFRONT1_a486_remoteBridgeO_0000 m486 : 22|1@1+ (1,0) [0|0] "" Vector__XXX
 SG_ VCFRONT1_a012_ExternalReset m12 : 21|1@1+ (1,0) [0|0] "" Vector__XXX
 SG_ VCFRONT1_a021_Task10msMissed m21 : 21|1@1+ (1,0) [0|0] "" Vector__XXX
 SG_ VCFRONT1_a028_UndefInstr m28 : 21|1@1+ (1,0) [0|0] "" Vector__XXX
 SG_ VCFRONT1_a038_privilegedRead m38 : 21|1@1+ (1,0) [0|0] "" Vector__XXX
 SG_ VCFRONT1_a078_FRONTIPC_LVSelfTes m78 : 21|1@1+ (1,0) [0|0] "" Vector__XXX
 SG_ VCFRONT1_a079_FRONTIPC_fron_0001 m79 : 21|1@1+ (1,0) [0|0] "" Vector__XXX
 SG_ VCFRONT1_a081_BATTIPC_LVSelfTest m81 : 21|1@1+ (1,0) [0|0] "" Vector__XXX
 SG_ VCFRONT1_a090_FRONTIPC_vbatVolta m90 : 21|1@1+ (1,0) [0|0] "" Vector__XXX
 SG_ VCFRONT1_a104_FRONTIPC_status m104 : 21|1@1+ (1,0) [0|0] "" Vector__XXX
 SG_ VCFRONT1_a106_CH_dcdcRailStatus m106 : 21|1@1+ (1,0) [0|0] "" Vector__XXX
 SG_ VCFRONT1_a107_FRONTIPC_bmbMinMax m107 : 21|1@1+ (1,0) [0|0] "" Vector__XXX
 SG_ VCFRONT1_a110_FRONTIPC_vehNm m110 : 21|1@1+ (1,0) [0|0] "" Vector__XXX
 SG_ VCFRONT1_a113_BATTIPC_vehicleCon m113 : 21|1@1+ (1,0) [0|0] "" Vector__XXX
 SG_ VCFRONT1_a115_FRONTIPC_thsStatus m115 : 21|1@1+ (1,0) [0|0] "" Vector__XXX
 SG_ VCFRONT1_a116_FRONTIPC_status m116 : 21|1@1+ (1,0) [0|0] "" Vector__XXX
 SG_ VCFRONT1_a117_FRONTIPC_chargeInf m117 : 21|1@1+ (1,0) [0|0] "" Vector__XXX
 SG_ VCFRONT1_a118_BATTIPC_LVPowerSta m118 : 21|1@1+ (1,0) [0|0] "" Vector__XXX
 SG_ VCFRONT1_a120_FRONTIPC_autonomyH m120 : 21|1@1+ (1,0) [0|0] "" Vector__XXX
 SG_ VCFRONT1_a216_vcrightFastBlowDeb m216 : 21|1@1+ (1,0) [0|0] "" Vector__XXX
 SG_ VCFRONT1_a251_clampLowSideCheckR m251 : 21|2@1+ (1,0) [0|0] "" Vector__XXX
 SG_ VCFRONT1_a252_incorrectClam_0000 m252 : 21|1@1+ (1,0) [0|0] "" Vector__XXX
 SG_ VCFRONT1_a423_partyBusAwake m423 : 21|1@1+ (1,0) [0|0] "" Vector__XXX
 SG_ VCFRONT1_a475_autoOn m475 : 21|1@1+ (1,0) [0|0] "" Vector__XXX
 SG_ VCFRONT1_a486_remoteBridgeOutput m486 : 21|1@1+ (1,0) [0|0] "" Vector__XXX
 SG_ VCFRONT1_a491_fsMode m491 : 21|2@1+ (1,0) [0|0] "" Vector__XXX
 SG_ VCFRONT1_a005_faults0 m5 : 20|12@1+ (1,0) [0|0] "" Vector__XXX
 SG_ VCFRONT1_a006_fault m6 : 20|4@1+ (1,0) [0|0] "" Vector__XXX
 SG_ VCFRONT1_a012_DebugReset m12 : 20|1@1+ (1,0) [0|0] "" Vector__XXX
 SG_ VCFRONT1_a018_BFARVALID m18 : 20|1@1+ (1,0) [0|0] "" Vector__XXX
 SG_ VCFRONT1_a019_InstrBusErr m19 : 20|1@1+ (1,0) [0|0] "" Vector__XXX
 SG_ VCFRONT1_a021_Task10msStarved m21 : 20|1@1+ (1,0) [0|0] "" Vector__XXX
 SG_ VCFRONT1_a028_InvalidState m28 : 20|1@1+ (1,0) [0|0] "" Vector__XXX
 SG_ VCFRONT1_a038_userExecute m38 : 20|1@1+ (1,0) [0|0] "" Vector__XXX
 SG_ VCFRONT1_a078_FRONTIPC_LVHealth m78 : 20|1@1+ (1,0) [0|0] "" Vector__XXX
 SG_ VCFRONT1_a079_BATTIPC_front_0000 m79 : 20|1@1+ (1,0) [0|0] "" Vector__XXX
 SG_ VCFRONT1_a081_BATTIPC_LVHealth m81 : 20|1@1+ (1,0) [0|0] "" Vector__XXX
 SG_ VCFRONT1_a082_BATTIPC_frontprivD m82 : 20|1@1+ (1,0) [0|0] "" Vector__XXX
 SG_ VCFRONT1_a090_BATTIPC_vbatVoltag m90 : 20|1@1+ (1,0) [0|0] "" Vector__XXX
 SG_ VCFRONT1_a104_FRONTIPC_thermalSt m104 : 20|1@1+ (1,0) [0|0] "" Vector__XXX
 SG_ VCFRONT1_a106_VEH_dcdcRailStatus m106 : 20|1@1+ (1,0) [0|0] "" Vector__XXX
 SG_ VCFRONT1_a107_BATTIPC_energyStat m107 : 20|1@1+ (1,0) [0|0] "" Vector__XXX
 SG_ VCFRONT1_a110_BATTIPC_updateStat m110 : 20|1@1+ (1,0) [0|0] "" Vector__XXX
 SG_ VCFRONT1_a113_BATTIPC_status m113 : 20|1@1+ (1,0) [0|0] "" Vector__XXX
 SG_ VCFRONT1_a115_FRONTIPC_requests m115 : 20|1@1+ (1,0) [0|0] "" Vector__XXX
 SG_ VCFRONT1_a116_FRONTIPC_thsStatus m116 : 20|1@1+ (1,0) [0|0] "" Vector__XXX
 SG_ VCFRONT1_a117_FRONTIPC_bmbMinMax m117 : 20|1@1+ (1,0) [0|0] "" Vector__XXX
 SG_ VCFRONT1_a118_BATTIPC_LVHealth m118 : 20|1@1+ (1,0) [0|0] "" Vector__XXX
 SG_ VCFRONT1_a120_FRONTIPC_systemPow m120 : 20|1@1+ (1,0) [0|0] "" Vector__XXX
 SG_ VCFRONT1_a188_bridgeManagerState m188 : 20|4@1+ (1,0) [0|0] "" Vector__XXX
 SG_ VCFRONT1_a216_vcrightFastBlowImm m216 : 20|1@1+ (1,0) [0|0] "" Vector__XXX
 SG_ VCFRONT1_a220_vehicleSpeed m220 : 20|12@1+ (0.08,-40) [0|0] "" Vector__XXX
 SG_ VCFRONT1_a223_timedOut m223 : 20|1@1+ (1,0) [0|0] "" Vector__XXX
 SG_ VCFRONT1_a252_incorrectClampMoni m252 : 20|1@1+ (1,0) [0|0] "" Vector__XXX
 SG_ VCFRONT1_a423_hvsBusAwake m423 : 20|1@1+ (1,0) [0|0] "" Vector__XXX
 SG_ VCFRONT1_a475_spiError m475 : 20|1@1+ (1,0) [0|0] "" Vector__XXX
 SG_ VCFRONT1_a486_localBridgeDinStat m486 : 20|1@1+ (1,0) [0|0] "" Vector__XXX
 SG_ VCFRONT1_a490_outputOn m490 : 20|1@1+ (1,0) [0|0] "" Vector__XXX
 SG_ VCFRONT1_a491_nvmDefCfgEn m491 : 20|1@1+ (1,0) [0|0] "" Vector__XXX
 SG_ VCFRONT1_a617_FRONTIPC_defogInfo m617 : 20|1@1+ (1,0) [0|0] "" Vector__XXX
 SG_ VCFRONT1_a012_CheckstopReset m12 : 19|1@1+ (1,0) [0|0] "" Vector__XXX
 SG_ VCFRONT1_a018_MMFARVALID m18 : 19|1@1+ (1,0) [0|0] "" Vector__XXX
 SG_ VCFRONT1_a019_PreciseBusErr m19 : 19|1@1+ (1,0) [0|0] "" Vector__XXX
 SG_ VCFRONT1_a021_Task10msLate m21 : 19|1@1+ (1,0) [0|0] "" Vector__XXX
 SG_ VCFRONT1_a028_InvalidPCLoad m28 : 19|1@1+ (1,0) [0|0] "" Vector__XXX
 SG_ VCFRONT1_a037_DataAccessViolatio m37 : 19|1@1+ (1,0) [0|0] "" Vector__XXX
 SG_ VCFRONT1_a038_userWrite m38 : 19|1@1+ (1,0) [0|0] "" Vector__XXX
 SG_ VCFRONT1_a078_FRONTIPC_12VBatter m78 : 19|1@1+ (1,0) [0|0] "" Vector__XXX
 SG_ VCFRONT1_a079_FRONTIPC_fron_0000 m79 : 19|1@1+ (1,0) [0|0] "" Vector__XXX
 SG_ VCFRONT1_a081_BATTIPC_frontprivD m81 : 19|1@1+ (1,0) [0|0] "" Vector__XXX
 SG_ VCFRONT1_a082_FRONTIPC_fron_0000 m82 : 19|1@1+ (1,0) [0|0] "" Vector__XXX
 SG_ VCFRONT1_a086_FRONTIPC_frontpriv m86 : 19|1@1+ (1,0) [0|0] "" Vector__XXX
 SG_ VCFRONT1_a090_BATTIPC_state m90 : 19|1@1+ (1,0) [0|0] "" Vector__XXX
 SG_ VCFRONT1_a104_FRONTIPC_evseStatu m104 : 19|1@1+ (1,0) [0|0] "" Vector__XXX
 SG_ VCFRONT1_a106_VEH_thermalControl m106 : 19|1@1+ (1,0) [0|0] "" Vector__XXX
 SG_ VCFRONT1_a107_BATTIPC_status m107 : 19|1@1+ (1,0) [0|0] "" Vector__XXX
 SG_ VCFRONT1_a108_FRONTIPC_motorStat m108 : 19|1@1+ (1,0) [0|0] "" Vector__XXX
 SG_ VCFRONT1_a110_BATTIPC_time m110 : 19|1@1+ (1,0) [0|0] "" Vector__XXX
 SG_ VCFRONT1_a113_BATTIPC_powerRatio m113 : 19|1@1+ (1,0) [0|0] "" Vector__XXX
 SG_ VCFRONT1_a115_FRONTIPC_authentic m115 : 19|1@1+ (1,0) [0|0] "" Vector__XXX
 SG_ VCFRONT1_a116_FRONTIPC_LVPowerSt m116 : 19|1@1+ (1,0) [0|0] "" Vector__XXX
 SG_ VCFRONT1_a117_FRONTIPC_LVPowerSt m117 : 19|1@1+ (1,0) [0|0] "" Vector__XXX
 SG_ VCFRONT1_a118_FRONTIPC_frontIpcD m118 : 19|1@1+ (1,0) [0|0] "" Vector__XXX
 SG_ VCFRONT1_a120_BATTIPC_systemStat m120 : 19|1@1+ (1,0) [0|0] "" Vector__XXX
 SG_ VCFRONT1_a122_FRONTIPC_occu_0000 m122 : 19|1@1+ (1,0) [0|0] "" Vector__XXX
 SG_ VCFRONT1_a126_BATTIPC_status m126 : 19|1@1+ (1,0) [0|0] "" Vector__XXX
 SG_ VCFRONT1_a220_inDriverlessMode m220 : 19|1@1+ (1,0) [0|0] "" Vector__XXX
 SG_ VCFRONT1_a223_sharedBridgeShutdo m223 : 19|1@1+ (1,0) [0|0] "" Vector__XXX
 SG_ VCFRONT1_a250_busVoltage m250 : 19|10@1+ (0.025,0) [0|0] "" Vector__XXX
 SG_ VCFRONT1_a252_incorrectPinConfig m252 : 19|1@1+ (1,0) [0|0] "" Vector__XXX
 SG_ VCFRONT1_a423_chBusAwake m423 : 19|1@1+ (1,0) [0|0] "" Vector__XXX
 SG_ VCFRONT1_a475_reset m475 : 19|1@1+ (1,0) [0|0] "" Vector__XXX
 SG_ VCFRONT1_a486_localBridgeSyncArm m486 : 19|1@1+ (1,0) [0|0] "" Vector__XXX
 SG_ VCFRONT1_a490_timeout m490 : 19|1@1+ (1,0) [0|0] "" Vector__XXX
 SG_ VCFRONT1_a491_lockedModeEnable m491 : 19|1@1+ (1,0) [0|0] "" Vector__XXX
 SG_ VCFRONT1_a496_bmsState m496 : 19|4@1+ (1,0) [0|0] "" Vector__XXX
 SG_ VCFRONT1_a509_state m509 : 19|3@1+ (1,0) [0|0] "" Vector__XXX
 SG_ VCFRONT1_a581_resistance m581 : 19|10@1+ (0.0005,0) [0|0] "" Vector__XXX
 SG_ VCFRONT1_a617_BATTIPC_status m617 : 19|1@1+ (1,0) [0|0] "" Vector__XXX
 SG_ VCFRONT1_a012_SoftwareReset m12 : 18|1@1+ (1,0) [0|0] "" Vector__XXX
 SG_ VCFRONT1_a015_NVMMRecordIDError m15 : 18|1@1+ (1,0) [0|0] "" Vector__XXX
 SG_ VCFRONT1_a018_VECTTBL m18 : 18|1@1+ (1,0) [0|0] "" Vector__XXX
 SG_ VCFRONT1_a019_ImpreciseBusErr m19 : 18|1@1+ (1,0) [0|0] "" Vector__XXX
 SG_ VCFRONT1_a021_Task1msMissed m21 : 18|1@1+ (1,0) [0|0] "" Vector__XXX
 SG_ VCFRONT1_a028_NoCoprocessor m28 : 18|1@1+ (1,0) [0|0] "" Vector__XXX
 SG_ VCFRONT1_a037_InstrAccessViolati m37 : 18|1@1+ (1,0) [0|0] "" Vector__XXX
 SG_ VCFRONT1_a038_userRead m38 : 18|1@1+ (1,0) [0|0] "" Vector__XXX
 SG_ VCFRONT1_a078_BATTIPC_battIpcDat m78 : 18|1@1+ (1,0) [0|0] "" Vector__XXX
 SG_ VCFRONT1_a079_BATTIPC_frontprivD m79 : 18|1@1+ (1,0) [0|0] "" Vector__XXX
 SG_ VCFRONT1_a081_FRONTIPC_frontIpcD m81 : 18|1@1+ (1,0) [0|0] "" Vector__XXX
 SG_ VCFRONT1_a082_FRONTIPC_fron_0001 m82 : 18|1@1+ (1,0) [0|0] "" Vector__XXX
 SG_ VCFRONT1_a086_BATTIPC_battIpcDat m86 : 18|1@1+ (1,0) [0|0] "" Vector__XXX
 SG_ VCFRONT1_a090_FRONTIPC_status m90 : 18|1@1+ (1,0) [0|0] "" Vector__XXX
 SG_ VCFRONT1_a103_FRONTIPC_evseStatu m103 : 18|1@1+ (1,0) [0|0] "" Vector__XXX
 SG_ VCFRONT1_a104_FRONTIPC_bodyContr m104 : 18|1@1+ (1,0) [0|0] "" Vector__XXX
 SG_ VCFRONT1_a106_VEH_dcdcStatus m106 : 18|1@1+ (1,0) [0|0] "" Vector__XXX
 SG_ VCFRONT1_a107_BATTIPC_socStatus m107 : 18|1@1+ (1,0) [0|0] "" Vector__XXX
 SG_ VCFRONT1_a108_FRONTIPC_thermalCo m108 : 18|1@1+ (1,0) [0|0] "" Vector__XXX
 SG_ VCFRONT1_a110_BATTIPC_mismatchFa m110 : 18|1@1+ (1,0) [0|0] "" Vector__XXX
 SG_ VCFRONT1_a111_BATTIPC_status m111 : 18|1@1+ (1,0) [0|0] "" Vector__XXX
 SG_ VCFRONT1_a112_BATTIPC_status m112 : 18|1@1+ (1,0) [0|0] "" Vector__XXX
 SG_ VCFRONT1_a113_FRONTIPC_vehi_0000 m113 : 18|1@1+ (1,0) [0|0] "" Vector__XXX
 SG_ VCFRONT1_a115_BATTIPC_authentica m115 : 18|1@1+ (1,0) [0|0] "" Vector__XXX
 SG_ VCFRONT1_a116_FRONTIPC_doorStatu m116 : 18|1@1+ (1,0) [0|0] "" Vector__XXX
 SG_ VCFRONT1_a117_FRONTIPC_doorStatu m117 : 18|1@1+ (1,0) [0|0] "" Vector__XXX
 SG_ VCFRONT1_a118_FRONTIPC_frontpriv m118 : 18|1@1+ (1,0) [0|0] "" Vector__XXX
 SG_ VCFRONT1_a120_FRONTIPC_systemSta m120 : 18|1@1+ (1,0) [0|0] "" Vector__XXX
 SG_ VCFRONT1_a122_FRONTIPC_occupancy m122 : 18|1@1+ (1,0) [0|0] "" Vector__XXX
 SG_ VCFRONT1_a125_FRONTIPC_info m125 : 18|1@1+ (1,0) [0|0] "" Vector__XXX
 SG_ VCFRONT1_a126_FRONTIPC_status m126 : 18|1@1+ (1,0) [0|0] "" Vector__XXX
 SG_ VCFRONT1_a191_hvState m191 : 18|3@1+ (1,0) [0|0] "" Vector__XXX
 SG_ VCFRONT1_a223_overvoltageFaultAc m223 : 18|1@1+ (1,0) [0|0] "" Vector__XXX
 SG_ VCFRONT1_a229_pcsNotSupporting m229 : 18|1@1+ (1,0) [0|0] "" Vector__XXX
 SG_ VCFRONT1_a249_ovClampBusVoltage m249 : 18|10@1+ (0.025,0) [0|0] "" Vector__XXX
 SG_ VCFRONT1_a250_battDomainHealthy m250 : 18|1@1+ (1,0) [0|0] "" Vector__XXX
 SG_ VCFRONT1_a251_rationalitySetupFa m251 : 18|3@1+ (1,0) [0|0] "" Vector__XXX
 SG_ VCFRONT1_a253_busVoltage m253 : 18|10@1+ (0.025,0) [0|0] "" Vector__XXX
 SG_ VCFRONT1_a423_frontPrivBusAwake m423 : 18|1@1+ (1,0) [0|0] "" Vector__XXX
 SG_ VCFRONT1_a486_localBridgeOutputO m486 : 18|1@1+ (1,0) [0|0] "" Vector__XXX
 SG_ VCFRONT1_a496_NotEnoughPowerForS m496 : 18|1@1+ (1,0) [0|0] "" Vector__XXX
 SG_ VCFRONT1_a617_FRONTIPC_status m617 : 18|1@1+ (1,0) [0|0] "" Vector__XXX
 SG_ VCFRONT1_a002_PowerOnReset m2 : 17|1@1+ (1,0) [0|0] "" Vector__XXX
 SG_ VCFRONT1_a012_FlashError m12 : 17|1@1+ (1,0) [0|0] "" Vector__XXX
 SG_ VCFRONT1_a013_ClearQueueFull m13 : 17|1@1+ (1,0) [0|0] "" Vector__XXX
 SG_ VCFRONT1_a015_NVMMFilesystemErro m15 : 17|1@1+ (1,0) [0|0] "" Vector__XXX
 SG_ VCFRONT1_a018_FORCED m18 : 17|1@1+ (1,0) [0|0] "" Vector__XXX
 SG_ VCFRONT1_a019_LazyFPStateError m19 : 17|1@1+ (1,0) [0|0] "" Vector__XXX
 SG_ VCFRONT1_a021_Task1msStarved m21 : 17|1@1+ (1,0) [0|0] "" Vector__XXX
 SG_ VCFRONT1_a028_UnalignedAccess m28 : 17|1@1+ (1,0) [0|0] "" Vector__XXX
 SG_ VCFRONT1_a037_LazyFPStateError m37 : 17|1@1+ (1,0) [0|0] "" Vector__XXX
 SG_ VCFRONT1_a060_resetUnlocked m60 : 17|1@1+ (1,0) [0|0] "" Vector__XXX
 SG_ VCFRONT1_a077_FRONTIPC_frontpriv m77 : 17|1@1+ (1,0) [0|0] "" Vector__XXX
 SG_ VCFRONT1_a078_BATTIPC_frontprivD m78 : 17|1@1+ (1,0) [0|0] "" Vector__XXX
 SG_ VCFRONT1_a079_BATTIPC_battIpcDat m79 : 17|1@1+ (1,0) [0|0] "" Vector__XXX
 SG_ VCFRONT1_a081_FRONTIPC_frontpriv m81 : 17|1@1+ (1,0) [0|0] "" Vector__XXX
 SG_ VCFRONT1_a082_FRONTIPC_frontIpcD m82 : 17|1@1+ (1,0) [0|0] "" Vector__XXX
 SG_ VCFRONT1_a086_BATTIPC_vehNm m86 : 17|1@1+ (1,0) [0|0] "" Vector__XXX
 SG_ VCFRONT1_a090_FRONTIPC_state m90 : 17|1@1+ (1,0) [0|0] "" Vector__XXX
 SG_ VCFRONT1_a091_FRONTIPC_state m91 : 17|1@1+ (1,0) [0|0] "" Vector__XXX
 SG_ VCFRONT1_a098_FRONTIPC_thermalCo m98 : 17|1@1+ (1,0) [0|0] "" Vector__XXX
 SG_ VCFRONT1_a100_FRONTIPC m100 : 17|1@1+ (1,0) [0|0] "" Vector__XXX
 SG_ VCFRONT1_a103_FRONTIPC_status m103 : 17|1@1+ (1,0) [0|0] "" Vector__XXX
 SG_ VCFRONT1_a104_FRONTIPC_autonomyC m104 : 17|1@1+ (1,0) [0|0] "" Vector__XXX
 SG_ VCFRONT1_a106_BATTIPC_dcdcStatus m106 : 17|1@1+ (1,0) [0|0] "" Vector__XXX
 SG_ VCFRONT1_a107_FRONTIPC_status m107 : 17|1@1+ (1,0) [0|0] "" Vector__XXX
 SG_ VCFRONT1_a108_FRONTIPC_temperatu m108 : 17|1@1+ (1,0) [0|0] "" Vector__XXX
 SG_ VCFRONT1_a110_BATTIPC_carState m110 : 17|1@1+ (1,0) [0|0] "" Vector__XXX
 SG_ VCFRONT1_a111_FRONTIPC_status m111 : 17|1@1+ (1,0) [0|0] "" Vector__XXX
 SG_ VCFRONT1_a112_FRONTIPC_status m112 : 17|1@1+ (1,0) [0|0] "" Vector__XXX
 SG_ VCFRONT1_a113_FRONTIPC_powerRati m113 : 17|1@1+ (1,0) [0|0] "" Vector__XXX
 SG_ VCFRONT1_a114_FRONTIPC_wheelRota m114 : 17|1@1+ (1,0) [0|0] "" Vector__XXX
 SG_ VCFRONT1_a115_BATTIPC_requests m115 : 17|1@1+ (1,0) [0|0] "" Vector__XXX
 SG_ VCFRONT1_a116_FRONTIPC_hvacReque m116 : 17|1@1+ (1,0) [0|0] "" Vector__XXX
 SG_ VCFRONT1_a117_FRONTIPC_switchSta m117 : 17|1@1+ (1,0) [0|0] "" Vector__XXX
 SG_ VCFRONT1_a118_BATTIPC_vehNm m118 : 17|1@1+ (1,0) [0|0] "" Vector__XXX
 SG_ VCFRONT1_a120_FRONTIPC_speed m120 : 17|1@1+ (1,0) [0|0] "" Vector__XXX
 SG_ VCFRONT1_a122_FRONTIPC_nonLocali m122 : 17|1@1+ (1,0) [0|0] "" Vector__XXX
 SG_ VCFRONT1_a124_BATTIPC_status m124 : 17|1@1+ (1,0) [0|0] "" Vector__XXX
 SG_ VCFRONT1_a125_FRONTIPC_steerAngl m125 : 17|1@1+ (1,0) [0|0] "" Vector__XXX
 SG_ VCFRONT1_a126_BATTIPC_sysStatus m126 : 17|1@1+ (1,0) [0|0] "" Vector__XXX
 SG_ VCFRONT1_a131_BATTIPC_power m131 : 17|1@1+ (1,0) [0|0] "" Vector__XXX
 SG_ VCFRONT1_a133_FRONTIPC_secondary m133 : 17|1@1+ (1,0) [0|0] "" Vector__XXX
 SG_ VCFRONT1_a144_BATTIPC_status m144 : 17|1@1+ (1,0) [0|0] "" Vector__XXX
 SG_ VCFRONT1_a214_tripCurrent m214 : 17|10@1- (0.1,0) [0|0] "" Vector__XXX
 SG_ VCFRONT1_a216_hvState m216 : 17|3@1+ (1,0) [0|0] "" Vector__XXX
 SG_ VCFRONT1_a223_failedFaultInject m223 : 17|1@1+ (1,0) [0|0] "" Vector__XXX
 SG_ VCFRONT1_a229_pcsMIA m229 : 17|1@1+ (1,0) [0|0] "" Vector__XXX
 SG_ VCFRONT1_a249_pcsOvShutdownArmed m249 : 17|1@1+ (1,0) [0|0] "" Vector__XXX
 SG_ VCFRONT1_a250_pcsOvShutdownArmed m250 : 17|1@1+ (1,0) [0|0] "" Vector__XXX
 SG_ VCFRONT1_a253_pcsOvSelfTestEnabl m253 : 17|1@1+ (1,0) [0|0] "" Vector__XXX
 SG_ VCFRONT1_a423_vehBusAwake m423 : 17|1@1+ (1,0) [0|0] "" Vector__XXX
 SG_ VCFRONT1_a484_upstreamEFuseVolta m484 : 17|6@1+ (1,0) [0|0] "" Vector__XXX
 SG_ VCFRONT1_a486_bridgeFailedSyncCh m486 : 17|1@1+ (1,0) [0|0] "" Vector__XXX
 SG_ VCFRONT1_a496_frunkOpen m496 : 17|1@1+ (1,0) [0|0] "" Vector__XXX
 SG_ VCFRONT1_a590_vcrightCurveOffset m590 : 17|3@1+ (1,0) [0|0] "" Vector__XXX
 SG_ VCFRONT1_a591_vcrightCurrentThre m591 : 17|12@1+ (0.1,0) [0|0] "" Vector__XXX
 SG_ VCFRONT1_a596_vcrightCutoffCurve m596 : 17|3@1+ (1,0) [0|0] "" Vector__XXX
 SG_ VCFRONT1_a597_vcrightCutoffCurre m597 : 17|12@1+ (0.1,0) [0|0] "" Vector__XXX
 SG_ VCFRONT1_a617_FRONTIPC_VC_infoMe m617 : 17|1@1+ (1,0) [0|0] "" Vector__XXX
 SG_ VCFRONT1_a001_InternalWatchdog m1 : 16|1@1+ (1,0) [0|0] "" Vector__XXX
 SG_ VCFRONT1_a002_CPUUndervoltage m2 : 16|1@1+ (1,0) [0|0] "" Vector__XXX
 SG_ VCFRONT1_a003_AssertID m3 : 16|16@1+ (1,0) [0|0] "" Vector__XXX
 SG_ VCFRONT1_a005_busID0 m5 : 16|4@1+ (1,0) [0|0] "" Vector__XXX
 SG_ VCFRONT1_a006_busID m6 : 16|4@1+ (1,0) [0|0] "" Vector__XXX
 SG_ VCFRONT1_a012_ClockError m12 : 16|1@1+ (1,0) [0|0] "" Vector__XXX
 SG_ VCFRONT1_a013_LogQueueFull m13 : 16|1@1+ (1,0) [0|0] "" Vector__XXX
 SG_ VCFRONT1_a015_NVMMMemOverflow m15 : 16|1@1+ (1,0) [0|0] "" Vector__XXX
 SG_ VCFRONT1_a016_NVMMRecordID m16 : 16|16@1+ (1,0) [0|0] "" Vector__XXX
 SG_ VCFRONT1_a017_NVMMLifetimeEraseC m17 : 16|32@1+ (1,0) [0|0] "" Vector__XXX
 SG_ VCFRONT1_a018_DEBUGEVT m18 : 16|1@1+ (1,0) [0|0] "" Vector__XXX
 SG_ VCFRONT1_a019_BFARVALID m19 : 16|1@1+ (1,0) [0|0] "" Vector__XXX
 SG_ VCFRONT1_a021_Task1msLate m21 : 16|1@1+ (1,0) [0|0] "" Vector__XXX
 SG_ VCFRONT1_a022_TaskInitErrorCount m22 : 16|8@1+ (1,0) [0|0] "" Vector__XXX
 SG_ VCFRONT1_a028_DivideByZero m28 : 16|1@1+ (1,0) [0|0] "" Vector__XXX
 SG_ VCFRONT1_a030_logId m30 : 16|4@1+ (1,0) [0|0] "" Vector__XXX
 SG_ VCFRONT1_a031_uds_bytes_0 m31 : 16|8@1+ (1,0) [0|0] "" Vector__XXX
 SG_ VCFRONT1_a036_ipsr m36 : 16|8@1+ (1,0) [0|0] "" Vector__XXX
 SG_ VCFRONT1_a037_MMFARVALID m37 : 16|1@1+ (1,0) [0|0] "" Vector__XXX
 SG_ VCFRONT1_a038_faultType m38 : 16|2@1+ (1,0) [0|0] "" Vector__XXX
 SG_ VCFRONT1_a039_faultType m39 : 16|2@1+ (1,0) [0|0] "" Vector__XXX
 SG_ VCFRONT1_a040_depth m40 : 16|4@1+ (1,0) [0|0] "" Vector__XXX
 SG_ VCFRONT1_a041_CPULoadTotal m41 : 16|8@1+ (1,0) [0|0] "" Vector__XXX
 SG_ VCFRONT1_a042_Usage1msTask m42 : 16|8@1+ (1,0) [0|0] "" Vector__XXX
 SG_ VCFRONT1_a043_CallTrace0 m43 : 16|24@1+ (1,0) [0|0] "" Vector__XXX
 SG_ VCFRONT1_a044_CallTrace0 m44 : 16|24@1+ (1,0) [0|0] "" Vector__XXX
 SG_ VCFRONT1_a045_CallTrace0 m45 : 16|24@1+ (1,0) [0|0] "" Vector__XXX
 SG_ VCFRONT1_a046_CallTrace0 m46 : 16|24@1+ (1,0) [0|0] "" Vector__XXX
 SG_ VCFRONT1_a058_voltageDrop m58 : 16|12@1+ (0.005443676098,0) [0|0] "" Vector__XXX
 SG_ VCFRONT1_a059_voltageDrop m59 : 16|12@1+ (0.005443676098,0) [0|0] "" Vector__XXX
 SG_ VCFRONT1_a060_lockoutDisabled m60 : 16|1@1+ (1,0) [0|0] "" Vector__XXX
 SG_ VCFRONT1_a063_switchChannel m63 : 16|8@1+ (1,0) [0|0] "" Vector__XXX
 SG_ VCFRONT1_a064_busBitField m64 : 16|8@1+ (1,0) [0|0] "" Vector__XXX
 SG_ VCFRONT1_a077_BATTIPC_battIpcDat m77 : 16|1@1+ (1,0) [0|0] "" Vector__XXX
 SG_ VCFRONT1_a078_FRONTIPC_frontpriv m78 : 16|1@1+ (1,0) [0|0] "" Vector__XXX
 SG_ VCFRONT1_a079_FRONTIPC_frontpriv m79 : 16|1@1+ (1,0) [0|0] "" Vector__XXX
 SG_ VCFRONT1_a080_FRONTIPC_frontIpcD m80 : 16|1@1+ (1,0) [0|0] "" Vector__XXX
 SG_ VCFRONT1_a081_FRONTIPC_vehNm m81 : 16|1@1+ (1,0) [0|0] "" Vector__XXX
 SG_ VCFRONT1_a082_FRONTIPC_frontpriv m82 : 16|1@1+ (1,0) [0|0] "" Vector__XXX
 SG_ VCFRONT1_a086_FRONTIPC_vehNm m86 : 16|1@1+ (1,0) [0|0] "" Vector__XXX
 SG_ VCFRONT1_a090_FRONTIPC_chNm m90 : 16|1@1+ (1,0) [0|0] "" Vector__XXX
 SG_ VCFRONT1_a091_FRONTIPC_faultsAnd m91 : 16|1@1+ (1,0) [0|0] "" Vector__XXX
 SG_ VCFRONT1_a096_FRONTIPC_status m96 : 16|1@1+ (1,0) [0|0] "" Vector__XXX
 SG_ VCFRONT1_a098_FRONTIPC_temperatu m98 : 16|1@1+ (1,0) [0|0] "" Vector__XXX
 SG_ VCFRONT1_a100_BATTIPC m100 : 16|1@1+ (1,0) [0|0] "" Vector__XXX
 SG_ VCFRONT1_a103_FRONTIPC_hvsNm m103 : 16|1@1+ (1,0) [0|0] "" Vector__XXX
 SG_ VCFRONT1_a104_FRONTIPC_chNm m104 : 16|1@1+ (1,0) [0|0] "" Vector__XXX
 SG_ VCFRONT1_a105_FRONTIPC_chNm m105 : 16|1@1+ (1,0) [0|0] "" Vector__XXX
 SG_ VCFRONT1_a106_BATTIPC_dcdcRailSt m106 : 16|1@1+ (1,0) [0|0] "" Vector__XXX
 SG_ VCFRONT1_a107_FRONTIPC_vehNm m107 : 16|1@1+ (1,0) [0|0] "" Vector__XXX
 SG_ VCFRONT1_a108_FRONTIPC_status m108 : 16|1@1+ (1,0) [0|0] "" Vector__XXX
 SG_ VCFRONT1_a110_BATTIPC_carConfig m110 : 16|1@1+ (1,0) [0|0] "" Vector__XXX
 SG_ VCFRONT1_a111_FRONTIPC_vehNm m111 : 16|1@1+ (1,0) [0|0] "" Vector__XXX
 SG_ VCFRONT1_a112_FRONTIPC_vehNm m112 : 16|1@1+ (1,0) [0|0] "" Vector__XXX
 SG_ VCFRONT1_a113_FRONTIPC_ethNm m113 : 16|1@1+ (1,0) [0|0] "" Vector__XXX
 SG_ VCFRONT1_a114_BATTIPC_wheelRotat m114 : 16|1@1+ (1,0) [0|0] "" Vector__XXX
 SG_ VCFRONT1_a115_FRONTIPC_vehNm m115 : 16|1@1+ (1,0) [0|0] "" Vector__XXX
 SG_ VCFRONT1_a116_FRONTIPC_vehNm m116 : 16|1@1+ (1,0) [0|0] "" Vector__XXX
 SG_ VCFRONT1_a117_FRONTIPC_vehNm m117 : 16|1@1+ (1,0) [0|0] "" Vector__XXX
 SG_ VCFRONT1_a118_FRONTIPC_vehNm m118 : 16|1@1+ (1,0) [0|0] "" Vector__XXX
 SG_ VCFRONT1_a119_FRONTIPC_leftStalk m119 : 16|1@1+ (1,0) [0|0] "" Vector__XXX
 SG_ VCFRONT1_a120_BATTIPC_speed m120 : 16|1@1+ (1,0) [0|0] "" Vector__XXX
 SG_ VCFRONT1_a122_FRONTIPC_status m122 : 16|1@1+ (1,0) [0|0] "" Vector__XXX
 SG_ VCFRONT1_a124_FRONTIPC_status m124 : 16|1@1+ (1,0) [0|0] "" Vector__XXX
 SG_ VCFRONT1_a125_FRONTIPC_leftStalk m125 : 16|1@1+ (1,0) [0|0] "" Vector__XXX
 SG_ VCFRONT1_a126_FRONTIPC_sysStatus m126 : 16|1@1+ (1,0) [0|0] "" Vector__XXX
 SG_ VCFRONT1_a127_iBoosterEFuseCurre m127 : 16|16@1+ (0.1,0) [0|0] "" Vector__XXX
 SG_ VCFRONT1_a128_vcrightEFuseCurren m128 : 16|16@1+ (0.1,0) [0|0] "" Vector__XXX
 SG_ VCFRONT1_a129_pcsEFuseCurrent m129 : 16|16@1+ (0.1,0) [0|0] "" Vector__XXX
 SG_ VCFRONT1_a130_autopilot2EFuseCur m130 : 16|16@1+ (0.1,0) [0|0] "" Vector__XXX
 SG_ VCFRONT1_a131_FRONTIPC_power m131 : 16|1@1+ (1,0) [0|0] "" Vector__XXX
 SG_ VCFRONT1_a132_epas2EFuseCurrent m132 : 16|16@1+ (0.1,0) [0|0] "" Vector__XXX
 SG_ VCFRONT1_a133_BATTIPC_primaryAct m133 : 16|1@1+ (1,0) [0|0] "" Vector__XXX
 SG_ VCFRONT1_a134_hvContactorsEFuseC m134 : 16|16@1+ (0.1,0) [0|0] "" Vector__XXX
 SG_ VCFRONT1_a135_leftHeadlightEFuse m135 : 16|16@1+ (0.1,0) [0|0] "" Vector__XXX
 SG_ VCFRONT1_a144_FRONTIPC_status m144 : 16|1@1+ (1,0) [0|0] "" Vector__XXX
 SG_ VCFRONT1_a164_lockoutVoltage m164 : 16|16@1+ (0.1,0) [0|0] "" Vector__XXX
 SG_ VCFRONT1_a165_lockoutVoltage m165 : 16|16@1+ (0.1,0) [0|0] "" Vector__XXX
 SG_ VCFRONT1_a177_mcuAudioEFuseCurre m177 : 16|10@1+ (0.1,0) [0|0] "" Vector__XXX
 SG_ VCFRONT1_a188_LVBridgeState m188 : 16|4@1+ (1,0) [0|0] "" Vector__XXX
 SG_ VCFRONT1_a191_vehiclePowerState m191 : 16|2@1+ (1,0) [0|0] "" Vector__XXX
 SG_ VCFRONT1_a204_vbusVoltage m204 : 16|10@1+ (0.025,0) [0|0] "" Vector__XXX
 SG_ VCFRONT1_a205_busVoltage m205 : 16|10@1+ (0.025,0) [0|0] "" Vector__XXX
 SG_ VCFRONT1_a214_channel m214 : 16|1@1+ (1,0) [0|0] "" Vector__XXX
 SG_ VCFRONT1_a216_inDrive m216 : 16|1@1+ (1,0) [0|0] "" Vector__XXX
 SG_ VCFRONT1_a220_DI_gear m220 : 16|3@1+ (1,0) [0|0] "" Vector__XXX
 SG_ VCFRONT1_a223_failedArmingSetup m223 : 16|1@1+ (1,0) [0|0] "" Vector__XXX
 SG_ VCFRONT1_a229_bridgeOpened m229 : 16|1@1+ (1,0) [0|0] "" Vector__XXX
 SG_ VCFRONT1_a249_hardwareProtection m249 : 16|1@1+ (1,0) [0|0] "" Vector__XXX
 SG_ VCFRONT1_a250_pcsOvShutdownFault m250 : 16|1@1+ (1,0) [0|0] "" Vector__XXX
 SG_ VCFRONT1_a251_rationalitySetupCh m251 : 16|2@1+ (1,0) [0|0] "" Vector__XXX
 SG_ VCFRONT1_a252_stage m252 : 16|3@1+ (1,0) [0|0] "" Vector__XXX
 SG_ VCFRONT1_a253_pcsOvClampArmed m253 : 16|1@1+ (1,0) [0|0] "" Vector__XXX
 SG_ VCFRONT1_a262_eFuseVoltage m262 : 16|16@1+ (0.1,0) [0|0] "" Vector__XXX
 SG_ VCFRONT1_a263_eFuseVoltage m263 : 16|16@1+ (0.1,0) [0|0] "" Vector__XXX
 SG_ VCFRONT1_a264_eFuseVoltage m264 : 16|16@1+ (0.1,0) [0|0] "" Vector__XXX
 SG_ VCFRONT1_a266_eFuseVoltage m266 : 16|16@1+ (0.1,0) [0|0] "" Vector__XXX
 SG_ VCFRONT1_a414_failureReason m414 : 16|6@1+ (1,0) [0|0] "" Vector__XXX
 SG_ VCFRONT1_a415_upstreamEFuseStuck m415 : 16|1@1+ (1,0) [0|0] "" Vector__XXX
 SG_ VCFRONT1_a423_allBusesSleeping m423 : 16|1@1+ (1,0) [0|0] "" Vector__XXX
 SG_ VCFRONT1_a475_channel m475 : 16|3@1+ (1,0) [0|0] "" Vector__XXX
 SG_ VCFRONT1_a482_lvBridgeEFuseCurre m482 : 16|16@1+ (0.1,0) [0|0] "" Vector__XXX
 SG_ VCFRONT1_a484_upstreamEFuseStuck m484 : 16|1@1+ (1,0) [0|0] "" Vector__XXX
 SG_ VCFRONT1_a485_upstreamEfuseUnatt m485 : 16|1@1+ (1,0) [0|0] "" Vector__XXX
 SG_ VCFRONT1_a486_bridgeFailedArming m486 : 16|1@1+ (1,0) [0|0] "" Vector__XXX
 SG_ VCFRONT1_a489_channel m489 : 16|3@1+ (1,0) [0|0] "" Vector__XXX
 SG_ VCFRONT1_a490_channel m490 : 16|3@1+ (1,0) [0|0] "" Vector__XXX
 SG_ VCFRONT1_a491_channel m491 : 16|3@1+ (1,0) [0|0] "" Vector__XXX
 SG_ VCFRONT1_a496_serviceMode m496 : 16|1@1+ (1,0) [0|0] "" Vector__XXX
 SG_ VCFRONT1_a509_channel m509 : 16|3@1+ (1,0) [0|0] "" Vector__XXX
 SG_ VCFRONT1_a574_frontDriveInverter m574 : 16|16@1+ (0.1,0) [0|0] "" Vector__XXX
 SG_ VCFRONT1_a578_vbusFusedLoadShedC m578 : 16|16@1+ (0.1,0) [0|0] "" Vector__XXX
 SG_ VCFRONT1_a581_channel m581 : 16|3@1+ (1,0) [0|0] "" Vector__XXX
 SG_ VCFRONT1_a590_vcrightEFuseCurveT m590 : 16|1@1+ (1,0) [0|0] "" Vector__XXX
 SG_ VCFRONT1_a591_vcrightEFuseFastBl m591 : 16|1@1+ (1,0) [0|0] "" Vector__XXX
 SG_ VCFRONT1_a596_vcrightCutoffEFuse m596 : 16|1@1+ (1,0) [0|0] "" Vector__XXX
 SG_ VCFRONT1_a597_vcrightCutoffEFuse m597 : 16|1@1+ (1,0) [0|0] "" Vector__XXX
 SG_ VCFRONT1_a617_FRONTIPC_APP_VC_in m617 : 16|1@1+ (1,0) [0|0] "" Vector__XXX
 SG_ VCFRONT1_alertState : 15|1@1+ (1,0) [0|0] "" Vector__XXX
 SG_ VCFRONT1_alertID M : 0|10@1+ (1,0) [0|0] "" Vector__XXX

BO_ 1336 ICR_bootID: 12 Vector__XXX
 SG_ ICR_bootFirmwareType : 63|8@0+ (1,0) [0|0] "" Vector__XXX
 SG_ ICR_bootUsageId : 39|16@0+ (1,0) [0|0] "" Vector__XXX
 SG_ ICR_bootAssemblyId : 31|8@0+ (1,0) [0|0] "" Vector__XXX
 SG_ ICR_bootPcbaId : 23|8@0+ (1,0) [0|0] "" Vector__XXX
 SG_ ICR_bootComponentId : 7|16@0+ (1,0) [0|0] "" Vector__XXX

BO_ 1338 VCBATT0_alertLog: 8 Vector__XXX
 SG_ VCBATT0_a058_faultReason m58 : 63|1@1+ (1,0) [0|0] "" Vector__XXX
 SG_ VCBATT0_a047_IpcWatchdog m47 : 61|1@1+ (1,0) [0|0] "" Vector__XXX
 SG_ VCBATT0_a047_SingleCoreFailed m47 : 60|1@1+ (1,0) [0|0] "" Vector__XXX
 SG_ VCBATT0_a047_SingleCoreM7_1 m47 : 59|1@1+ (1,0) [0|0] "" Vector__XXX
 SG_ VCBATT0_a047_SingleCoreM4_M7_0 m47 : 58|1@1+ (1,0) [0|0] "" Vector__XXX
 SG_ VCBATT0_a047_uds m47 : 57|1@1+ (1,0) [0|0] "" Vector__XXX
 SG_ VCBATT0_a022_TaskInitError4 m22 : 56|8@1+ (1,0) [0|0] "" Vector__XXX
 SG_ VCBATT0_a031_uds_bytes_5 m31 : 56|8@1+ (1,0) [0|0] "" Vector__XXX
 SG_ VCBATT0_a041_CPULoadNVMMTask m41 : 56|8@1+ (1,0) [0|0] "" Vector__XXX
 SG_ VCBATT0_a042_UsageNVMMTask m42 : 56|8@1+ (1,0) [0|0] "" Vector__XXX
 SG_ VCBATT0_a047_CsvRef m47 : 56|1@1+ (1,0) [0|0] "" Vector__XXX
 SG_ VCBATT0_a058_newREstimate m58 : 51|12@1+ (0.00061,0) [0|0] "" Vector__XXX
 SG_ VCBATT0_a003_Data m3 : 48|16@1+ (1,0) [0|0] "" Vector__XXX
 SG_ VCBATT0_a022_TaskInitError3 m22 : 48|8@1+ (1,0) [0|0] "" Vector__XXX
 SG_ VCBATT0_a031_uds_bytes_4 m31 : 48|8@1+ (1,0) [0|0] "" Vector__XXX
 SG_ VCBATT0_a041_CPULoad1000msTask m41 : 48|8@1+ (1,0) [0|0] "" Vector__XXX
 SG_ VCBATT0_a042_UsageUDSTask m42 : 48|8@1+ (1,0) [0|0] "" Vector__XXX
 SG_ VCBATT0_a063_faulted m63 : 43|1@1+ (1,0) [0|0] "" Vector__XXX
 SG_ VCBATT0_a423_didCore2EverSleep m423 : 43|1@1+ (1,0) [0|0] "" Vector__XXX
 SG_ VCBATT0_a063_stuckActive m63 : 42|1@1+ (1,0) [0|0] "" Vector__XXX
 SG_ VCBATT0_a423_didCore1EverSleep m423 : 42|1@1+ (1,0) [0|0] "" Vector__XXX
 SG_ VCBATT0_a063_indeterminate m63 : 41|1@1+ (1,0) [0|0] "" Vector__XXX
 SG_ VCBATT0_a423_sleepShutdownC_0000 m423 : 41|1@1+ (1,0) [0|0] "" Vector__XXX
 SG_ VCBATT0_a022_TaskInitError2 m22 : 40|8@1+ (1,0) [0|0] "" Vector__XXX
 SG_ VCBATT0_a031_uds_bytes_3 m31 : 40|8@1+ (1,0) [0|0] "" Vector__XXX
 SG_ VCBATT0_a038_faultSource m38 : 40|7@1+ (1,0) [0|0] "" Vector__XXX
 SG_ VCBATT0_a041_CPULoad100msTask m41 : 40|8@1+ (1,0) [0|0] "" Vector__XXX
 SG_ VCBATT0_a042_Usage1000msTask m42 : 40|8@1+ (1,0) [0|0] "" Vector__XXX
 SG_ VCBATT0_a043_CallTrace1 m43 : 40|24@1+ (1,0) [0|0] "" Vector__XXX
 SG_ VCBATT0_a044_CallTrace1 m44 : 40|24@1+ (1,0) [0|0] "" Vector__XXX
 SG_ VCBATT0_a045_CallTrace1 m45 : 40|24@1+ (1,0) [0|0] "" Vector__XXX
 SG_ VCBATT0_a046_CallTrace1 m46 : 40|24@1+ (1,0) [0|0] "" Vector__XXX
 SG_ VCBATT0_a047_CsvHf m47 : 40|16@1+ (1,0) [0|0] "" Vector__XXX
 SG_ VCBATT0_a059_current m59 : 40|12@1+ (0.05,0) [0|0] "" Vector__XXX
 SG_ VCBATT0_a063_disconnected m63 : 40|1@1+ (1,0) [0|0] "" Vector__XXX
 SG_ VCBATT0_a423_sleepShutdownComple m423 : 40|1@1+ (1,0) [0|0] "" Vector__XXX
 SG_ VCBATT0_a058_prevREstimate m58 : 39|12@1+ (0.00061,0) [0|0] "" Vector__XXX
 SG_ VCBATT0_a016_NVMMWriteFailed m16 : 37|1@1+ (1,0) [0|0] "" Vector__XXX
 SG_ VCBATT0_a005_faults1 m5 : 36|12@1+ (1,0) [0|0] "" Vector__XXX
 SG_ VCBATT0_a016_NVMMMemOverflow m16 : 36|1@1+ (1,0) [0|0] "" Vector__XXX
 SG_ VCBATT0_a038_violationType m38 : 36|3@1+ (1,0) [0|0] "" Vector__XXX
 SG_ VCBATT0_a047_Porvddd m47 : 36|1@1+ (1,0) [0|0] "" Vector__XXX
 SG_ VCBATT0_a016_NVMMRecordUpgraded m16 : 35|1@1+ (1,0) [0|0] "" Vector__XXX
 SG_ VCBATT0_a047_Pmic m47 : 35|1@1+ (1,0) [0|0] "" Vector__XXX
 SG_ VCBATT0_a016_NVMMVersionMismatch m16 : 34|1@1+ (1,0) [0|0] "" Vector__XXX
 SG_ VCBATT0_a047_OcdReghc m47 : 34|1@1+ (1,0) [0|0] "" Vector__XXX
 SG_ VCBATT0_a016_NVMMCRCMismatch m16 : 33|1@1+ (1,0) [0|0] "" Vector__XXX
 SG_ VCBATT0_a047_OcdDpslpLinreg m47 : 33|1@1+ (1,0) [0|0] "" Vector__XXX
 SG_ VCBATT0_a003_LineNumber m3 : 32|16@1+ (1,0) [0|0] "" Vector__XXX
 SG_ VCBATT0_a005_busID1 m5 : 32|4@1+ (1,0) [0|0] "" Vector__XXX
 SG_ VCBATT0_a006_messageID m6 : 32|29@1+ (1,0) [0|0] "" Vector__XXX
 SG_ VCBATT0_a016_NVMMRecordNotFound m16 : 32|1@1+ (1,0) [0|0] "" Vector__XXX
 SG_ VCBATT0_a022_TaskInitError1 m22 : 32|8@1+ (1,0) [0|0] "" Vector__XXX
 SG_ VCBATT0_a031_uds_bytes_2 m31 : 32|8@1+ (1,0) [0|0] "" Vector__XXX
 SG_ VCBATT0_a033_address m33 : 32|32@1+ (1,0) [0|0] "" Vector__XXX
 SG_ VCBATT0_a038_protectionContext m38 : 32|4@1+ (1,0) [0|0] "" Vector__XXX
 SG_ VCBATT0_a041_CPULoad10msTask m41 : 32|8@1+ (1,0) [0|0] "" Vector__XXX
 SG_ VCBATT0_a042_Usage100msTask m42 : 32|8@1+ (1,0) [0|0] "" Vector__XXX
 SG_ VCBATT0_a047_OcdActLinreg m47 : 32|1@1+ (1,0) [0|0] "" Vector__XXX
 SG_ VCBATT0_a063_ADCVoltage m63 : 32|8@1+ (0.025,0) [0|0] "" Vector__XXX
 SG_ VCBATT0_a047_Ovdvccd m47 : 31|1@1+ (1,0) [0|0] "" Vector__XXX
 SG_ VCBATT0_a047_Ovdvdda m47 : 30|1@1+ (1,0) [0|0] "" Vector__XXX
 SG_ VCBATT0_a047_Ovdvddd m47 : 29|1@1+ (1,0) [0|0] "" Vector__XXX
 SG_ VCBATT0_a047_Bodvccd m47 : 28|1@1+ (1,0) [0|0] "" Vector__XXX
 SG_ VCBATT0_a058_current m58 : 28|11@1+ (0.1,0) [0|0] "" Vector__XXX
 SG_ VCBATT0_a059_resistanceEstimate m59 : 28|12@1+ (0.00244,0) [0|0] "" Vector__XXX
 SG_ VCBATT0_a021_Task1000msMissed m21 : 27|1@1+ (1,0) [0|0] "" Vector__XXX
 SG_ VCBATT0_a047_Bodvdda m47 : 27|1@1+ (1,0) [0|0] "" Vector__XXX
 SG_ VCBATT0_a021_Task1000msStarved m21 : 26|1@1+ (1,0) [0|0] "" Vector__XXX
 SG_ VCBATT0_a047_Bodvddd m47 : 26|1@1+ (1,0) [0|0] "" Vector__XXX
 SG_ VCBATT0_a021_Task1000msLate m21 : 25|1@1+ (1,0) [0|0] "" Vector__XXX
 SG_ VCBATT0_a038_busMaster m38 : 25|4@1+ (1,0) [0|0] "" Vector__XXX
 SG_ VCBATT0_a047_Xres m47 : 25|1@1+ (1,0) [0|0] "" Vector__XXX
 SG_ VCBATT0_a006_mailboxID m6 : 24|8@1+ (1,0) [0|0] "" Vector__XXX
 SG_ VCBATT0_a021_Task100msMissed m21 : 24|1@1+ (1,0) [0|0] "" Vector__XXX
 SG_ VCBATT0_a022_TaskInitError0 m22 : 24|8@1+ (1,0) [0|0] "" Vector__XXX
 SG_ VCBATT0_a031_uds_bytes_1 m31 : 24|8@1+ (1,0) [0|0] "" Vector__XXX
 SG_ VCBATT0_a033_syndrome m33 : 24|8@1+ (1,0) [0|0] "" Vector__XXX
 SG_ VCBATT0_a038_nonSecure m38 : 24|1@1+ (1,0) [0|0] "" Vector__XXX
 SG_ VCBATT0_a039_faultAddress m39 : 24|32@1+ (1,0) [0|0] "" Vector__XXX
 SG_ VCBATT0_a040_programCounter m40 : 24|32@1+ (1,0) [0|0] "" Vector__XXX
 SG_ VCBATT0_a041_CPULoad1msTask m41 : 24|8@1+ (1,0) [0|0] "" Vector__XXX
 SG_ VCBATT0_a042_Usage10msTask m42 : 24|8@1+ (1,0) [0|0] "" Vector__XXX
 SG_ VCBATT0_a047_Mcwdt3 m47 : 24|1@1+ (1,0) [0|0] "" Vector__XXX
 SG_ VCBATT0_a063_switchType m63 : 24|8@1+ (1,0) [0|0] "" Vector__XXX
 SG_ VCBATT0_a423_requestSleepFailedB m423 : 24|16@1+ (1,0) [0|0] "" Vector__XXX
 SG_ VCBATT0_a021_Task100msStarved m21 : 23|1@1+ (1,0) [0|0] "" Vector__XXX
 SG_ VCBATT0_a032_pwrDone m32 : 23|1@1+ (1,0) [0|0] "" Vector__XXX
 SG_ VCBATT0_a038_privilegedExecute m38 : 23|1@1+ (1,0) [0|0] "" Vector__XXX
 SG_ VCBATT0_a047_Mcwdt2 m47 : 23|1@1+ (1,0) [0|0] "" Vector__XXX
 SG_ VCBATT0_a021_Task100msLate m21 : 22|1@1+ (1,0) [0|0] "" Vector__XXX
 SG_ VCBATT0_a032_sleepdeep m32 : 22|1@1+ (1,0) [0|0] "" Vector__XXX
 SG_ VCBATT0_a038_privilegedWrite m38 : 22|1@1+ (1,0) [0|0] "" Vector__XXX
 SG_ VCBATT0_a047_Mcwdt1 m47 : 22|1@1+ (1,0) [0|0] "" Vector__XXX
 SG_ VCBATT0_a012_ExternalReset m12 : 21|1@1+ (1,0) [0|0] "" Vector__XXX
 SG_ VCBATT0_a021_Task10msMissed m21 : 21|1@1+ (1,0) [0|0] "" Vector__XXX
 SG_ VCBATT0_a032_sleeping m32 : 21|1@1+ (1,0) [0|0] "" Vector__XXX
 SG_ VCBATT0_a038_privilegedRead m38 : 21|1@1+ (1,0) [0|0] "" Vector__XXX
 SG_ VCBATT0_a047_Mcwdt0 m47 : 21|1@1+ (1,0) [0|0] "" Vector__XXX
 SG_ VCBATT0_a005_faults0 m5 : 20|12@1+ (1,0) [0|0] "" Vector__XXX
 SG_ VCBATT0_a006_fault m6 : 20|4@1+ (1,0) [0|0] "" Vector__XXX
 SG_ VCBATT0_a012_DebugReset m12 : 20|1@1+ (1,0) [0|0] "" Vector__XXX
 SG_ VCBATT0_a021_Task10msStarved m21 : 20|1@1+ (1,0) [0|0] "" Vector__XXX
 SG_ VCBATT0_a038_userExecute m38 : 20|1@1+ (1,0) [0|0] "" Vector__XXX
 SG_ VCBATT0_a047_SysReset m47 : 20|1@1+ (1,0) [0|0] "" Vector__XXX
 SG_ VCBATT0_a012_CheckstopReset m12 : 19|1@1+ (1,0) [0|0] "" Vector__XXX
 SG_ VCBATT0_a021_Task10msLate m21 : 19|1@1+ (1,0) [0|0] "" Vector__XXX
 SG_ VCBATT0_a032_corePowerMode m32 : 19|2@1+ (1,0) [0|0] "" Vector__XXX
 SG_ VCBATT0_a038_userWrite m38 : 19|1@1+ (1,0) [0|0] "" Vector__XXX
 SG_ VCBATT0_a047_TcDbgreset m47 : 19|1@1+ (1,0) [0|0] "" Vector__XXX
 SG_ VCBATT0_a012_SoftwareReset m12 : 18|1@1+ (1,0) [0|0] "" Vector__XXX
 SG_ VCBATT0_a015_NVMMRecordIDError m15 : 18|1@1+ (1,0) [0|0] "" Vector__XXX
 SG_ VCBATT0_a021_Task1msMissed m21 : 18|1@1+ (1,0) [0|0] "" Vector__XXX
 SG_ VCBATT0_a032_watchdogState m32 : 18|1@1+ (1,0) [0|0] "" Vector__XXX
 SG_ VCBATT0_a038_userRead m38 : 18|1@1+ (1,0) [0|0] "" Vector__XXX
 SG_ VCBATT0_a047_DpslpFault m47 : 18|1@1+ (1,0) [0|0] "" Vector__XXX
 SG_ VCBATT0_a002_PowerOnReset m2 : 17|1@1+ (1,0) [0|0] "" Vector__XXX
 SG_ VCBATT0_a012_FlashError m12 : 17|1@1+ (1,0) [0|0] "" Vector__XXX
 SG_ VCBATT0_a013_ClearQueueFull m13 : 17|1@1+ (1,0) [0|0] "" Vector__XXX
 SG_ VCBATT0_a015_NVMMFilesystemError m15 : 17|1@1+ (1,0) [0|0] "" Vector__XXX
 SG_ VCBATT0_a021_Task1msStarved m21 : 17|1@1+ (1,0) [0|0] "" Vector__XXX
 SG_ VCBATT0_a047_ActFault m47 : 17|1@1+ (1,0) [0|0] "" Vector__XXX
 SG_ VCBATT0_a060_resetUnlocked m60 : 17|1@1+ (1,0) [0|0] "" Vector__XXX
 SG_ VCBATT0_a423_requestSleepFailed m423 : 17|1@1+ (1,0) [0|0] "" Vector__XXX
 SG_ VCBATT0_a001_InternalWatchdog m1 : 16|1@1+ (1,0) [0|0] "" Vector__XXX
 SG_ VCBATT0_a002_CPUUndervoltage m2 : 16|1@1+ (1,0) [0|0] "" Vector__XXX
 SG_ VCBATT0_a003_AssertID m3 : 16|16@1+ (1,0) [0|0] "" Vector__XXX
 SG_ VCBATT0_a005_busID0 m5 : 16|4@1+ (1,0) [0|0] "" Vector__XXX
 SG_ VCBATT0_a006_busID m6 : 16|4@1+ (1,0) [0|0] "" Vector__XXX
 SG_ VCBATT0_a012_ClockError m12 : 16|1@1+ (1,0) [0|0] "" Vector__XXX
 SG_ VCBATT0_a013_LogQueueFull m13 : 16|1@1+ (1,0) [0|0] "" Vector__XXX
 SG_ VCBATT0_a015_NVMMMemOverflow m15 : 16|1@1+ (1,0) [0|0] "" Vector__XXX
 SG_ VCBATT0_a016_NVMMRecordID m16 : 16|16@1+ (1,0) [0|0] "" Vector__XXX
 SG_ VCBATT0_a021_Task1msLate m21 : 16|1@1+ (1,0) [0|0] "" Vector__XXX
 SG_ VCBATT0_a022_TaskInitErrorCount m22 : 16|8@1+ (1,0) [0|0] "" Vector__XXX
 SG_ VCBATT0_a030_logId m30 : 16|4@1+ (1,0) [0|0] "" Vector__XXX
 SG_ VCBATT0_a031_uds_bytes_0 m31 : 16|8@1+ (1,0) [0|0] "" Vector__XXX
 SG_ VCBATT0_a032_core m32 : 16|2@1+ (1,0) [0|0] "" Vector__XXX
 SG_ VCBATT0_a033_index m33 : 16|7@1+ (1,0) [0|0] "" Vector__XXX
 SG_ VCBATT0_a038_faultType m38 : 16|2@1+ (1,0) [0|0] "" Vector__XXX
 SG_ VCBATT0_a039_faultType m39 : 16|2@1+ (1,0) [0|0] "" Vector__XXX
 SG_ VCBATT0_a040_depth m40 : 16|4@1+ (1,0) [0|0] "" Vector__XXX
 SG_ VCBATT0_a041_CPULoadTotal m41 : 16|8@1+ (1,0) [0|0] "" Vector__XXX
 SG_ VCBATT0_a042_Usage1msTask m42 : 16|8@1+ (1,0) [0|0] "" Vector__XXX
 SG_ VCBATT0_a043_CallTrace0 m43 : 16|24@1+ (1,0) [0|0] "" Vector__XXX
 SG_ VCBATT0_a044_CallTrace0 m44 : 16|24@1+ (1,0) [0|0] "" Vector__XXX
 SG_ VCBATT0_a045_CallTrace0 m45 : 16|24@1+ (1,0) [0|0] "" Vector__XXX
 SG_ VCBATT0_a046_CallTrace0 m46 : 16|24@1+ (1,0) [0|0] "" Vector__XXX
 SG_ VCBATT0_a047_Wdt m47 : 16|1@1+ (1,0) [0|0] "" Vector__XXX
 SG_ VCBATT0_a058_voltageDrop m58 : 16|12@1+ (0.005443676098,0) [0|0] "" Vector__XXX
 SG_ VCBATT0_a059_voltageDrop m59 : 16|12@1+ (0.005443676098,0) [0|0] "" Vector__XXX
 SG_ VCBATT0_a060_lockoutDisabled m60 : 16|1@1+ (1,0) [0|0] "" Vector__XXX
 SG_ VCBATT0_a063_switchChannel m63 : 16|8@1+ (1,0) [0|0] "" Vector__XXX
 SG_ VCBATT0_a064_busBitField m64 : 16|8@1+ (1,0) [0|0] "" Vector__XXX
 SG_ VCBATT0_a423_readyToSleepFailed m423 : 16|1@1+ (1,0) [0|0] "" Vector__XXX
 SG_ VCBATT0_alertState : 15|1@1+ (1,0) [0|0] "" Vector__XXX
 SG_ VCBATT0_alertID M : 0|9@1+ (1,0) [0|0] "" Vector__XXX

CM_ BO_ 1335 "ESP32-DualCAN Model3_VEH. Not seen on this car in the logs.";
VAL_ 1335 VCFRONT1_a117_BATTIPC_systemStat 0 "UNKNOWN" 1 "RELEASED" 2 "PARKED" 3 "DYNAMIC" 4 "PARKING" 5 "RELEASING" 6 "FAULT" 7 "FAULT_SECURE" 8 "MISMATCH" ;
VAL_ 1335 VCFRONT1_a220_serviceMode 0 "DISABLED" 1 "ENABLED" ;
VAL_ 1335 VCFRONT1_a220_factoryMode 0 "DISABLED" 1 "ENABLED" ;
VAL_ 1335 VCFRONT1_a117_BATTIPC_status 0 "DISABLED" 1 "ENABLED" 2 "TEMPORARY_FAILURE" 3 "SNA" ;
VAL_ 1335 VCFRONT1_a113_FRONTIPC_status 0 "DISABLED" 1 "ENABLED" 2 "TEMPORARY_FAILURE" 3 "SNA" ;
VAL_ 1335 VCFRONT1_a116_BATTIPC_systemStat 0 "UNKNOWN" 1 "RELEASED" 2 "PARKED" 3 "DYNAMIC" 4 "PARKING" 5 "RELEASING" 6 "FAULT" 7 "FAULT_SECURE" 8 "MISMATCH" ;
VAL_ 1335 VCFRONT1_a116_FRONTIPC_systemSta 0 "UNKNOWN" 1 "RELEASED" 2 "PARKED" 3 "DYNAMIC" 4 "PARKING" 5 "RELEASING" 6 "FAULT" 7 "FAULT_SECURE" 8 "MISMATCH" ;
VAL_ 1335 VCFRONT1_a129_pcsEFuseVoltage 1023 "SNA" ;
VAL_ 1335 VCFRONT1_a188_vehiclePowerState 0 "OFF" 1 "CONDITIONING" 2 "ACCESSORY" 3 "DRIVE" ;
VAL_ 1335 VCFRONT1_a191_serviceMode 0 "DISABLED" 1 "ENABLED" ;
VAL_ 1335 VCFRONT1_a110_BATTIPC_status 0 "DISABLED" 1 "ENABLED" 2 "TEMPORARY_FAILURE" 3 "SNA" ;
VAL_ 1335 VCFRONT1_a104_BATTIPC_status 0 "DISABLED" 1 "ENABLED" 2 "TEMPORARY_FAILURE" 3 "SNA" ;
VAL_ 1335 VCFRONT1_a118_BATTIPC_systemStat 0 "UNKNOWN" 1 "RELEASED" 2 "PARKED" 3 "DYNAMIC" 4 "PARKING" 5 "RELEASING" 6 "FAULT" 7 "FAULT_SECURE" 8 "MISMATCH" ;
VAL_ 1335 VCFRONT1_a118_FRONTIPC_systemSta 0 "UNKNOWN" 1 "RELEASED" 2 "PARKED" 3 "DYNAMIC" 4 "PARKING" 5 "RELEASING" 6 "FAULT" 7 "FAULT_SECURE" 8 "MISMATCH" ;
VAL_ 1335 VCFRONT1_a118_BATTIPC_status 0 "DISABLED" 1 "ENABLED" 2 "TEMPORARY_FAILURE" 3 "SNA" ;
VAL_ 1335 VCFRONT1_a188_bridgeEFuseState 0 "UNKNOWN" 1 "STANDBY" 2 "WAKEUP" 3 "CONFIGURATION" 4 "UNLOCKED" 5 "LOCKED" 6 "SELF_TEST_PREP" 7 "SELF_TEST" ;
VAL_ 1335 VCFRONT1_a079_FRONTIPC_systemSta 0 "UNKNOWN" 1 "RELEASED" 2 "PARKED" 3 "DYNAMIC" 4 "PARKING" 5 "RELEASING" 6 "FAULT" 7 "FAULT_SECURE" 8 "MISMATCH" ;
VAL_ 1335 VCFRONT1_a079_BATTIPC_systemStat 0 "UNKNOWN" 1 "RELEASED" 2 "PARKED" 3 "DYNAMIC" 4 "PARKING" 5 "RELEASING" 6 "FAULT" 7 "FAULT_SECURE" 8 "MISMATCH" ;
VAL_ 1335 VCFRONT1_a104_FRONTIPC_status 0 "DISABLED" 1 "ENABLED" 2 "TEMPORARY_FAILURE" 3 "SNA" ;
VAL_ 1335 VCFRONT1_a116_FRONTIPC_status 0 "DISABLED" 1 "ENABLED" 2 "TEMPORARY_FAILURE" 3 "SNA" ;
VAL_ 1335 VCFRONT1_a113_BATTIPC_status 0 "DISABLED" 1 "ENABLED" 2 "TEMPORARY_FAILURE" 3 "SNA" ;
VAL_ 1335 VCFRONT1_a220_vehicleSpeed 8191 "SNA" ;
VAL_ 1335 VCFRONT1_a090_BATTIPC_state 0 "STANDBY" 1 "DRIVE" 2 "SUPPORT" 3 "CHARGE" 4 "FEIM" 5 "CLEAR_FAULT" 6 "FAULT" 7 "WELD" 8 "TEST" 9 "SNA" 10 "DIAG" ;
VAL_ 1335 VCFRONT1_a107_BATTIPC_status 0 "DISABLED" 1 "ENABLED" 2 "TEMPORARY_FAILURE" 3 "SNA" ;
VAL_ 1335 VCFRONT1_a120_BATTIPC_systemStat 0 "UNKNOWN" 1 "RELEASED" 2 "PARKED" 3 "DYNAMIC" 4 "PARKING" 5 "RELEASING" 6 "FAULT" 7 "FAULT_SECURE" 8 "MISMATCH" ;
VAL_ 1335 VCFRONT1_a126_BATTIPC_status 0 "DISABLED" 1 "ENABLED" 2 "TEMPORARY_FAILURE" 3 "SNA" ;
VAL_ 1335 VCFRONT1_a509_state 0 "STANDBY" 1 "DRIVE" 2 "SUPPORT" 3 "CHARGE" 4 "FEIM" 5 "CLEAR_FAULT" 6 "FAULT" 7 "WELD" 8 "TEST" 9 "SNA" 10 "DIAG" ;
VAL_ 1335 VCFRONT1_a617_BATTIPC_status 0 "DISABLED" 1 "ENABLED" 2 "TEMPORARY_FAILURE" 3 "SNA" ;
VAL_ 1335 VCFRONT1_a090_FRONTIPC_status 0 "DISABLED" 1 "ENABLED" 2 "TEMPORARY_FAILURE" 3 "SNA" ;
VAL_ 1335 VCFRONT1_a111_BATTIPC_status 0 "DISABLED" 1 "ENABLED" 2 "TEMPORARY_FAILURE" 3 "SNA" ;
VAL_ 1335 VCFRONT1_a112_BATTIPC_status 0 "DISABLED" 1 "ENABLED" 2 "TEMPORARY_FAILURE" 3 "SNA" ;
VAL_ 1335 VCFRONT1_a120_FRONTIPC_systemSta 0 "UNKNOWN" 1 "RELEASED" 2 "PARKED" 3 "DYNAMIC" 4 "PARKING" 5 "RELEASING" 6 "FAULT" 7 "FAULT_SECURE" 8 "MISMATCH" ;
VAL_ 1335 VCFRONT1_a126_FRONTIPC_status 0 "DISABLED" 1 "ENABLED" 2 "TEMPORARY_FAILURE" 3 "SNA" ;
VAL_ 1335 VCFRONT1_a191_hvState 0 "DOWN" 1 "COMING_UP" 2 "GOING_DOWN" 3 "UP_FOR_DRIVE" 4 "UP_FOR_CHARGE" 5 "UP_FOR_DC_CHARGE" 6 "UP" ;
VAL_ 1335 VCFRONT1_a617_FRONTIPC_status 0 "DISABLED" 1 "ENABLED" 2 "TEMPORARY_FAILURE" 3 "SNA" ;
VAL_ 1335 VCFRONT1_a090_FRONTIPC_state 0 "STANDBY" 1 "DRIVE" 2 "SUPPORT" 3 "CHARGE" 4 "FEIM" 5 "CLEAR_FAULT" 6 "FAULT" 7 "WELD" 8 "TEST" 9 "SNA" 10 "DIAG" ;
VAL_ 1335 VCFRONT1_a091_FRONTIPC_state 0 "STANDBY" 1 "DRIVE" 2 "SUPPORT" 3 "CHARGE" 4 "FEIM" 5 "CLEAR_FAULT" 6 "FAULT" 7 "WELD" 8 "TEST" 9 "SNA" 10 "DIAG" ;
VAL_ 1335 VCFRONT1_a103_FRONTIPC_status 0 "DISABLED" 1 "ENABLED" 2 "TEMPORARY_FAILURE" 3 "SNA" ;
VAL_ 1335 VCFRONT1_a107_FRONTIPC_status 0 "DISABLED" 1 "ENABLED" 2 "TEMPORARY_FAILURE" 3 "SNA" ;
VAL_ 1335 VCFRONT1_a111_FRONTIPC_status 0 "DISABLED" 1 "ENABLED" 2 "TEMPORARY_FAILURE" 3 "SNA" ;
VAL_ 1335 VCFRONT1_a112_FRONTIPC_status 0 "DISABLED" 1 "ENABLED" 2 "TEMPORARY_FAILURE" 3 "SNA" ;
VAL_ 1335 VCFRONT1_a124_BATTIPC_status 0 "DISABLED" 1 "ENABLED" 2 "TEMPORARY_FAILURE" 3 "SNA" ;
VAL_ 1335 VCFRONT1_a144_BATTIPC_status 0 "DISABLED" 1 "ENABLED" 2 "TEMPORARY_FAILURE" 3 "SNA" ;
VAL_ 1335 VCFRONT1_a216_hvState 0 "DOWN" 1 "COMING_UP" 2 "GOING_DOWN" 3 "UP_FOR_DRIVE" 4 "UP_FOR_CHARGE" 5 "UP_FOR_DC_CHARGE" 6 "UP" ;
VAL_ 1335 VCFRONT1_a031_uds_bytes_0 0 "0" 1 "1" 2 "2" 3 "3" 4 "4" 5 "5" 6 "6" 7 "7" 8 "8" 9 "9" 10 "10" 11 "11" 12 "12" 13 "13" 14 "14" 15 "15" 16 "16" 17 "17" 18 "18" 19 "19" 20 "20" 21 "21" 22 "22" 23 "23" 24 "24" 25 "25" 26 "26" 27 "27" 28 "28" 29 "29" 30 "30" 31 "31" ;
VAL_ 1335 VCFRONT1_a096_FRONTIPC_status 0 "DISABLED" 1 "ENABLED" 2 "TEMPORARY_FAILURE" 3 "SNA" ;
VAL_ 1335 VCFRONT1_a108_FRONTIPC_status 0 "DISABLED" 1 "ENABLED" 2 "TEMPORARY_FAILURE" 3 "SNA" ;
VAL_ 1335 VCFRONT1_a122_FRONTIPC_status 0 "DISABLED" 1 "ENABLED" 2 "TEMPORARY_FAILURE" 3 "SNA" ;
VAL_ 1335 VCFRONT1_a124_FRONTIPC_status 0 "DISABLED" 1 "ENABLED" 2 "TEMPORARY_FAILURE" 3 "SNA" ;
VAL_ 1335 VCFRONT1_a144_FRONTIPC_status 0 "DISABLED" 1 "ENABLED" 2 "TEMPORARY_FAILURE" 3 "SNA" ;
VAL_ 1335 VCFRONT1_a188_LVBridgeState 0 "UNKNOWN" 1 "OFF" 2 "ON" 3 "TURNING_ON_FIRST" 4 "WAITING_FOR_REMOTE_TURN_ON_FIRST" 5 "TURNING_ON_SECOND" 6 "WAITING_FOR_REMOTE_TURN_ON_SECOND" 7 "FAULT_ON" 8 "FAULT_OFF" 9 "SELF_TESTING_FIRST" 10 "SELF_TESTING_SECOND" 11 "PRECHARGING" 12 "WAITING_FOR_REMOTE_PRECHARGE" ;
VAL_ 1335 VCFRONT1_a191_vehiclePowerState 0 "OFF" 1 "CONDITIONING" 2 "ACCESSORY" 3 "DRIVE" ;
VAL_ 1335 VCFRONT1_a220_DI_gear 0 "INVALID" 1 "P" 2 "R" 3 "N" 4 "D" 7 "SNA" ;
VAL_ 1335 VCFRONT1_a496_serviceMode 0 "DISABLED" 1 "ENABLED" ;
VAL_ 1335 VCFRONT1_alertState 0 "CLEARED" 1 "SET" ;
VAL_ 1335 VCFRONT1_alertID 0 "ALERT_DO_NOT_USE_ZERO" 1 "a001_DriverDoorOpen" 2 "a002_DoorOpen" 3 "a003_TrunkOpen" 4 "a004_FrunkOpen" 5 "a005_HeadlightsOnDoorOpen" 6 "a006_RemoteServiceAlert" 7 "a007_SoftPackConfigMismatch" 8 "a008_TouchScreenError" 9 "a009_SquashfsError" 10 "a010_MapsMissing" 11 "a011_IncorrectMap" 12 "a012_NotOnPrivateProperty" 13 "a013_TPMSHardWarning" 14 "a014_TPMSSoftWarning" 15 "a015_TPMSOverPressureWarning" 16 "a016_TPMSTemperatureWarning" 17 "a017_TPMSSystemFault" 18 "a018_SlipStartOn" 19 "a019_ParkBrakeFault" 20 "a020_SteeringReduced" 21 "a021_RearSeatbeltUnbuckled" 22 "a022_ApeFusesEtc" 23 "a023_CellInternetCheckFailed" 24 "a024_WifiInternetCheckFailed" 25 "a025_WifiOnlineCheckFailed" 26 "a026_ModemResetLoopDetected" 27 "a027_AutoSteerMIA" 28 "a028_FrontTrunkPopupClosed" 29 "a029_ModemMIA" 30 "a030_ModemVMCrash" 31 "a031_BrakeFluidLow" 32 "a032_CellModemRecoveryResets" 33 "a033_ApTrialExpired" 34 "a034_WakeupProblem" 35 "a035_AudioWatchdogKernelError" 36 "a036_AudioWatchdogHfpError" 37 "a037_AudioWatchdogXrunStormError" 38 "a038_AudioWatchdogA2bI2cLockupError" 39 "a039_AudioA2bNeedRediscovery" 40 "a040_HomelinkTransmit" 41 "a041_AudioDmesgXrun" 42 "a042_AudioDmesgRtThrottling" 43 "a043_InvalidMapDataOverride" 44 "a044_AudioDmesgDspException" 45 "a045_ECallNeedsService" 46 "a046_BackupCameraStreamError" 47 "a047_CellRoamingDisallowed" 48 "a048_AudioPremiumAmpCheckFailed" 49 "a049_BrakeShiftRequired" 50 "a050_BackupCameraIPUTimeout" 51 "a051_BackupCameraFrameTimeout" 52 "a052_KernelPanicReported" 53 "a053_QtCarExitError" 54 "a054_AudioBoostPowerBad" 55 "a055_ManualECallDisabled" 56 "a056_ManualECallButtonDisconnected" 57 "a057_CellAntennaDisconnected" 58 "a058_GPSAntennaDisconnected" 59 "a059_ECallSpeakerDisconnected" 60 "a060_ECallMicDisconnected" 61 "a061_SIMTestFailed" 62 "a062_ENSTestFailed" 63 "a063_CellularTestFailed" 64 "a064_ModemFirmwareTestFailed" 65 "a065_WiFiRecoveryReset" 66 "a066_GpuHangDetected" 67 "a067_WarnOnI915" 68 "a068_VideoUnexpectedExit" 69 "a069_VideoUDPTimeout" 70 "a070_VideoPipelineWarning" 71 "a071_VideoPipelineError" 72 "a072_ECallAnalogMicFailed" 73 "a073_ECallDigitalMicFailed" 74 "a074_EMMCHangDetected" 75 "a075_BackupCameraInitError" 76 "a076_NumFalseManualECalls" 77 "a077_AudioA2bMicChannelSwap" 78 "a078_DashcamUsbDriveUnmountable" 79 "a079_DashcamUsbDriveFull" 80 "a080_DashcamUsbDriveSlow" 81 "a081_CellModemSearchExpired" 82 "a082_NumModemRebootStuckInECall" 83 "a083_ECallProxyWatchdogTriggered" 84 "a084_SerializerError" 85 "a085_DeserializerError" 86 "a086_TouchEnumerationError" 87 "a087_BmpReset" 88 "a088_CellRemovableSimMissing" 89 "a089_RadioSoftResetError" 90 "a090_RadioPingFailError" 91 "a091_VehicleLinkStall" 92 "a092_updateStarted" 93 "a093_updateEnded" 94 "a094_ModemPowerOnFailure" 95 "a095_CidStorageRunningLow" 96 "a096_VideodPipelineIssueDetected" 97 "a097_AudiodRestarted" 98 "a098_DiskCheckFailure" 99 "a099_eMMCStatusError" 100 "a100_eMMCFTLError" 101 "a101_wifiStackProblem" 102 "a102_A2bDiscoveryFailed" 103 "a103_UsbHubNotEnumerating" 104 "a104_DashcamUsbDriveMissing" 105 "a105_firmwareReinstallRequested" 106 "a106_rebootBackstopTriggered" 107 "a107_DashcamUsbDriveTooBigForVfatFsck" 108 "a108_DashcamUsbDriveGettingFull" 109 "a109_DashcamUsbDriveTooSmall" 110 "a110_DashcamUsbDriveCorrupt" 111 "a111_DashcamUsbDriveWrongPort" 112 "a112_badUSBDevice" 113 "a113_DashcamHasOnboardSentryClips" ;
CM_ BO_ 1336 "ESP32-DualCAN Model3_VEH. Not seen on this car in the logs.";
CM_ BO_ 1338 "ESP32-DualCAN Model3_VEH. Not seen on this car in the logs.";
VAL_ 1338 VCBATT0_a047_SingleCoreM4_M7_0 0 "0" 1 "1" 2 "2" 3 "3" 4 "4" 5 "5" 6 "6" 7 "7" 8 "8" 9 "9" 10 "10" 11 "11" 12 "12" 13 "13" 14 "14" 15 "15" 16 "16" 17 "17" 18 "18" 19 "19" 20 "20" 21 "21" 22 "22" 23 "23" 24 "24" 25 "25" 26 "26" 27 "27" 28 "28" 29 "29" 30 "30" 31 "31" ;
VAL_ 1338 VCBATT0_a032_watchdogState 0 "UNKNOWN" 1 "DEGRADED" 2 "CRITICAL" 3 "HEALTHY" 7 "SNA" ;
VAL_ 1338 VCBATT0_a031_uds_bytes_0 0 "0" 1 "1" 2 "2" 3 "3" 4 "4" 5 "5" 6 "6" 7 "7" 8 "8" 9 "9" 10 "10" 11 "11" 12 "12" 13 "13" 14 "14" 15 "15" 16 "16" 17 "17" 18 "18" 19 "19" 20 "20" 21 "21" 22 "22" 23 "23" 24 "24" 25 "25" 26 "26" 27 "27" 28 "28" 29 "29" 30 "30" 31 "31" ;
VAL_ 1338 VCBATT0_alertState 0 "CLEARED" 1 "SET" ;
VAL_ 1338 VCBATT0_alertID 0 "ALERT_DO_NOT_USE_ZERO" 1 "a001_DriverDoorOpen" 2 "a002_DoorOpen" 3 "a003_TrunkOpen" 4 "a004_FrunkOpen" 5 "a005_HeadlightsOnDoorOpen" 6 "a006_RemoteServiceAlert" 7 "a007_SoftPackConfigMismatch" 8 "a008_TouchScreenError" 9 "a009_SquashfsError" 10 "a010_MapsMissing" 11 "a011_IncorrectMap" 12 "a012_NotOnPrivateProperty" 13 "a013_TPMSHardWarning" 14 "a014_TPMSSoftWarning" 15 "a015_TPMSOverPressureWarning" 16 "a016_TPMSTemperatureWarning" 17 "a017_TPMSSystemFault" 18 "a018_SlipStartOn" 19 "a019_ParkBrakeFault" 20 "a020_SteeringReduced" 21 "a021_RearSeatbeltUnbuckled" 22 "a022_ApeFusesEtc" 23 "a023_CellInternetCheckFailed" 24 "a024_WifiInternetCheckFailed" 25 "a025_WifiOnlineCheckFailed" 26 "a026_ModemResetLoopDetected" 27 "a027_AutoSteerMIA" 28 "a028_FrontTrunkPopupClosed" 29 "a029_ModemMIA" 30 "a030_ModemVMCrash" 31 "a031_BrakeFluidLow" 32 "a032_CellModemRecoveryResets" 33 "a033_ApTrialExpired" 34 "a034_WakeupProblem" 35 "a035_AudioWatchdogKernelError" 36 "a036_AudioWatchdogHfpError" 37 "a037_AudioWatchdogXrunStormError" 38 "a038_AudioWatchdogA2bI2cLockupError" 39 "a039_AudioA2bNeedRediscovery" 40 "a040_HomelinkTransmit" 41 "a041_AudioDmesgXrun" 42 "a042_AudioDmesgRtThrottling" 43 "a043_InvalidMapDataOverride" 44 "a044_AudioDmesgDspException" 45 "a045_ECallNeedsService" 46 "a046_BackupCameraStreamError" 47 "a047_CellRoamingDisallowed" 48 "a048_AudioPremiumAmpCheckFailed" 49 "a049_BrakeShiftRequired" 50 "a050_BackupCameraIPUTimeout" 51 "a051_BackupCameraFrameTimeout" 52 "a052_KernelPanicReported" 53 "a053_QtCarExitError" 54 "a054_AudioBoostPowerBad" 55 "a055_ManualECallDisabled" 56 "a056_ManualECallButtonDisconnected" 57 "a057_CellAntennaDisconnected" 58 "a058_GPSAntennaDisconnected" 59 "a059_ECallSpeakerDisconnected" 60 "a060_ECallMicDisconnected" 61 "a061_SIMTestFailed" 62 "a062_ENSTestFailed" 63 "a063_CellularTestFailed" 64 "a064_ModemFirmwareTestFailed" 65 "a065_WiFiRecoveryReset" 66 "a066_GpuHangDetected" 67 "a067_WarnOnI915" 68 "a068_VideoUnexpectedExit" 69 "a069_VideoUDPTimeout" 70 "a070_VideoPipelineWarning" 71 "a071_VideoPipelineError" 72 "a072_ECallAnalogMicFailed" 73 "a073_ECallDigitalMicFailed" 74 "a074_EMMCHangDetected" 75 "a075_BackupCameraInitError" 76 "a076_NumFalseManualECalls" 77 "a077_AudioA2bMicChannelSwap" 78 "a078_DashcamUsbDriveUnmountable" 79 "a079_DashcamUsbDriveFull" 80 "a080_DashcamUsbDriveSlow" 81 "a081_CellModemSearchExpired" 82 "a082_NumModemRebootStuckInECall" 83 "a083_ECallProxyWatchdogTriggered" 84 "a084_SerializerError" 85 "a085_DeserializerError" 86 "a086_TouchEnumerationError" 87 "a087_BmpReset" 88 "a088_CellRemovableSimMissing" 89 "a089_RadioSoftResetError" 90 "a090_RadioPingFailError" 91 "a091_VehicleLinkStall" 92 "a092_updateStarted" 93 "a093_updateEnded" 94 "a094_ModemPowerOnFailure" 95 "a095_CidStorageRunningLow" 96 "a096_VideodPipelineIssueDetected" 97 "a097_AudiodRestarted" 98 "a098_DiskCheckFailure" 99 "a099_eMMCStatusError" 100 "a100_eMMCFTLError" 101 "a101_wifiStackProblem" 102 "a102_A2bDiscoveryFailed" 103 "a103_UsbHubNotEnumerating" 104 "a104_DashcamUsbDriveMissing" 105 "a105_firmwareReinstallRequested" 106 "a106_rebootBackstopTriggered" 107 "a107_DashcamUsbDriveTooBigForVfatFsck" 108 "a108_DashcamUsbDriveGettingFull" 109 "a109_DashcamUsbDriveTooSmall" 110 "a110_DashcamUsbDriveCorrupt" 111 "a111_DashcamUsbDriveWrongPort" 112 "a112_badUSBDevice" 113 "a113_DashcamHasOnboardSentryClips" ;
